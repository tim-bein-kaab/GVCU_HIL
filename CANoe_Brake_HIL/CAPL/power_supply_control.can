/*@!Encoding:65001*/
includes
{
  
}

variables
{
  int port = 1;
  int ret = 0;
  const int cHANDSHAKE_DISABLED = 0;
  const int cBUFFER_SIZE = 1000;
  const int cTXBUFFER_SIZE = 20;
  
  // data is copied from callback buffer to gReceiverBuffer (collects data)
  byte gReceiverCallbackBuffer[cBUFFER_SIZE];
  msTimer myMsTimer1;
  msTimer myMsTimer2;
  msTimer tmrBytesReceived;
  
  char gcharTxBuffer [cTXBUFFER_SIZE];
  byte gbytTxBuffer [cTXBUFFER_SIZE];
  long gchrbyteIndex = 0;
  long txBuffIndex = 0;
  
  char gcharReceiverBuffer[cBUFFER_SIZE];
  byte gEmptyBuffer[cBUFFER_SIZE];
  long gNumberOfReceivedBytes = 0;
  dword gNumberOfBytesToCopy;
  byte txFlag = 1;
}


byte InitSerialPort(int port)
{
  ret = RS232Close(1);
  switch(ret)
  {
    case(0x0):
    {
      write("Port A RS232Close --> Error");
      return 0;
    }
    case(0x1):
    {
      // write("Port A RS232Close --> Success");
      break;
    }
    default:
    {
      write("Port A RS232Close --> Unhandled returnvalue");
      return 0;
    }    
  }
  
  ret = RS232Open(1);
  switch(ret)
  {
    case(0x0):
    {
      write("Port A RS232Open --> Error");
      return 0;
    }
    case(0x1):
    {
      write("Port A RS232Open --> Success --> Open");
      break;
    }
    default:
    {
      write("Port A RS232Open --> Unhandled returnvalue");
      return 0;
    }
  }
  
  ret = RS232Configure(1, 115200, 8, 1, 0);
  switch(ret)
  {
    case(0):
    {
      write("Port A RS232Configure --> Error");
      return 0;
    }
    case(0x1):
    {
      // write("Port A RS232Configure --> Success");
      break;
    }
    default:
    {
      write("Port A RS232Configure --> Unhandled return value");
      return 0;
    }
  }
  
  ret = Rs232SetHandshake(1, cHANDSHAKE_DISABLED, 0, 0, 0, 0);
  switch(ret)
  {
    case(0x0):
    {
      write("Port A Rs232SetHandshake --> Error");
      return 0;     
    }
    case(0x1):
    {
      // write("Port A Rs232SetHandshake --> Success");
      break;
    }
    default:
    {
      write("Port A Rs232SetHandshake --> Unhandled Returnvalue");
      return 0;     
    }
  }
  
  ret = Rs232Receive(1, gReceiverCallbackBuffer, cBUFFER_SIZE);
  switch(ret)
  {
    case(0x0):
    {
      write("Port A Rs232Receive --> Error");
      return 0;
    }
    case(0x1):
    {
      // write("Port A Rs232Receive --> Success");
      break;      
    }
    default:
    {
      write("Port A Rs232Receive --> Unhandled Returnvalue");
      return 0;     
    }
  }  
  return ret; 
}

on key 'K'
{
  ret = InitSerialPort(port);
  if(ret)
  {
    //query voltage
    for(txBuffIndex = 0; txBuffIndex<elcount(gcharTxBuffer); txBuffIndex++)
    {
      gcharTxBuffer[txBuffIndex] = 0;
    }
    snprintf(gcharTxBuffer, elcount(gcharTxBuffer), "VOLt?\n");
    ret = send_serial_command(gcharTxBuffer);
    if(!ret)
    {
      write("send serial command failed");
    }
    
    setTimer(myMsTimer2,100);
  }
  else
  {
    write("Fault occured on serial port init !");
  }
}

on key 'I'
{
  ret = InitSerialPort(port);
  if(ret)
  {
    //query voltage
    for(txBuffIndex = 0; txBuffIndex<elcount(gcharTxBuffer); txBuffIndex++)
    {
      gcharTxBuffer[txBuffIndex] = 0;
    }
    snprintf(gcharTxBuffer, elcount(gcharTxBuffer), "*IDN?\n");
    ret = send_serial_command(gcharTxBuffer);
    if(!ret)
    {
      write("send serial command failed");
    }
    
    setTimer(myMsTimer2,100);
  }
  else
  {
    write("Fault occured on serial port init !");
  }
}

byte send_serial_command(char Txbuffer[])
{
  if (0 != strlen(Txbuffer))
  {
    for (gchrbyteIndex = 0; gchrbyteIndex < strlen(Txbuffer); gchrbyteIndex++)
      gbytTxBuffer[gchrbyteIndex] = Txbuffer[gchrbyteIndex];

     if(txFlag)
     {
       txFlag = 0;
       ret = Rs232Send(1, gbytTxBuffer, strlen(Txbuffer));
       switch(ret)
       {
         case(0x0):
         {
           write("Port A Rs232Send --> Error");
           return 0;
         }
         case(0x1):
         {
           //write("Port A Rs232Send --> Success");
           break;
         }
         default:
         {
           write("Port A Rs232Send --> Unhandled returnvalue");
           return 0;
         }
       }
       //clear tx buffer
      for (gchrbyteIndex = 0; gchrbyteIndex < strlen(Txbuffer); gchrbyteIndex++)
        gbytTxBuffer[gchrbyteIndex] = 0;
    }
  }
  else
  {
     write("Port A No data to be transmitted on Port A");      
  }
  return ret;
}

RS232OnSend(dword port, byte buffer[], dword number)
{
  // set state
  setTimer(myMsTimer1, 100);
}

on timer myMsTimer1
{
  txFlag = 1;
}

on timer myMsTimer2
{
  ret = deInitSerialPort(port);
  if(!ret)
  {
    write("deinit serial port failed");
  }
  else
  {
    write("deinit serial port success");
  }
}

byte deInitSerialPort(int port)
{
  ret = rs232Close(1);
  switch(ret)
  {
    case(0x0):
    {
      write("on preStop PortA --> rs232Close --> Error");
      return 0;
    }
    case(0x1):
    {
      //write("on preStop PortA --> rs232Close --> Succes");
      break;
    }
    default:
    {
      write("on preStop PortA --> rs232Close --> Unhandled Returnvalue");
      return 0;
    }    
  }
  return ret;
}

RS232OnReceive(dword RXport, byte RXbuffer[], dword numberRxBytes)
{
  // collect data as long as buffer has space for it
  if ((gNumberOfReceivedBytes + numberRxBytes) > cBUFFER_SIZE)
  {
     // no more than that ! it is full now
     gNumberOfBytesToCopy = cBUFFER_SIZE - gNumberOfReceivedBytes; 
  } 
  else
   {
     gNumberOfBytesToCopy = numberRxBytes;
   }

  if (gNumberOfBytesToCopy == 0)
  {
     // nothing to add
     return; 
  }

  CopyBuffer(gcharReceiverBuffer, gNumberOfReceivedBytes, RXbuffer, gNumberOfBytesToCopy);
  gNumberOfReceivedBytes += gNumberOfBytesToCopy; 

  
  cancelTimer(tmrBytesReceived);
  setTimer(tmrBytesReceived,500);
}


CopyBuffer(char destBuffer[], dword destOffset, byte srcBuffer[], dword srcNumber)
{
  dword i;

  // transfer byte data into string buffer
  for (i=0; i<srcNumber; i++)
  {
    destBuffer[destOffset+i] = srcBuffer[i];
  }
}

ClearBuffer(char destBuffer[], dword numberBytesToBeCleared)
{
  dword j;
  
  // clean buffer to show current transmission only
  for (j = 0; j < numberBytesToBeCleared; j++)
  {
    destBuffer[j] = 0;
  }  
}


on timer tmrBytesReceived
{
  // reset buffer
  write("received data: %s", gcharReceiverBuffer);
  ClearBuffer(gcharReceiverBuffer, gNumberOfReceivedBytes); 
  gNumberOfReceivedBytes = 0;
}

RS232OnError(dword port, dword errorFlags)
{


  if (errorFlags & 1)
    write("Port A RS232OnError --> %d informs of send error",errorFlags);
  if (errorFlags & 2)
    write("Port A RS232OnError --> %d informs of receive error",errorFlags);
  if (errorFlags & 4)
    write("Port A RS232OnError --> %d informs of frame error",errorFlags);
  if (errorFlags & 8)
    write("Port A RS232OnError --> %d informs of parity error",errorFlags);
  if (errorFlags & 16)
    write("Port A RS232OnError --> %d informs of overrun error",errorFlags);
  if (errorFlags & 32)
    write("Port A RS232OnError --> %d informs of receiver overrun error",errorFlags);
  if (errorFlags & 64)
    write("Port A RS232OnError --> %d informs of break state",errorFlags);
  if (errorFlags & 128)
    write("Port A RS232OnError --> %d informs of send timeout error",errorFlags);
}
