/*@!Encoding:65001*/
includes
{
  

}

variables
{
}

void MainTest()
{
  TestWaitForUnlockEcu("IEB", 3);
}




