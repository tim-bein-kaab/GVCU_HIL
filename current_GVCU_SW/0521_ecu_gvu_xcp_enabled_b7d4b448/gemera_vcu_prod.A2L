ASAP2_VERSION 1 71
/begin PROJECT GEMERA ""
/begin MODULE GVCU ""
/begin MOD_COMMON "" BYTE_ORDER MSB_FIRST ALIGNMENT_BYTE 1 ALIGNMENT_WORD 2 ALIGNMENT_LONG 4 ALIGNMENT_FLOAT16_IEEE 2 ALIGNMENT_FLOAT32_IEEE 4 ALIGNMENT_FLOAT64_IEEE 8 ALIGNMENT_INT64 8 /end MOD_COMMON
/begin TYPEDEF_MEASUREMENT tIceSystemState "" ULONG tIceSystemState 0 0 0 4 /end TYPEDEF_MEASUREMENT
/begin TYPEDEF_MEASUREMENT tBar_10_S16 "" SWORD tBar_10_S16 0 0 -1.0 1000.0 /end TYPEDEF_MEASUREMENT
/begin TYPEDEF_MEASUREMENT tGear "" ULONG tGear 0 0 0 10 /end TYPEDEF_MEASUREMENT
/begin TYPEDEF_MEASUREMENT tAmpereHour "" FLOAT32_IEEE tAmpereHour 0 0 0 1000 /end TYPEDEF_MEASUREMENT
/begin TYPEDEF_MEASUREMENT tRadianPerSecond "" FLOAT32_IEEE tRadianPerSecond 0 0 -1000 1000 /end TYPEDEF_MEASUREMENT
/begin TYPEDEF_MEASUREMENT tPercent_S8 "" SBYTE tPercent_S8 0 0 0 100 /end TYPEDEF_MEASUREMENT
/begin TYPEDEF_MEASUREMENT tDegree_10_S16 "" SWORD tDegree_10_S16 0 0 -720.0 720.0 /end TYPEDEF_MEASUREMENT
/begin TYPEDEF_MEASUREMENT tPercent "" FLOAT32_IEEE tPercent 0 0 0 100 /end TYPEDEF_MEASUREMENT
/begin TYPEDEF_MEASUREMENT tRadianPerSecond_100_U16 "" UWORD tRadianPerSecond_100_U16 0 0 -10.0 10.0 /end TYPEDEF_MEASUREMENT
/begin TYPEDEF_MEASUREMENT uint8_t_0x2 "" UBYTE NO_COMPU_METHOD 0 0 0 1 BIT_MASK 0x2 /end TYPEDEF_MEASUREMENT
/begin TYPEDEF_MEASUREMENT tAccSetVelOrDist "" ULONG tAccSetVelOrDist 0 0 0 4 /end TYPEDEF_MEASUREMENT
/begin TYPEDEF_MEASUREMENT uint8_t_0xF8 "" UBYTE NO_COMPU_METHOD 0 0 0 31 BIT_MASK 0xF8 /end TYPEDEF_MEASUREMENT
/begin TYPEDEF_MEASUREMENT tLvBatteryType "" ULONG tLvBatteryType 0 0 0 1 /end TYPEDEF_MEASUREMENT
/begin TYPEDEF_MEASUREMENT tPropulsionMode "" ULONG tPropulsionMode 0 0 0 4 /end TYPEDEF_MEASUREMENT
/begin TYPEDEF_MEASUREMENT tNewtonMetre "" FLOAT32_IEEE tNewtonMetre 0 0 -100000 100000 /end TYPEDEF_MEASUREMENT
/begin TYPEDEF_MEASUREMENT uint8_t_0x10 "" UBYTE NO_COMPU_METHOD 0 0 0 1 BIT_MASK 0x10 /end TYPEDEF_MEASUREMENT
/begin TYPEDEF_MEASUREMENT tAdasDriverTakeoverRequest "" ULONG tAdasDriverTakeoverRequest 0 0 0 3 /end TYPEDEF_MEASUREMENT
/begin TYPEDEF_MEASUREMENT tDiagnos "" ULONG tDiagnos 0 0 0 2 /end TYPEDEF_MEASUREMENT
/begin TYPEDEF_MEASUREMENT tBar "" FLOAT32_IEEE tBar 0 0 -1 1000 /end TYPEDEF_MEASUREMENT
/begin TYPEDEF_MEASUREMENT uint8_t_0xF0 "" UBYTE NO_COMPU_METHOD 0 0 0 15 BIT_MASK 0xF0 /end TYPEDEF_MEASUREMENT
/begin TYPEDEF_MEASUREMENT tIceStartCmd "" ULONG tIceStartCmd 0 0 0 2 /end TYPEDEF_MEASUREMENT
/begin TYPEDEF_MEASUREMENT tAdaptiveCruiseControlState "" ULONG tAdaptiveCruiseControlState 0 0 0 8 /end TYPEDEF_MEASUREMENT
/begin TYPEDEF_MEASUREMENT uint8_t_0x80 "" UBYTE NO_COMPU_METHOD 0 0 0 1 BIT_MASK 0x80 /end TYPEDEF_MEASUREMENT
/begin TYPEDEF_MEASUREMENT tShiftRequest "" ULONG tShiftRequest 0 0 0 2 /end TYPEDEF_MEASUREMENT
/begin TYPEDEF_MEASUREMENT tMillivolt_S32 "" SLONG tMillivolt_S32 0 0 0 1000000 /end TYPEDEF_MEASUREMENT
/begin TYPEDEF_MEASUREMENT tDegree "" FLOAT32_IEEE tDegree 0 0 -720 720 /end TYPEDEF_MEASUREMENT
/begin TYPEDEF_MEASUREMENT tHertz "" FLOAT32_IEEE tHertz 0 0 0 30000 /end TYPEDEF_MEASUREMENT
/begin TYPEDEF_MEASUREMENT tAdasDriverTakeoffRequest "" ULONG tAdasDriverTakeoffRequest 0 0 0 2 /end TYPEDEF_MEASUREMENT
/begin TYPEDEF_MEASUREMENT tChargePortStatus "" ULONG tChargePortStatus 0 0 0 3 /end TYPEDEF_MEASUREMENT
/begin TYPEDEF_MEASUREMENT tAccDistanceLevel "" ULONG tAccDistanceLevel 0 0 0 4 /end TYPEDEF_MEASUREMENT
/begin TYPEDEF_MEASUREMENT uint8_t_0xE0 "" UBYTE NO_COMPU_METHOD 0 0 0 7 BIT_MASK 0xE0 /end TYPEDEF_MEASUREMENT
/begin TYPEDEF_MEASUREMENT uint16_t_0x4 "" UWORD NO_COMPU_METHOD 0 0 0 1 BIT_MASK 0x4 /end TYPEDEF_MEASUREMENT
/begin TYPEDEF_MEASUREMENT tPercent_100_S32 "" SLONG tPercent_100_S32 0 0 0.0 100.0 /end TYPEDEF_MEASUREMENT
/begin TYPEDEF_MEASUREMENT tSecond "" FLOAT32_IEEE tSecond 0 0 0 3600 /end TYPEDEF_MEASUREMENT
/begin TYPEDEF_MEASUREMENT tHybSmState "" ULONG tHybSmState 0 0 0 6 /end TYPEDEF_MEASUREMENT
/begin TYPEDEF_MEASUREMENT uint16_t_0x8 "" UWORD NO_COMPU_METHOD 0 0 0 1 BIT_MASK 0x8 /end TYPEDEF_MEASUREMENT
/begin TYPEDEF_MEASUREMENT tQualifier "" ULONG tQualifier 0 0 0 3 /end TYPEDEF_MEASUREMENT
/begin TYPEDEF_MEASUREMENT tTrueVehVelSrc "" ULONG tTrueVehVelSrc 0 0 0 1 /end TYPEDEF_MEASUREMENT
/begin TYPEDEF_MEASUREMENT uint32_t "" ULONG NO_COMPU_METHOD 0 0 0 4294967295 /end TYPEDEF_MEASUREMENT
/begin TYPEDEF_MEASUREMENT tAdaptiveCruiseControlStateRequest "" ULONG tAdaptiveCruiseControlStateRequest 0 0 0 4 /end TYPEDEF_MEASUREMENT
/begin TYPEDEF_MEASUREMENT tOhm "" FLOAT32_IEEE tOhm 0 0 0 2000000 /end TYPEDEF_MEASUREMENT
/begin TYPEDEF_MEASUREMENT tMetreSquared "" FLOAT32_IEEE tMetreSquared 0 0 0 10 /end TYPEDEF_MEASUREMENT
/begin TYPEDEF_MEASUREMENT tBar_100_S16 "" SWORD tBar_100_S16 0 0 -1.0 1000.0 /end TYPEDEF_MEASUREMENT
/begin TYPEDEF_MEASUREMENT tBrakeFluidLevel "" ULONG tBrakeFluidLevel 0 0 0 3 /end TYPEDEF_MEASUREMENT
/begin TYPEDEF_MEASUREMENT tElectricalSystemState "" ULONG tElectricalSystemState 0 0 0 5 /end TYPEDEF_MEASUREMENT
/begin TYPEDEF_MEASUREMENT tLowPassFilterType "" ULONG tLowPassFilterType 0 0 0 1 /end TYPEDEF_MEASUREMENT
/begin TYPEDEF_MEASUREMENT tTpmsWarnLampRsn "" ULONG tTpmsWarnLampRsn 0 0 0 3 /end TYPEDEF_MEASUREMENT
/begin TYPEDEF_MEASUREMENT tCombustionEngineControlState "" ULONG tCombustionEngineControlState 0 0 0 6 /end TYPEDEF_MEASUREMENT
/begin TYPEDEF_MEASUREMENT tEnableState "" ULONG tEnableState 0 0 0 3 /end TYPEDEF_MEASUREMENT
/begin TYPEDEF_MEASUREMENT int16_t "" SWORD NO_COMPU_METHOD 0 0 -32768 32767 /end TYPEDEF_MEASUREMENT
/begin TYPEDEF_MEASUREMENT uint16_t_0x80 "" UWORD NO_COMPU_METHOD 0 0 0 1 BIT_MASK 0x80 /end TYPEDEF_MEASUREMENT
/begin TYPEDEF_MEASUREMENT tTakeoffState "" ULONG tTakeoffState 0 0 0 4 /end TYPEDEF_MEASUREMENT
/begin TYPEDEF_MEASUREMENT uint8_t_0x8 "" UBYTE NO_COMPU_METHOD 0 0 0 1 BIT_MASK 0x8 /end TYPEDEF_MEASUREMENT
/begin TYPEDEF_MEASUREMENT tTorqueRequestTransitionState "" ULONG tTorqueRequestTransitionState 0 0 0 3 /end TYPEDEF_MEASUREMENT
/begin TYPEDEF_MEASUREMENT tSpeedLimiterState "" ULONG tSpeedLimiterState 0 0 0 3 /end TYPEDEF_MEASUREMENT
/begin TYPEDEF_MEASUREMENT uint16_t_0x800 "" UWORD NO_COMPU_METHOD 0 0 0 1 BIT_MASK 0x800 /end TYPEDEF_MEASUREMENT
/begin TYPEDEF_MEASUREMENT uint8_t_0x20 "" UBYTE NO_COMPU_METHOD 0 0 0 1 BIT_MASK 0x20 /end TYPEDEF_MEASUREMENT
/begin TYPEDEF_MEASUREMENT tBMSState "" ULONG tBMSState 0 0 0 6 /end TYPEDEF_MEASUREMENT
/begin TYPEDEF_MEASUREMENT tParkingBrakeRequest "" ULONG tParkingBrakeRequest 0 0 0 2 /end TYPEDEF_MEASUREMENT
/begin TYPEDEF_MEASUREMENT tInvSmStatus "" ULONG tInvSmStatus 0 0 0 5 /end TYPEDEF_MEASUREMENT
/begin TYPEDEF_MEASUREMENT uint16_t_0x40 "" UWORD NO_COMPU_METHOD 0 0 0 1 BIT_MASK 0x40 /end TYPEDEF_MEASUREMENT
/begin TYPEDEF_MEASUREMENT int8_t "" SBYTE NO_COMPU_METHOD 0 0 -128 127 /end TYPEDEF_MEASUREMENT
/begin TYPEDEF_MEASUREMENT tTpmsTirePState "" ULONG tTpmsTirePState 0 0 0 4 /end TYPEDEF_MEASUREMENT
/begin TYPEDEF_MEASUREMENT tVolt "" FLOAT32_IEEE tVolt 0 0 0 1000 /end TYPEDEF_MEASUREMENT
/begin TYPEDEF_MEASUREMENT tTpmsSpdLimHit "" ULONG tTpmsSpdLimHit 0 0 0 2 /end TYPEDEF_MEASUREMENT
/begin TYPEDEF_MEASUREMENT uint8_t_0x1 "" UBYTE NO_COMPU_METHOD 0 0 0 1 BIT_MASK 0x1 /end TYPEDEF_MEASUREMENT
/begin TYPEDEF_MEASUREMENT uint8_t_0x4 "" UBYTE NO_COMPU_METHOD 0 0 0 1 BIT_MASK 0x4 /end TYPEDEF_MEASUREMENT
/begin TYPEDEF_MEASUREMENT tSpdLimRsnIdx "" ULONG tSpdLimRsnIdx 0 0 0 12 /end TYPEDEF_MEASUREMENT
/begin TYPEDEF_MEASUREMENT int32_t "" SLONG NO_COMPU_METHOD 0 0 -2147483648 2147483647 /end TYPEDEF_MEASUREMENT
/begin TYPEDEF_MEASUREMENT tPowerState "" ULONG tPowerState 0 0 0 15 /end TYPEDEF_MEASUREMENT
/begin TYPEDEF_MEASUREMENT uint16_t_0x400 "" UWORD NO_COMPU_METHOD 0 0 0 1 BIT_MASK 0x400 /end TYPEDEF_MEASUREMENT
/begin TYPEDEF_MEASUREMENT _float "" FLOAT32_IEEE NO_COMPU_METHOD 0 0 -3.40282346639E+38 3.40282346639E+38 /end TYPEDEF_MEASUREMENT
/begin TYPEDEF_MEASUREMENT tPaddleComb "" ULONG tPaddleComb 0 0 0 4 /end TYPEDEF_MEASUREMENT
/begin TYPEDEF_MEASUREMENT uint8_t "" UBYTE NO_COMPU_METHOD 0 0 0 255 /end TYPEDEF_MEASUREMENT
/begin TYPEDEF_MEASUREMENT tKilometrePerHour "" FLOAT32_IEEE tKilometrePerHour 0 0 -600 600 /end TYPEDEF_MEASUREMENT
/begin TYPEDEF_MEASUREMENT tRadian "" FLOAT32_IEEE tRadian 0 0 -20 20 /end TYPEDEF_MEASUREMENT
/begin TYPEDEF_MEASUREMENT tAutomatedDriverControlState "" ULONG tAutomatedDriverControlState 0 0 0 5 /end TYPEDEF_MEASUREMENT
/begin TYPEDEF_MEASUREMENT tAmpere "" FLOAT32_IEEE tAmpere 0 0 0 10000 /end TYPEDEF_MEASUREMENT
/begin TYPEDEF_MEASUREMENT tCelsius "" FLOAT32_IEEE tCelsius 0 0 -400 10000 /end TYPEDEF_MEASUREMENT
/begin TYPEDEF_MEASUREMENT tKilogramPerCubeMetre "" FLOAT32_IEEE tKilogramPerCubeMetre 0 0 0 10 /end TYPEDEF_MEASUREMENT
/begin TYPEDEF_MEASUREMENT tNewtonMetre_100_S32 "" SLONG tNewtonMetre_100_S32 0 0 -100000.0 100000.0 /end TYPEDEF_MEASUREMENT
/begin TYPEDEF_MEASUREMENT uint16_t_0x1 "" UWORD NO_COMPU_METHOD 0 0 0 1 BIT_MASK 0x1 /end TYPEDEF_MEASUREMENT
/begin TYPEDEF_MEASUREMENT tPerformanceMode "" ULONG tPerformanceMode 0 0 0 7 /end TYPEDEF_MEASUREMENT
/begin TYPEDEF_MEASUREMENT tKilogram "" FLOAT32_IEEE tKilogram 0 0 0 10000 /end TYPEDEF_MEASUREMENT
/begin TYPEDEF_MEASUREMENT tLvBatteryStatus "" ULONG tLvBatteryStatus 0 0 0 3 /end TYPEDEF_MEASUREMENT
/begin TYPEDEF_MEASUREMENT tAvasMod "" ULONG tAvasMod 0 0 0 3 /end TYPEDEF_MEASUREMENT
/begin TYPEDEF_MEASUREMENT tBar_1000_S16 "" SWORD tBar_1000_S16 0 0 -0.1 100.0 /end TYPEDEF_MEASUREMENT
/begin TYPEDEF_MEASUREMENT tRevolutionPerMinute_S16 "" SWORD tRevolutionPerMinute_S16 0 0 -32768 32767 /end TYPEDEF_MEASUREMENT
/begin TYPEDEF_MEASUREMENT tAscii "" UBYTE tAscii 0 0 0 255 /end TYPEDEF_MEASUREMENT
/begin TYPEDEF_MEASUREMENT tIntegratorState "" ULONG tIntegratorState 0 0 0 4 /end TYPEDEF_MEASUREMENT
/begin TYPEDEF_MEASUREMENT tKilowattHour "" FLOAT32_IEEE tKilowattHour 0 0 -10000 10000 /end TYPEDEF_MEASUREMENT
/begin TYPEDEF_MEASUREMENT tAccActuatorResponse "" ULONG tAccActuatorResponse 0 0 0 5 /end TYPEDEF_MEASUREMENT
/begin TYPEDEF_MEASUREMENT uint8_t_0xC0 "" UBYTE NO_COMPU_METHOD 0 0 0 3 BIT_MASK 0xC0 /end TYPEDEF_MEASUREMENT
/begin TYPEDEF_MEASUREMENT tMetrePerSquareSecond "" FLOAT32_IEEE tMetrePerSquareSecond 0 0 -50 50 /end TYPEDEF_MEASUREMENT
/begin TYPEDEF_MEASUREMENT tDegreePerSecond "" FLOAT32_IEEE tDegreePerSecond 0 0 -50000 50000 /end TYPEDEF_MEASUREMENT
/begin TYPEDEF_MEASUREMENT uint16_t_0x10 "" UWORD NO_COMPU_METHOD 0 0 0 1 BIT_MASK 0x10 /end TYPEDEF_MEASUREMENT
/begin TYPEDEF_MEASUREMENT tSensorState "" ULONG tSensorState 0 0 0 5 /end TYPEDEF_MEASUREMENT
/begin TYPEDEF_MEASUREMENT tKilowatt "" FLOAT32_IEEE tKilowatt 0 0 -10000 10000 /end TYPEDEF_MEASUREMENT
/begin TYPEDEF_MEASUREMENT tMillisecond_U32 "" ULONG tMillisecond_U32 0 0 0 3600000 /end TYPEDEF_MEASUREMENT
/begin TYPEDEF_MEASUREMENT uint16_t_0x20 "" UWORD NO_COMPU_METHOD 0 0 0 1 BIT_MASK 0x20 /end TYPEDEF_MEASUREMENT
/begin TYPEDEF_MEASUREMENT tRadianPerSquareSecond "" FLOAT32_IEEE tRadianPerSquareSecond 0 0 -100000 100000 /end TYPEDEF_MEASUREMENT
/begin TYPEDEF_MEASUREMENT tKilometrePerHour_10_S16 "" SWORD tKilometrePerHour_10_S16 0 0 -600.0 600.0 /end TYPEDEF_MEASUREMENT
/begin TYPEDEF_MEASUREMENT uint64_t_0x80 "" A_UINT64 NO_COMPU_METHOD 0 0 0 1 BIT_MASK 0x80 /end TYPEDEF_MEASUREMENT
/begin TYPEDEF_MEASUREMENT tKilometrePerHour_10_S32 "" SLONG tKilometrePerHour_10_S32 0 0 -600.0 600.0 /end TYPEDEF_MEASUREMENT
/begin TYPEDEF_MEASUREMENT uint16_t_0x200 "" UWORD NO_COMPU_METHOD 0 0 0 1 BIT_MASK 0x200 /end TYPEDEF_MEASUREMENT
/begin TYPEDEF_MEASUREMENT tPercent_100_S16 "" SWORD tPercent_100_S16 0 0 0.0 100.0 /end TYPEDEF_MEASUREMENT
/begin TYPEDEF_MEASUREMENT tFactor "" FLOAT32_IEEE tFactor 0 0 -3.40282346639E+38 3.40282346639E+38 /end TYPEDEF_MEASUREMENT
/begin TYPEDEF_MEASUREMENT tTireModel "" ULONG tTireModel 0 0 0 4 /end TYPEDEF_MEASUREMENT
/begin TYPEDEF_MEASUREMENT tMetre "" FLOAT32_IEEE tMetre 0 0 -1000 1000 /end TYPEDEF_MEASUREMENT
/begin TYPEDEF_MEASUREMENT uint16_t_0x1000 "" UWORD NO_COMPU_METHOD 0 0 0 1 BIT_MASK 0x1000 /end TYPEDEF_MEASUREMENT
/begin TYPEDEF_MEASUREMENT tCelsius_10_S16 "" SWORD tCelsius_10_S16 0 0 -400.0 10000.0 /end TYPEDEF_MEASUREMENT
/begin TYPEDEF_MEASUREMENT tHybMod "" ULONG tHybMod 0 0 0 2 /end TYPEDEF_MEASUREMENT
/begin TYPEDEF_MEASUREMENT tEBrakeState "" ULONG tEBrakeState 0 0 0 5 /end TYPEDEF_MEASUREMENT
/begin TYPEDEF_MEASUREMENT tDriveMode "" ULONG tDriveMode 0 0 0 5 /end TYPEDEF_MEASUREMENT
/begin TYPEDEF_MEASUREMENT tTle92464ChannelType "" ULONG tTle92464ChannelType 0 0 0 4 /end TYPEDEF_MEASUREMENT
/begin TYPEDEF_MEASUREMENT uint16_t_0x2 "" UWORD NO_COMPU_METHOD 0 0 0 1 BIT_MASK 0x2 /end TYPEDEF_MEASUREMENT
/begin TYPEDEF_MEASUREMENT tOdoSyncSt "" ULONG tOdoSyncSt 0 0 0 3 /end TYPEDEF_MEASUREMENT
/begin TYPEDEF_MEASUREMENT tOdeStatus "" ULONG tOdeStatus 0 0 0 2 /end TYPEDEF_MEASUREMENT
/begin TYPEDEF_MEASUREMENT uint8_t_0xFC "" UBYTE NO_COMPU_METHOD 0 0 0 63 BIT_MASK 0xFC /end TYPEDEF_MEASUREMENT
/begin TYPEDEF_MEASUREMENT tAdasRequest "" ULONG tAdasRequest 0 0 0 2 /end TYPEDEF_MEASUREMENT
/begin TYPEDEF_MEASUREMENT tNewton "" FLOAT32_IEEE tNewton 0 0 -100000 100000 /end TYPEDEF_MEASUREMENT
/begin TYPEDEF_MEASUREMENT tCelsius_100_S16 "" SWORD tCelsius_100_S16 0 0 -4000.0 100000.0 /end TYPEDEF_MEASUREMENT
/begin TYPEDEF_MEASUREMENT tWatt "" FLOAT32_IEEE tWatt 0 0 -3.40282346639E+38 3.40282346639E+38 /end TYPEDEF_MEASUREMENT
/begin TYPEDEF_MEASUREMENT tAccStationaryRequest "" ULONG tAccStationaryRequest 0 0 0 2 /end TYPEDEF_MEASUREMENT
/begin TYPEDEF_MEASUREMENT _Bool "" UBYTE NO_COMPU_METHOD 0 0 0 1 /end TYPEDEF_MEASUREMENT
/begin TYPEDEF_MEASUREMENT uint8_t_0x40 "" UBYTE NO_COMPU_METHOD 0 0 0 1 BIT_MASK 0x40 /end TYPEDEF_MEASUREMENT
/begin TYPEDEF_MEASUREMENT tEngineRunning "" ULONG tEngineRunning 0 0 0 3 /end TYPEDEF_MEASUREMENT
/begin TYPEDEF_MEASUREMENT tMetrePerSecond "" FLOAT32_IEEE tMetrePerSecond 0 0 -200 200 /end TYPEDEF_MEASUREMENT
/begin TYPEDEF_MEASUREMENT tPerformanceStrategy "" ULONG tPerformanceStrategy 0 0 0 3 /end TYPEDEF_MEASUREMENT
/begin TYPEDEF_MEASUREMENT tVsoVehicleMotionObserverSwt "" ULONG tVsoVehicleMotionObserverSwt 0 0 0 4 /end TYPEDEF_MEASUREMENT
/begin TYPEDEF_MEASUREMENT tRollingState "" ULONG tRollingState 0 0 0 4 /end TYPEDEF_MEASUREMENT
/begin TYPEDEF_MEASUREMENT tKilometre "" FLOAT32_IEEE tKilometre 0 0 0 2147483 /end TYPEDEF_MEASUREMENT
/begin TYPEDEF_MEASUREMENT tTpmsWarnLamp "" ULONG tTpmsWarnLamp 0 0 0 3 /end TYPEDEF_MEASUREMENT
/begin TYPEDEF_MEASUREMENT tTqMacSt "" ULONG tTqMacSt 0 0 0 20 /end TYPEDEF_MEASUREMENT
/begin TYPEDEF_MEASUREMENT tPascal "" FLOAT32_IEEE tPascal 0 0 -100000 100000000 /end TYPEDEF_MEASUREMENT
/begin TYPEDEF_MEASUREMENT uint16_t "" UWORD NO_COMPU_METHOD 0 0 0 65535 /end TYPEDEF_MEASUREMENT
/begin TYPEDEF_MEASUREMENT tMillivolt_S16 "" SWORD tMillivolt_S16 0 0 0 10000 /end TYPEDEF_MEASUREMENT
/begin TYPEDEF_MEASUREMENT uint16_t_0x100 "" UWORD NO_COMPU_METHOD 0 0 0 1 BIT_MASK 0x100 /end TYPEDEF_MEASUREMENT
/begin TYPEDEF_STRUCTURE TaskHmi "" 0x8 SYMBOL_TYPE_LINK "TaskHmi" /begin STRUCTURE_COMPONENT hmiLocals tHmiLocals 4 SYMBOL_TYPE_LINK "hmiLocals" /end STRUCTURE_COMPONENT /end TYPEDEF_STRUCTURE
/begin TYPEDEF_STRUCTURE TaskHybridSm "" 0x48 SYMBOL_TYPE_LINK "TaskHybridSm" /begin STRUCTURE_COMPONENT libHybridSm LibHybridSm 0 SYMBOL_TYPE_LINK "libHybridSm" /end STRUCTURE_COMPONENT /end TYPEDEF_STRUCTURE
/begin TYPEDEF_STRUCTURE TaskDynamicsHomlnSfty "" 0x164 SYMBOL_TYPE_LINK "TaskDynamicsHomlnSfty"
 /begin STRUCTURE_COMPONENT homlnSftyLocals HomologationSafetyLocals 4 SYMBOL_TYPE_LINK "homlnSftyLocals" /end STRUCTURE_COMPONENT
/end TYPEDEF_STRUCTURE
/begin TYPEDEF_STRUCTURE TaskDynamicsVso "" 0xB40 SYMBOL_TYPE_LINK "TaskDynamicsVso" /begin STRUCTURE_COMPONENT stepSize tSecond 4 SYMBOL_TYPE_LINK "stepSize" /end STRUCTURE_COMPONENT
 /begin STRUCTURE_COMPONENT vsoMgrLocals VsoManagerLocals 8 SYMBOL_TYPE_LINK "vsoMgrLocals" /end STRUCTURE_COMPONENT
/end TYPEDEF_STRUCTURE
/begin TYPEDEF_STRUCTURE TaskDynamicsDtr "" 0x5D4 SYMBOL_TYPE_LINK "TaskDynamicsDtr" /begin STRUCTURE_COMPONENT stepSize tSecond 4 SYMBOL_TYPE_LINK "stepSize" /end STRUCTURE_COMPONENT
 /begin STRUCTURE_COMPONENT dtrLocals DriverTorqueReqLocals 8 SYMBOL_TYPE_LINK "dtrLocals" /end STRUCTURE_COMPONENT
/end TYPEDEF_STRUCTURE
/begin TYPEDEF_STRUCTURE TaskHwio100ms "" 0xB4 SYMBOL_TYPE_LINK "TaskHwio100ms"
 /begin STRUCTURE_COMPONENT cooltSnrsLocals CooltSnrsLocals 4 SYMBOL_TYPE_LINK "cooltSnrsLocals" /end STRUCTURE_COMPONENT
 /begin STRUCTURE_COMPONENT brkFldLocals tBrkFldLocals 152 SYMBOL_TYPE_LINK "brkFldLocals" /end STRUCTURE_COMPONENT
/end TYPEDEF_STRUCTURE
/begin TYPEDEF_STRUCTURE TaskHybridTorque "" 0xE0 SYMBOL_TYPE_LINK "TaskHybridTorque"
 /begin STRUCTURE_COMPONENT libHybridTorque LibHybridTorque 0 SYMBOL_TYPE_LINK "libHybridTorque" /end STRUCTURE_COMPONENT
/end TYPEDEF_STRUCTURE
/begin TYPEDEF_STRUCTURE VsoManagerLocals "" 0xB38 SYMBOL_TYPE_LINK "VsoManagerLocals" /begin STRUCTURE_COMPONENT initDone _Bool 0 SYMBOL_TYPE_LINK "initDone" /end STRUCTURE_COMPONENT
 /begin STRUCTURE_COMPONENT vsoEnvLocals VsoEnvLocals 4 SYMBOL_TYPE_LINK "vsoEnvLocals" /end STRUCTURE_COMPONENT
 /begin STRUCTURE_COMPONENT vsoWheelTorquesLocals VsoWheelTorquesLocals 24 SYMBOL_TYPE_LINK "vsoWheelTorquesLocals" /end STRUCTURE_COMPONENT
 /begin STRUCTURE_COMPONENT vsoVehAnglesLocals VsoVehAnglesLocals 160 SYMBOL_TYPE_LINK "vsoVehAnglesLocals" /end STRUCTURE_COMPONENT
 /begin STRUCTURE_COMPONENT vsoImuLocals VsoImuLocals 264 SYMBOL_TYPE_LINK "vsoImuLocals" /end STRUCTURE_COMPONENT
 /begin STRUCTURE_COMPONENT vsoRollingDirectionLocals VsoRollingDirectionLocals 1012 SYMBOL_TYPE_LINK "vsoRollingDirectionLocals" /end STRUCTURE_COMPONENT
 /begin STRUCTURE_COMPONENT vsoMassEstLocals VsoMassEstLocals 1036 SYMBOL_TYPE_LINK "vsoMassEstLocals" /end STRUCTURE_COMPONENT
 /begin STRUCTURE_COMPONENT vsoWheelAnglesLocals VsoWheelAnglesLocals 1056 SYMBOL_TYPE_LINK "vsoWheelAnglesLocals" /end STRUCTURE_COMPONENT
 /begin STRUCTURE_COMPONENT vsoWheelLoadsLocals VsoWheelLoadsLocals 1100 SYMBOL_TYPE_LINK "vsoWheelLoadsLocals" /end STRUCTURE_COMPONENT
 /begin STRUCTURE_COMPONENT vsoTireRdLocals VsoTireRdLocals 1328 SYMBOL_TYPE_LINK "vsoTireRdLocals" /end STRUCTURE_COMPONENT
 /begin STRUCTURE_COMPONENT vsoWhlbasedVehSpdLocals VsoWhlbasedVehSpdLocals 1404 SYMBOL_TYPE_LINK "vsoWhlbasedVehSpdLocals" /end STRUCTURE_COMPONENT
 /begin STRUCTURE_COMPONENT vsoVehMtnObsvrLocals VsoVehMtnObsvrLocals 1716 SYMBOL_TYPE_LINK "vsoVehMtnObsvrLocals" /end STRUCTURE_COMPONENT
 /begin STRUCTURE_COMPONENT vsoTireModelLocals VsoTireModelLocals 2224 SYMBOL_TYPE_LINK "vsoTireModelLocals" /end STRUCTURE_COMPONENT
 /begin STRUCTURE_COMPONENT vsoVehDragLossLocals VsoVehDragLossLocals 2804 SYMBOL_TYPE_LINK "vsoVehDragLossLocals" /end STRUCTURE_COMPONENT
 /begin STRUCTURE_COMPONENT vsoSteerOut VsoSteerOutp 2852 SYMBOL_TYPE_LINK "vsoSteerOut" /end STRUCTURE_COMPONENT
 /begin STRUCTURE_COMPONENT vsoSteerLocals VsoSteerLocals 2864 SYMBOL_TYPE_LINK "vsoSteerLocals" /end STRUCTURE_COMPONENT
/end TYPEDEF_STRUCTURE
/begin TYPEDEF_STRUCTURE TaskEnergyManager "" 0x220 SYMBOL_TYPE_LINK "TaskEnergyManager" /begin STRUCTURE_COMPONENT inp EnergyInp 0 SYMBOL_TYPE_LINK "inp" /end STRUCTURE_COMPONENT /begin STRUCTURE_COMPONENT locals EnergyLocals 172 SYMBOL_TYPE_LINK "locals" /end STRUCTURE_COMPONENT /begin STRUCTURE_COMPONENT out EnergyOutp 488 SYMBOL_TYPE_LINK "out" /end STRUCTURE_COMPONENT /end TYPEDEF_STRUCTURE
/begin TYPEDEF_STRUCTURE VsoMassEstLocals "" 0x14 SYMBOL_TYPE_LINK "VsoMassEstLocals" /begin STRUCTURE_COMPONENT initDone _Bool 0 SYMBOL_TYPE_LINK "initDone" /end STRUCTURE_COMPONENT /begin STRUCTURE_COMPONENT vehMass tKilogram 4 SYMBOL_TYPE_LINK "vehMass" /end STRUCTURE_COMPONENT
 /begin STRUCTURE_COMPONENT vehMassOpenLoop tKilogram 8 SYMBOL_TYPE_LINK "vehMassOpenLoop" /end STRUCTURE_COMPONENT
 /begin STRUCTURE_COMPONENT vehMassStaticCorrection tKilogram 12 SYMBOL_TYPE_LINK "vehMassStaticCorrection" /end STRUCTURE_COMPONENT
 /begin STRUCTURE_COMPONENT vehMassQ tQualifier 16 SYMBOL_TYPE_LINK "vehMassQ" /end STRUCTURE_COMPONENT
/end TYPEDEF_STRUCTURE
/begin TYPEDEF_STRUCTURE VsoWheelLoadsLocals "" 0xE4 SYMBOL_TYPE_LINK "VsoWheelLoadsLocals" /begin STRUCTURE_COMPONENT initDone _Bool 0 SYMBOL_TYPE_LINK "initDone" /end STRUCTURE_COMPONENT /begin STRUCTURE_COMPONENT frntRollAxis tMetre 4 SYMBOL_TYPE_LINK "frntRollAxis" /end STRUCTURE_COMPONENT /begin STRUCTURE_COMPONENT reRollAxis tMetre 8 SYMBOL_TYPE_LINK "reRollAxis" /end STRUCTURE_COMPONENT
 /begin STRUCTURE_COMPONENT antiBrkForceAtWhl tNewton 12 MATRIX_DIM 4 SYMBOL_TYPE_LINK "antiBrkForceAtWhl" /end STRUCTURE_COMPONENT
 /begin STRUCTURE_COMPONENT antiDrvForceAtWhl tNewton 28 MATRIX_DIM 4 SYMBOL_TYPE_LINK "antiDrvForceAtWhl" /end STRUCTURE_COMPONENT
 /begin STRUCTURE_COMPONENT damprForce tNewton 44 MATRIX_DIM 4 SYMBOL_TYPE_LINK "damprForce" /end STRUCTURE_COMPONENT
 /begin STRUCTURE_COMPONENT damprForceAtWhl tNewton 60 MATRIX_DIM 4 SYMBOL_TYPE_LINK "damprForceAtWhl" /end STRUCTURE_COMPONENT
 /begin STRUCTURE_COMPONENT frntArbForceAtWhl tNewton 76 SYMBOL_TYPE_LINK "frntArbForceAtWhl" /end STRUCTURE_COMPONENT
 /begin STRUCTURE_COMPONENT latForce tNewton 80 SYMBOL_TYPE_LINK "latForce" /end STRUCTURE_COMPONENT
 /begin STRUCTURE_COMPONENT latForceAtWhl tNewton 84 MATRIX_DIM 4 SYMBOL_TYPE_LINK "latForceAtWhl" /end STRUCTURE_COMPONENT
 /begin STRUCTURE_COMPONENT latForceFrnt tNewton 100 SYMBOL_TYPE_LINK "latForceFrnt" /end STRUCTURE_COMPONENT
 /begin STRUCTURE_COMPONENT latForceRe tNewton 104 SYMBOL_TYPE_LINK "latForceRe" /end STRUCTURE_COMPONENT
 /begin STRUCTURE_COMPONENT reArbForceAtWhl tNewton 108 SYMBOL_TYPE_LINK "reArbForceAtWhl" /end STRUCTURE_COMPONENT
 /begin STRUCTURE_COMPONENT sprgForce tNewton 112 MATRIX_DIM 4 SYMBOL_TYPE_LINK "sprgForce" /end STRUCTURE_COMPONENT
 /begin STRUCTURE_COMPONENT sprgForceAtWhl tNewton 128 MATRIX_DIM 4 SYMBOL_TYPE_LINK "sprgForceAtWhl" /end STRUCTURE_COMPONENT
 /begin STRUCTURE_COMPONENT suspForceAtWhl tNewton 144 MATRIX_DIM 4 SYMBOL_TYPE_LINK "suspForceAtWhl" /end STRUCTURE_COMPONENT
 /begin STRUCTURE_COMPONENT whlNormLoad tNewton 160 MATRIX_DIM 4 SYMBOL_TYPE_LINK "whlNormLoad" /end STRUCTURE_COMPONENT
 /begin STRUCTURE_COMPONENT latYawTq tNewtonMetre 176 SYMBOL_TYPE_LINK "latYawTq" /end STRUCTURE_COMPONENT
 /begin STRUCTURE_COMPONENT vehYawTqFromWhls tNewtonMetre 180 SYMBOL_TYPE_LINK "vehYawTqFromWhls" /end STRUCTURE_COMPONENT
 /begin STRUCTURE_COMPONENT vehYawTqFromWhlsQ tQualifier 184 SYMBOL_TYPE_LINK "vehYawTqFromWhlsQ" /end STRUCTURE_COMPONENT
 /begin STRUCTURE_COMPONENT whlNormLoadQ tQualifier 188 MATRIX_DIM 4 SYMBOL_TYPE_LINK "whlNormLoadQ" /end STRUCTURE_COMPONENT
 /begin STRUCTURE_COMPONENT frntAntiBrkAg tRadian 204 SYMBOL_TYPE_LINK "frntAntiBrkAg" /end STRUCTURE_COMPONENT
 /begin STRUCTURE_COMPONENT frntAntiDrvAg tRadian 208 SYMBOL_TYPE_LINK "frntAntiDrvAg" /end STRUCTURE_COMPONENT
 /begin STRUCTURE_COMPONENT frntRollAg tRadian 212 SYMBOL_TYPE_LINK "frntRollAg" /end STRUCTURE_COMPONENT
 /begin STRUCTURE_COMPONENT reAntiBrkAg tRadian 216 SYMBOL_TYPE_LINK "reAntiBrkAg" /end STRUCTURE_COMPONENT
 /begin STRUCTURE_COMPONENT reAntiDrvAg tRadian 220 SYMBOL_TYPE_LINK "reAntiDrvAg" /end STRUCTURE_COMPONENT
 /begin STRUCTURE_COMPONENT reRollAg tRadian 224 SYMBOL_TYPE_LINK "reRollAg" /end STRUCTURE_COMPONENT
/end TYPEDEF_STRUCTURE
/begin TYPEDEF_STRUCTURE VsoVehDragLossLocals "" 0x30 SYMBOL_TYPE_LINK "VsoVehDragLossLocals" /begin STRUCTURE_COMPONENT initDone _Bool 0 SYMBOL_TYPE_LINK "initDone" /end STRUCTURE_COMPONENT
 /begin STRUCTURE_COMPONENT coastDwnDrgPolyCoeffArr tFactor 4 MATRIX_DIM 3 SYMBOL_TYPE_LINK "coastDwnDrgPolyCoeffArr" /end STRUCTURE_COMPONENT
 /begin STRUCTURE_COMPONENT aeroEfcDrgAr tMetreSquared 16 SYMBOL_TYPE_LINK "aeroEfcDrgAr" /end STRUCTURE_COMPONENT
 /begin STRUCTURE_COMPONENT aeroDrgWhlTq tNewtonMetre 20 SYMBOL_TYPE_LINK "aeroDrgWhlTq" /end STRUCTURE_COMPONENT
 /begin STRUCTURE_COMPONENT coastDownDrgWhlTq tNewtonMetre 24 SYMBOL_TYPE_LINK "coastDownDrgWhlTq" /end STRUCTURE_COMPONENT
 /begin STRUCTURE_COMPONENT drvgDtLossPropshTqTot tNewtonMetre 28 SYMBOL_TYPE_LINK "drvgDtLossPropshTqTot" /end STRUCTURE_COMPONENT
 /begin STRUCTURE_COMPONENT frntDtLossPropshTq tNewtonMetre 32 SYMBOL_TYPE_LINK "frntDtLossPropshTq" /end STRUCTURE_COMPONENT
 /begin STRUCTURE_COMPONENT rearDtLossPropshTq tNewtonMetre 36 SYMBOL_TYPE_LINK "rearDtLossPropshTq" /end STRUCTURE_COMPONENT
 /begin STRUCTURE_COMPONENT roadGrdtResWhlTq tNewtonMetre 40 SYMBOL_TYPE_LINK "roadGrdtResWhlTq" /end STRUCTURE_COMPONENT
 /begin STRUCTURE_COMPONENT rollgResWhlTq tNewtonMetre 44 SYMBOL_TYPE_LINK "rollgResWhlTq" /end STRUCTURE_COMPONENT
/end TYPEDEF_STRUCTURE
/begin TYPEDEF_STRUCTURE TaskHwioSolndrv "" 0x12C SYMBOL_TYPE_LINK "TaskHwioSolndrv"
 /begin STRUCTURE_COMPONENT solnDrvrLocals SolnDrvrLocals 4 SYMBOL_TYPE_LINK "solnDrvrLocals" /end STRUCTURE_COMPONENT
/end TYPEDEF_STRUCTURE
/begin TYPEDEF_STRUCTURE TaskHwio1ms "" 0x374 SYMBOL_TYPE_LINK "TaskHwio1ms"
 /begin STRUCTURE_COMPONENT pedalLogicLocals PedalLogicLocals 4 SYMBOL_TYPE_LINK "pedalLogicLocals" /end STRUCTURE_COMPONENT
 /begin STRUCTURE_COMPONENT spdSnsrLocals SpdSnsrLocals 80 SYMBOL_TYPE_LINK "spdSnsrLocals" /end STRUCTURE_COMPONENT
 /begin STRUCTURE_COMPONENT pSnrsLocals PSnrsLocals 700 SYMBOL_TYPE_LINK "pSnrsLocals" /end STRUCTURE_COMPONENT
 /begin STRUCTURE_COMPONENT eBrakeLocals EBrakeLocals 804 SYMBOL_TYPE_LINK "eBrakeLocals" /end STRUCTURE_COMPONENT
 /begin STRUCTURE_COMPONENT kl30Voltage tVolt 876 SYMBOL_TYPE_LINK "kl30Voltage" /end STRUCTURE_COMPONENT
 /begin STRUCTURE_COMPONENT lvBatteryStatus tLvBatteryStatus 880 SYMBOL_TYPE_LINK "lvBatteryStatus" /end STRUCTURE_COMPONENT
/end TYPEDEF_STRUCTURE
/begin TYPEDEF_STRUCTURE tHmiLocals "" 0x4 SYMBOL_TYPE_LINK "tHmiLocals" /begin STRUCTURE_COMPONENT combdPwr tKilowatt 0 SYMBOL_TYPE_LINK "combdPwr" /end STRUCTURE_COMPONENT /end TYPEDEF_STRUCTURE
/begin TYPEDEF_STRUCTURE VsoVehAnglesLocals "" 0x68 SYMBOL_TYPE_LINK "VsoVehAnglesLocals" /begin STRUCTURE_COMPONENT initDone _Bool 0 SYMBOL_TYPE_LINK "initDone" /end STRUCTURE_COMPONENT
 /begin STRUCTURE_COMPONENT vehPitchAgDeg tDegree_10_S16 2 SYMBOL_TYPE_LINK "vehPitchAgDeg" /end STRUCTURE_COMPONENT
 /begin STRUCTURE_COMPONENT vehRollAgDeg tDegree_10_S16 4 SYMBOL_TYPE_LINK "vehRollAgDeg" /end STRUCTURE_COMPONENT
 /begin STRUCTURE_COMPONENT pitchAgKalmanCtx KalmanFilter1DCtx 8 SYMBOL_TYPE_LINK "pitchAgKalmanCtx" /end STRUCTURE_COMPONENT
 /begin STRUCTURE_COMPONENT rollAgKalmanCtx KalmanFilter1DCtx 44 SYMBOL_TYPE_LINK "rollAgKalmanCtx" /end STRUCTURE_COMPONENT
 /begin STRUCTURE_COMPONENT vehPitchAgQ tQualifier 80 SYMBOL_TYPE_LINK "vehPitchAgQ" /end STRUCTURE_COMPONENT
 /begin STRUCTURE_COMPONENT vehRollAgQ tQualifier 84 SYMBOL_TYPE_LINK "vehRollAgQ" /end STRUCTURE_COMPONENT
 /begin STRUCTURE_COMPONENT pitchAg tRadian 88 SYMBOL_TYPE_LINK "pitchAg" /end STRUCTURE_COMPONENT
 /begin STRUCTURE_COMPONENT rollAg tRadian 92 SYMBOL_TYPE_LINK "rollAg" /end STRUCTURE_COMPONENT
 /begin STRUCTURE_COMPONENT vehPitchAg tRadian 96 SYMBOL_TYPE_LINK "vehPitchAg" /end STRUCTURE_COMPONENT
 /begin STRUCTURE_COMPONENT vehRollAg tRadian 100 SYMBOL_TYPE_LINK "vehRollAg" /end STRUCTURE_COMPONENT
/end TYPEDEF_STRUCTURE
/begin TYPEDEF_STRUCTURE VsoTireModelLocals "" 0x244 SYMBOL_TYPE_LINK "VsoTireModelLocals" /begin STRUCTURE_COMPONENT initDone _Bool 0 SYMBOL_TYPE_LINK "initDone" /end STRUCTURE_COMPONENT
 /begin STRUCTURE_COMPONENT tireLatSlipStfn _float 4 MATRIX_DIM 4 SYMBOL_TYPE_LINK "tireLatSlipStfn" /end STRUCTURE_COMPONENT
 /begin STRUCTURE_COMPONENT tireLgtSlipStfn _float 20 MATRIX_DIM 4 SYMBOL_TYPE_LINK "tireLgtSlipStfn" /end STRUCTURE_COMPONENT
 /begin STRUCTURE_COMPONENT tirePureLatSlipStfn _float 36 MATRIX_DIM 4 SYMBOL_TYPE_LINK "tirePureLatSlipStfn" /end STRUCTURE_COMPONENT
 /begin STRUCTURE_COMPONENT tirePureLgtSlipStfn _float 52 MATRIX_DIM 4 SYMBOL_TYPE_LINK "tirePureLgtSlipStfn" /end STRUCTURE_COMPONENT
 /begin STRUCTURE_COMPONENT tireRoadFricCoeff tFactor 68 MATRIX_DIM 4 SYMBOL_TYPE_LINK "tireRoadFricCoeff" /end STRUCTURE_COMPONENT
 /begin STRUCTURE_COMPONENT tireFricCoeffLat tFactor 84 MATRIX_DIM 4 SYMBOL_TYPE_LINK "tireFricCoeffLat" /end STRUCTURE_COMPONENT
 /begin STRUCTURE_COMPONENT tireFricCoeffLgt tFactor 100 MATRIX_DIM 4 SYMBOL_TYPE_LINK "tireFricCoeffLgt" /end STRUCTURE_COMPONENT
 /begin STRUCTURE_COMPONENT tireMaxLatFRednFac tFactor 116 MATRIX_DIM 4 SYMBOL_TYPE_LINK "tireMaxLatFRednFac" /end STRUCTURE_COMPONENT
 /begin STRUCTURE_COMPONENT tireMaxLgtFRednFac tFactor 132 MATRIX_DIM 4 SYMBOL_TYPE_LINK "tireMaxLgtFRednFac" /end STRUCTURE_COMPONENT
 /begin STRUCTURE_COMPONENT tireMaxLgtSlip tFactor 148 MATRIX_DIM 4 SYMBOL_TYPE_LINK "tireMaxLgtSlip" /end STRUCTURE_COMPONENT
 /begin STRUCTURE_COMPONENT tireMaxLatF tNewton 164 MATRIX_DIM 4 SYMBOL_TYPE_LINK "tireMaxLatF" /end STRUCTURE_COMPONENT
 /begin STRUCTURE_COMPONENT tireMaxLatFPure tNewton 180 MATRIX_DIM 4 SYMBOL_TYPE_LINK "tireMaxLatFPure" /end STRUCTURE_COMPONENT
 /begin STRUCTURE_COMPONENT tireMaxLgtF tNewton 196 MATRIX_DIM 4 SYMBOL_TYPE_LINK "tireMaxLgtF" /end STRUCTURE_COMPONENT
 /begin STRUCTURE_COMPONENT tireMaxLgtFPure tNewton 212 MATRIX_DIM 4 SYMBOL_TYPE_LINK "tireMaxLgtFPure" /end STRUCTURE_COMPONENT
 /begin STRUCTURE_COMPONENT tireMaxLatSlip tRadian 228 MATRIX_DIM 4 SYMBOL_TYPE_LINK "tireMaxLatSlip" /end STRUCTURE_COMPONENT
 /begin STRUCTURE_COMPONENT tireMdlParam TireMdlPacejkaParam 244 MATRIX_DIM 4 SYMBOL_TYPE_LINK "tireMdlParam" /end STRUCTURE_COMPONENT
/end TYPEDEF_STRUCTURE
/begin TYPEDEF_STRUCTURE _unnamed_structure_00 "" 0x1 SYMBOL_TYPE_LINK "_unnamed_structure_00" /begin STRUCTURE_COMPONENT _bit_fill_ uint8_t_0xF8 0 SYMBOL_TYPE_LINK "_bit_fill_" /end STRUCTURE_COMPONENT
 /begin STRUCTURE_COMPONENT BrkLvlCircHigh uint8_t_0x4 0 SYMBOL_TYPE_LINK "BrkLvlCircHigh" /end STRUCTURE_COMPONENT
 /begin STRUCTURE_COMPONENT BrkLvlCircLow uint8_t_0x2 0 SYMBOL_TYPE_LINK "BrkLvlCircLow" /end STRUCTURE_COMPONENT
 /begin STRUCTURE_COMPONENT BrkLvlStartUp uint8_t_0x1 0 SYMBOL_TYPE_LINK "BrkLvlStartUp" /end STRUCTURE_COMPONENT
/end TYPEDEF_STRUCTURE
/begin TYPEDEF_STRUCTURE EnergyOutp "" 0x34 SYMBOL_TYPE_LINK "EnergyOutp" /begin STRUCTURE_COMPONENT elecMotPwrDmd tKilowatt 0 SYMBOL_TYPE_LINK "elecMotPwrDmd" /end STRUCTURE_COMPONENT
 /begin STRUCTURE_COMPONENT elecMotPwrDmdRaw tKilowatt 4 SYMBOL_TYPE_LINK "elecMotPwrDmdRaw" /end STRUCTURE_COMPONENT
 /begin STRUCTURE_COMPONENT elecMotChrgPwrDmdTempLimd tKilowatt 8 SYMBOL_TYPE_LINK "elecMotChrgPwrDmdTempLimd" /end STRUCTURE_COMPONENT
 /begin STRUCTURE_COMPONENT elecMotTqDmd tNewtonMetre 12 SYMBOL_TYPE_LINK "elecMotTqDmd" /end STRUCTURE_COMPONENT
 /begin STRUCTURE_COMPONENT elecMotTqDmdFltd tNewtonMetre 16 SYMBOL_TYPE_LINK "elecMotTqDmdFltd" /end STRUCTURE_COMPONENT
 /begin STRUCTURE_COMPONENT decoupleIceReq _Bool 20 SYMBOL_TYPE_LINK "decoupleIceReq" /end STRUCTURE_COMPONENT
 /begin STRUCTURE_COMPONENT iceStartCmd tIceStartCmd 24 SYMBOL_TYPE_LINK "iceStartCmd" /end STRUCTURE_COMPONENT
 /begin STRUCTURE_COMPONENT bChrgSt _Bool 28 SYMBOL_TYPE_LINK "bChrgSt" /end STRUCTURE_COMPONENT
 /begin STRUCTURE_COMPONENT hybMod tHybMod 32 SYMBOL_TYPE_LINK "hybMod" /end STRUCTURE_COMPONENT
 /begin STRUCTURE_COMPONENT elecCnsCdIceOnLastTrip tKilowattHour 36 SYMBOL_TYPE_LINK "elecCnsCdIceOnLastTrip" /end STRUCTURE_COMPONENT
 /begin STRUCTURE_COMPONENT elecCnsCdIceOffLastTrip tKilowattHour 40 SYMBOL_TYPE_LINK "elecCnsCdIceOffLastTrip" /end STRUCTURE_COMPONENT
 /begin STRUCTURE_COMPONENT elecCnsCdIceOnLifetime tKilowattHour 44 SYMBOL_TYPE_LINK "elecCnsCdIceOnLifetime" /end STRUCTURE_COMPONENT
 /begin STRUCTURE_COMPONENT elecCnsCdIceOffLifetime tKilowattHour 48 SYMBOL_TYPE_LINK "elecCnsCdIceOffLifetime" /end STRUCTURE_COMPONENT
/end TYPEDEF_STRUCTURE
/begin TYPEDEF_STRUCTURE LibHybridSm "" 0x44 SYMBOL_TYPE_LINK "LibHybridSm" /begin STRUCTURE_COMPONENT state tHybSmState 0 SYMBOL_TYPE_LINK "state" /end STRUCTURE_COMPONENT /begin STRUCTURE_COMPONENT fistStateRun _Bool 4 SYMBOL_TYPE_LINK "fistStateRun" /end STRUCTURE_COMPONENT /begin STRUCTURE_COMPONENT hvRequest HvRequest 5 SYMBOL_TYPE_LINK "hvRequest" /end STRUCTURE_COMPONENT
 /begin STRUCTURE_COMPONENT stopChargingRequest _Bool 6 SYMBOL_TYPE_LINK "stopChargingRequest" /end STRUCTURE_COMPONENT
 /begin STRUCTURE_COMPONENT drvMod tDriveMode 8 SYMBOL_TYPE_LINK "drvMod" /end STRUCTURE_COMPONENT
 /begin STRUCTURE_COMPONENT bmsState tBMSState 12 SYMBOL_TYPE_LINK "bmsState" /end STRUCTURE_COMPONENT
 /begin STRUCTURE_COMPONENT invDcVoltage tVolt 16 SYMBOL_TYPE_LINK "invDcVoltage" /end STRUCTURE_COMPONENT
 /begin STRUCTURE_COMPONENT engRunning _Bool 20 SYMBOL_TYPE_LINK "engRunning" /end STRUCTURE_COMPONENT
 /begin STRUCTURE_COMPONENT hvBatSoC tPercent 24 SYMBOL_TYPE_LINK "hvBatSoC" /end STRUCTURE_COMPONENT
 /begin STRUCTURE_COMPONENT chargePortStatus tChargePortStatus 28 SYMBOL_TYPE_LINK "chargePortStatus" /end STRUCTURE_COMPONENT
 /begin STRUCTURE_COMPONENT dcdc12VFaultCode uint8_t 32 SYMBOL_TYPE_LINK "dcdc12VFaultCode" /end STRUCTURE_COMPONENT
 /begin STRUCTURE_COMPONENT dcdc48VFaultCode uint8_t 33 SYMBOL_TYPE_LINK "dcdc48VFaultCode" /end STRUCTURE_COMPONENT
 /begin STRUCTURE_COMPONENT bmsFaultCode uint8_t 34 SYMBOL_TYPE_LINK "bmsFaultCode" /end STRUCTURE_COMPONENT
 /begin STRUCTURE_COMPONENT lvBatVltg tVolt 36 SYMBOL_TYPE_LINK "lvBatVltg" /end STRUCTURE_COMPONENT
 /begin STRUCTURE_COMPONENT lvBatCrnt tAmpere 40 SYMBOL_TYPE_LINK "lvBatCrnt" /end STRUCTURE_COMPONENT
 /begin STRUCTURE_COMPONENT lvBatSoc tPercent_S8 44 SYMBOL_TYPE_LINK "lvBatSoc" /end STRUCTURE_COMPONENT
 /begin STRUCTURE_COMPONENT ignitionPrev _Bool 45 SYMBOL_TYPE_LINK "ignitionPrev" /end STRUCTURE_COMPONENT
 /begin STRUCTURE_COMPONENT lvChrgLatch _Bool 46 SYMBOL_TYPE_LINK "lvChrgLatch" /end STRUCTURE_COMPONENT
 /begin STRUCTURE_COMPONENT hvReqInhibit _Bool 47 SYMBOL_TYPE_LINK "hvReqInhibit" /end STRUCTURE_COMPONENT
 /begin STRUCTURE_COMPONENT hvReqInhibitTimer tMillisecond_U32 48 SYMBOL_TYPE_LINK "hvReqInhibitTimer" /end STRUCTURE_COMPONENT
 /begin STRUCTURE_COMPONENT lvChrgnReqAllwd _Bool 52 SYMBOL_TYPE_LINK "lvChrgnReqAllwd" /end STRUCTURE_COMPONENT
 /begin STRUCTURE_COMPONENT lvBatType tLvBatteryType 56 SYMBOL_TYPE_LINK "lvBatType" /end STRUCTURE_COMPONENT
 /begin STRUCTURE_COMPONENT kl30Voltage tVolt 60 SYMBOL_TYPE_LINK "kl30Voltage" /end STRUCTURE_COMPONENT
 /begin STRUCTURE_COMPONENT hybCoolFaultSetLimp _Bool 64 SYMBOL_TYPE_LINK "hybCoolFaultSetLimp" /end STRUCTURE_COMPONENT
/end TYPEDEF_STRUCTURE
/begin TYPEDEF_STRUCTURE VsoVehMtnObsvrLocals "" 0x1FC SYMBOL_TYPE_LINK "VsoVehMtnObsvrLocals" /begin STRUCTURE_COMPONENT initDone _Bool 0 SYMBOL_TYPE_LINK "initDone" /end STRUCTURE_COMPONENT
 /begin STRUCTURE_COMPONENT roadBnkFilStructO1Butter O1Butter 4 SYMBOL_TYPE_LINK "roadBnkFilStructO1Butter" /end STRUCTURE_COMPONENT
 /begin STRUCTURE_COMPONENT roadGrdtFilStructO1Butter O1Butter 28 SYMBOL_TYPE_LINK "roadGrdtFilStructO1Butter" /end STRUCTURE_COMPONENT
 /begin STRUCTURE_COMPONENT vehSideslipAgDeg tDegree_10_S16 52 SYMBOL_TYPE_LINK "vehSideslipAgDeg" /end STRUCTURE_COMPONENT
 /begin STRUCTURE_COMPONENT roadBnkDeg tDegree_10_S16 54 SYMBOL_TYPE_LINK "roadBnkDeg" /end STRUCTURE_COMPONENT
 /begin STRUCTURE_COMPONENT roadGrdtDeg tDegree_10_S16 56 SYMBOL_TYPE_LINK "roadGrdtDeg" /end STRUCTURE_COMPONENT
 /begin STRUCTURE_COMPONENT tireLgtSlip tFactor 60 MATRIX_DIM 4 SYMBOL_TYPE_LINK "tireLgtSlip" /end STRUCTURE_COMPONENT
 /begin STRUCTURE_COMPONENT vehVelLgt tMetrePerSecond 76 SYMBOL_TYPE_LINK "vehVelLgt" /end STRUCTURE_COMPONENT
 /begin STRUCTURE_COMPONENT vehVelLat tMetrePerSecond 80 SYMBOL_TYPE_LINK "vehVelLat" /end STRUCTURE_COMPONENT
 /begin STRUCTURE_COMPONENT whlVelU tMetrePerSecond 84 MATRIX_DIM 4 SYMBOL_TYPE_LINK "whlVelU" /end STRUCTURE_COMPONENT
 /begin STRUCTURE_COMPONENT whlVelV tMetrePerSecond 100 MATRIX_DIM 4 SYMBOL_TYPE_LINK "whlVelV" /end STRUCTURE_COMPONENT
 /begin STRUCTURE_COMPONENT whlVelLat tMetrePerSecond 116 MATRIX_DIM 4 SYMBOL_TYPE_LINK "whlVelLat" /end STRUCTURE_COMPONENT
 /begin STRUCTURE_COMPONENT whlVelLgt tMetrePerSecond 132 MATRIX_DIM 4 SYMBOL_TYPE_LINK "whlVelLgt" /end STRUCTURE_COMPONENT
 /begin STRUCTURE_COMPONENT whlVelRollg tMetrePerSecond 148 MATRIX_DIM 4 SYMBOL_TYPE_LINK "whlVelRollg" /end STRUCTURE_COMPONENT
 /begin STRUCTURE_COMPONENT vehAccelLgt tMetrePerSquareSecond 164 SYMBOL_TYPE_LINK "vehAccelLgt" /end STRUCTURE_COMPONENT
 /begin STRUCTURE_COMPONENT vehAccelLat tMetrePerSquareSecond 168 SYMBOL_TYPE_LINK "vehAccelLat" /end STRUCTURE_COMPONENT
 /begin STRUCTURE_COMPONENT ksoOdeSts tOdeStatus 172 SYMBOL_TYPE_LINK "ksoOdeSts" /end STRUCTURE_COMPONENT
 /begin STRUCTURE_COMPONENT dsoOdeSts tOdeStatus 176 SYMBOL_TYPE_LINK "dsoOdeSts" /end STRUCTURE_COMPONENT
 /begin STRUCTURE_COMPONENT roadBnkQ tQualifier 180 SYMBOL_TYPE_LINK "roadBnkQ" /end STRUCTURE_COMPONENT
 /begin STRUCTURE_COMPONENT roadGrdtQ tQualifier 184 SYMBOL_TYPE_LINK "roadGrdtQ" /end STRUCTURE_COMPONENT
 /begin STRUCTURE_COMPONENT tireLatSlipQ tQualifier 188 MATRIX_DIM 4 SYMBOL_TYPE_LINK "tireLatSlipQ" /end STRUCTURE_COMPONENT
 /begin STRUCTURE_COMPONENT tireLgtSlipQ tQualifier 204 MATRIX_DIM 4 SYMBOL_TYPE_LINK "tireLgtSlipQ" /end STRUCTURE_COMPONENT
 /begin STRUCTURE_COMPONENT vehAccelLatQ tQualifier 220 SYMBOL_TYPE_LINK "vehAccelLatQ" /end STRUCTURE_COMPONENT
 /begin STRUCTURE_COMPONENT vehAccelLgtQ tQualifier 224 SYMBOL_TYPE_LINK "vehAccelLgtQ" /end STRUCTURE_COMPONENT
 /begin STRUCTURE_COMPONENT vehSideslipAgQ tQualifier 228 SYMBOL_TYPE_LINK "vehSideslipAgQ" /end STRUCTURE_COMPONENT
 /begin STRUCTURE_COMPONENT vehVelLatQ tQualifier 232 SYMBOL_TYPE_LINK "vehVelLatQ" /end STRUCTURE_COMPONENT
 /begin STRUCTURE_COMPONENT vehVelLgtQ tQualifier 236 SYMBOL_TYPE_LINK "vehVelLgtQ" /end STRUCTURE_COMPONENT
 /begin STRUCTURE_COMPONENT vehYawRateQ tQualifier 240 SYMBOL_TYPE_LINK "vehYawRateQ" /end STRUCTURE_COMPONENT
 /begin STRUCTURE_COMPONENT whlAgAxleFrntQ tQualifier 244 SYMBOL_TYPE_LINK "whlAgAxleFrntQ" /end STRUCTURE_COMPONENT
 /begin STRUCTURE_COMPONENT roadBnkRaw tRadian 248 SYMBOL_TYPE_LINK "roadBnkRaw" /end STRUCTURE_COMPONENT
 /begin STRUCTURE_COMPONENT roadGrdtRaw tRadian 252 SYMBOL_TYPE_LINK "roadGrdtRaw" /end STRUCTURE_COMPONENT
 /begin STRUCTURE_COMPONENT roadBnkFild tRadian 256 SYMBOL_TYPE_LINK "roadBnkFild" /end STRUCTURE_COMPONENT
 /begin STRUCTURE_COMPONENT roadGrdtFild tRadian 260 SYMBOL_TYPE_LINK "roadGrdtFild" /end STRUCTURE_COMPONENT
 /begin STRUCTURE_COMPONENT tireLatSlip tRadian 264 MATRIX_DIM 4 SYMBOL_TYPE_LINK "tireLatSlip" /end STRUCTURE_COMPONENT
 /begin STRUCTURE_COMPONENT vehSideslipAg tRadian 280 SYMBOL_TYPE_LINK "vehSideslipAg" /end STRUCTURE_COMPONENT
 /begin STRUCTURE_COMPONENT whlAgAxleFrnt tRadian 284 SYMBOL_TYPE_LINK "whlAgAxleFrnt" /end STRUCTURE_COMPONENT
 /begin STRUCTURE_COMPONENT vehYawRate tRadianPerSecond 288 SYMBOL_TYPE_LINK "vehYawRate" /end STRUCTURE_COMPONENT
 /begin STRUCTURE_COMPONENT dsoLocals VsoDynStObsvrLocals 292 SYMBOL_TYPE_LINK "dsoLocals" /end STRUCTURE_COMPONENT
 /begin STRUCTURE_COMPONENT ksoLocals VsoKinStObsvrLocals 396 SYMBOL_TYPE_LINK "ksoLocals" /end STRUCTURE_COMPONENT
 /begin STRUCTURE_COMPONENT stObsvrSwtSt tVsoVehicleMotionObserverSwt 504 SYMBOL_TYPE_LINK "stObsvrSwtSt" /end STRUCTURE_COMPONENT
/end TYPEDEF_STRUCTURE
/begin TYPEDEF_STRUCTURE KalmanFilter1DCtx "" 0x24 SYMBOL_TYPE_LINK "KalmanFilter1DCtx" /begin STRUCTURE_COMPONENT stateEstimate _float 0 SYMBOL_TYPE_LINK "stateEstimate" /end STRUCTURE_COMPONENT
 /begin STRUCTURE_COMPONENT stateCovariance _float 4 SYMBOL_TYPE_LINK "stateCovariance" /end STRUCTURE_COMPONENT
 /begin STRUCTURE_COMPONENT processCovariance _float 8 SYMBOL_TYPE_LINK "processCovariance" /end STRUCTURE_COMPONENT
 /begin STRUCTURE_COMPONENT observationCovariance _float 12 SYMBOL_TYPE_LINK "observationCovariance" /end STRUCTURE_COMPONENT
 /begin STRUCTURE_COMPONENT transitionStateGain _float 16 SYMBOL_TYPE_LINK "transitionStateGain" /end STRUCTURE_COMPONENT
 /begin STRUCTURE_COMPONENT transitionInputGain _float 20 SYMBOL_TYPE_LINK "transitionInputGain" /end STRUCTURE_COMPONENT
 /begin STRUCTURE_COMPONENT observationGain _float 24 SYMBOL_TYPE_LINK "observationGain" /end STRUCTURE_COMPONENT
 /begin STRUCTURE_COMPONENT aPrioriCovariance _float 28 SYMBOL_TYPE_LINK "aPrioriCovariance" /end STRUCTURE_COMPONENT
 /begin STRUCTURE_COMPONENT kalmanGain _float 32 SYMBOL_TYPE_LINK "kalmanGain" /end STRUCTURE_COMPONENT
/end TYPEDEF_STRUCTURE
/begin TYPEDEF_STRUCTURE PSnrsLocals "" 0x68 SYMBOL_TYPE_LINK "PSnrsLocals"
 /begin STRUCTURE_COMPONENT whlCluPressSnsrU tMillivolt_S16 0 MATRIX_DIM 4 SYMBOL_TYPE_LINK "whlCluPressSnsrU" /end STRUCTURE_COMPONENT
 /begin STRUCTURE_COMPONENT pressRaw tBar 8 MATRIX_DIM 4 SYMBOL_TYPE_LINK "pressRaw" /end STRUCTURE_COMPONENT
 /begin STRUCTURE_COMPONENT pressOffs tBar 24 MATRIX_DIM 4 SYMBOL_TYPE_LINK "pressOffs" /end STRUCTURE_COMPONENT
 /begin STRUCTURE_COMPONENT pressAccum tBar 40 MATRIX_DIM 4 SYMBOL_TYPE_LINK "pressAccum" /end STRUCTURE_COMPONENT
 /begin STRUCTURE_COMPONENT pressAdapTmr tMillisecond_U32 56 MATRIX_DIM 4 SYMBOL_TYPE_LINK "pressAdapTmr" /end STRUCTURE_COMPONENT
 /begin STRUCTURE_COMPONENT whlCluPress tBar_100_S16 72 MATRIX_DIM 4 SYMBOL_TYPE_LINK "whlCluPress" /end STRUCTURE_COMPONENT
 /begin STRUCTURE_COMPONENT whlCluPressDelta1ms tBar_100_S16 80 MATRIX_DIM 4 SYMBOL_TYPE_LINK "whlCluPressDelta1ms" /end STRUCTURE_COMPONENT
 /begin STRUCTURE_COMPONENT accumCnt int32_t 88 MATRIX_DIM 4 SYMBOL_TYPE_LINK "accumCnt" /end STRUCTURE_COMPONENT
/end TYPEDEF_STRUCTURE
/begin TYPEDEF_STRUCTURE SpdSnsrLocals "" 0x26C SYMBOL_TYPE_LINK "SpdSnsrLocals" /begin STRUCTURE_COMPONENT initDone _Bool 0 SYMBOL_TYPE_LINK "initDone" /end STRUCTURE_COMPONENT
 /begin STRUCTURE_COMPONENT frntAxleRateSnsrCtx QuadSensorCtx 4 SYMBOL_TYPE_LINK "frntAxleRateSnsrCtx" /end STRUCTURE_COMPONENT
 /begin STRUCTURE_COMPONENT whlCluRateOuterRearSnsrCtx QuadSensorCtx 88 MATRIX_DIM 2 SYMBOL_TYPE_LINK "whlCluRateOuterRearSnsrCtx" /end STRUCTURE_COMPONENT
 /begin STRUCTURE_COMPONENT whlCluRateOuterQ tQualifier 256 MATRIX_DIM 4 SYMBOL_TYPE_LINK "whlCluRateOuterQ" /end STRUCTURE_COMPONENT
 /begin STRUCTURE_COMPONENT whlRateQ tQualifier 272 MATRIX_DIM 4 SYMBOL_TYPE_LINK "whlRateQ" /end STRUCTURE_COMPONENT
 /begin STRUCTURE_COMPONENT axleRateFrnt tRadianPerSecond 288 SYMBOL_TYPE_LINK "axleRateFrnt" /end STRUCTURE_COMPONENT
 /begin STRUCTURE_COMPONENT whlCluRateOuter tRadianPerSecond 292 MATRIX_DIM 4 SYMBOL_TYPE_LINK "whlCluRateOuter" /end STRUCTURE_COMPONENT
 /begin STRUCTURE_COMPONENT whlRate tRadianPerSecond 308 MATRIX_DIM 4 SYMBOL_TYPE_LINK "whlRate" /end STRUCTURE_COMPONENT
 /begin STRUCTURE_COMPONENT whlRateURawPrev tRadianPerSecond_100_U16 324 MATRIX_DIM 4 SYMBOL_TYPE_LINK "whlRateURawPrev" /end STRUCTURE_COMPONENT
 /begin STRUCTURE_COMPONENT whlCluRateOuterFrntSnsrCtx RateSensorCtx 332 MATRIX_DIM 2 SYMBOL_TYPE_LINK "whlCluRateOuterFrntSnsrCtx" /end STRUCTURE_COMPONENT
 /begin STRUCTURE_COMPONENT trsmOutpShaftSpdPrev tRevolutionPerMinute_S16 436 SYMBOL_TYPE_LINK "trsmOutpShaftSpdPrev" /end STRUCTURE_COMPONENT
 /begin STRUCTURE_COMPONENT propshRateDir tRollingState 440 SYMBOL_TYPE_LINK "propshRateDir" /end STRUCTURE_COMPONENT
 /begin STRUCTURE_COMPONENT whlCluOuterDir tRollingState 444 MATRIX_DIM 4 SYMBOL_TYPE_LINK "whlCluOuterDir" /end STRUCTURE_COMPONENT
 /begin STRUCTURE_COMPONENT whlRateDirLstVld tRollingState 460 MATRIX_DIM 4 SYMBOL_TYPE_LINK "whlRateDirLstVld" /end STRUCTURE_COMPONENT
 /begin STRUCTURE_COMPONENT trsmOutpShaftCntr uint32_t 476 SYMBOL_TYPE_LINK "trsmOutpShaftCntr" /end STRUCTURE_COMPONENT
 /begin STRUCTURE_COMPONENT whlCluRateOuterCnt uint8_t 480 MATRIX_DIM 4 SYMBOL_TYPE_LINK "whlCluRateOuterCnt" /end STRUCTURE_COMPONENT
 /begin STRUCTURE_COMPONENT frntAxleChnFaultActive _Bool 484 SYMBOL_TYPE_LINK "frntAxleChnFaultActive" /end STRUCTURE_COMPONENT
 /begin STRUCTURE_COMPONENT frntAxleDirBitFaultActive _Bool 485 SYMBOL_TYPE_LINK "frntAxleDirBitFaultActive" /end STRUCTURE_COMPONENT
 /begin STRUCTURE_COMPONENT frntAxleRedundFaultActive _Bool 486 SYMBOL_TYPE_LINK "frntAxleRedundFaultActive" /end STRUCTURE_COMPONENT
 /begin STRUCTURE_COMPONENT whlCluFrntRedundFaultActive _Bool 487 MATRIX_DIM 2 SYMBOL_TYPE_LINK "whlCluFrntRedundFaultActive" /end STRUCTURE_COMPONENT
 /begin STRUCTURE_COMPONENT whlCluRearChnFaultActive _Bool 489 MATRIX_DIM 2 SYMBOL_TYPE_LINK "whlCluRearChnFaultActive" /end STRUCTURE_COMPONENT
 /begin STRUCTURE_COMPONENT whlCluRearDirBitFaultActive _Bool 491 MATRIX_DIM 2 SYMBOL_TYPE_LINK "whlCluRearDirBitFaultActive" /end STRUCTURE_COMPONENT
 /begin STRUCTURE_COMPONENT whlCluRearRedundFaultActive _Bool 493 MATRIX_DIM 2 SYMBOL_TYPE_LINK "whlCluRearRedundFaultActive" /end STRUCTURE_COMPONENT
 /begin STRUCTURE_COMPONENT frntAxleLastDir int8_t 495 SYMBOL_TYPE_LINK "frntAxleLastDir" /end STRUCTURE_COMPONENT
 /begin STRUCTURE_COMPONENT whlCluRearLastDir int8_t 496 MATRIX_DIM 2 SYMBOL_TYPE_LINK "whlCluRearLastDir" /end STRUCTURE_COMPONENT
 /begin STRUCTURE_COMPONENT frntAxleChnFaultHealTi tMillisecond_U32 500 SYMBOL_TYPE_LINK "frntAxleChnFaultHealTi" /end STRUCTURE_COMPONENT
 /begin STRUCTURE_COMPONENT frntAxleDirBitHealStartTi tMillisecond_U32 504 SYMBOL_TYPE_LINK "frntAxleDirBitHealStartTi" /end STRUCTURE_COMPONENT
 /begin STRUCTURE_COMPONENT frntAxleRedundTi tMillisecond_U32 508 SYMBOL_TYPE_LINK "frntAxleRedundTi" /end STRUCTURE_COMPONENT
 /begin STRUCTURE_COMPONENT whlCluFrntRedundTi tMillisecond_U32 512 MATRIX_DIM 2 SYMBOL_TYPE_LINK "whlCluFrntRedundTi" /end STRUCTURE_COMPONENT
 /begin STRUCTURE_COMPONENT whlCluRearChnFaultHealTi tMillisecond_U32 520 MATRIX_DIM 2 SYMBOL_TYPE_LINK "whlCluRearChnFaultHealTi" /end STRUCTURE_COMPONENT
 /begin STRUCTURE_COMPONENT whlCluRearDirBitHealStartTi tMillisecond_U32 528 MATRIX_DIM 2 SYMBOL_TYPE_LINK "whlCluRearDirBitHealStartTi" /end STRUCTURE_COMPONENT
 /begin STRUCTURE_COMPONENT whlCluRearRedundTi tMillisecond_U32 536 MATRIX_DIM 2 SYMBOL_TYPE_LINK "whlCluRearRedundTi" /end STRUCTURE_COMPONENT
 /begin STRUCTURE_COMPONENT frntAxleFaultMask FrntAxleSnsrFaultMask 544 SYMBOL_TYPE_LINK "frntAxleFaultMask" /end STRUCTURE_COMPONENT
 /begin STRUCTURE_COMPONENT elecMotSpdPrev tRevolutionPerMinute_S16 546 SYMBOL_TYPE_LINK "elecMotSpdPrev" /end STRUCTURE_COMPONENT
 /begin STRUCTURE_COMPONENT whlCluFrntFaultMask WhlCluFrntSnsrFaultMask 548 MATRIX_DIM 2 SYMBOL_TYPE_LINK "whlCluFrntFaultMask" /end STRUCTURE_COMPONENT
 /begin STRUCTURE_COMPONENT whlCluRearFaultMask WhlCluRearSnsrFaultMask 550 MATRIX_DIM 2 SYMBOL_TYPE_LINK "whlCluRearFaultMask" /end STRUCTURE_COMPONENT
 /begin STRUCTURE_COMPONENT frntAxleChnLastEventCnt uint32_t 552 MATRIX_DIM 4 SYMBOL_TYPE_LINK "frntAxleChnLastEventCnt" /end STRUCTURE_COMPONENT
 /begin STRUCTURE_COMPONENT whlCluRearChnLastEventCnt uint32_t 568 MATRIX_DIM 2 4 SYMBOL_TYPE_LINK "whlCluRearChnLastEventCnt" /end STRUCTURE_COMPONENT
 /begin STRUCTURE_COMPONENT frntAxleChnNoChgCnt uint8_t 600 MATRIX_DIM 4 SYMBOL_TYPE_LINK "frntAxleChnNoChgCnt" /end STRUCTURE_COMPONENT
 /begin STRUCTURE_COMPONENT frntAxleDirBitChgCnt uint8_t 604 SYMBOL_TYPE_LINK "frntAxleDirBitChgCnt" /end STRUCTURE_COMPONENT
 /begin STRUCTURE_COMPONENT whlCluRateInnerCnt uint8_t 605 MATRIX_DIM 4 SYMBOL_TYPE_LINK "whlCluRateInnerCnt" /end STRUCTURE_COMPONENT
 /begin STRUCTURE_COMPONENT whlCluRearChnNoChgCnt uint8_t 609 MATRIX_DIM 2 4 SYMBOL_TYPE_LINK "whlCluRearChnNoChgCnt" /end STRUCTURE_COMPONENT
 /begin STRUCTURE_COMPONENT whlCluRearDirBitChgCnt uint8_t 617 MATRIX_DIM 2 SYMBOL_TYPE_LINK "whlCluRearDirBitChgCnt" /end STRUCTURE_COMPONENT
/end TYPEDEF_STRUCTURE
/begin TYPEDEF_STRUCTURE VsoRollingDirectionLocals "" 0x18 SYMBOL_TYPE_LINK "VsoRollingDirectionLocals"
 /begin STRUCTURE_COMPONENT bBrakePlausibility _Bool 0 SYMBOL_TYPE_LINK "bBrakePlausibility" /end STRUCTURE_COMPONENT
 /begin STRUCTURE_COMPONENT bFaultDetected _Bool 1 SYMBOL_TYPE_LINK "bFaultDetected" /end STRUCTURE_COMPONENT
 /begin STRUCTURE_COMPONENT bVehHasMoved _Bool 2 SYMBOL_TYPE_LINK "bVehHasMoved" /end STRUCTURE_COMPONENT
 /begin STRUCTURE_COMPONENT initDone _Bool 3 SYMBOL_TYPE_LINK "initDone" /end STRUCTURE_COMPONENT
 /begin STRUCTURE_COMPONENT statyAccel tMetrePerSquareSecond 4 SYMBOL_TYPE_LINK "statyAccel" /end STRUCTURE_COMPONENT
 /begin STRUCTURE_COMPONENT allWhlDir tRollingState 8 SYMBOL_TYPE_LINK "allWhlDir" /end STRUCTURE_COMPONENT
 /begin STRUCTURE_COMPONENT bTakeoffPlausibility tRollingState 12 SYMBOL_TYPE_LINK "bTakeoffPlausibility" /end STRUCTURE_COMPONENT
 /begin STRUCTURE_COMPONENT vehRollgSt tRollingState 16 SYMBOL_TYPE_LINK "vehRollgSt" /end STRUCTURE_COMPONENT
 /begin STRUCTURE_COMPONENT statyCnt uint32_t 20 SYMBOL_TYPE_LINK "statyCnt" /end STRUCTURE_COMPONENT
/end TYPEDEF_STRUCTURE
/begin TYPEDEF_STRUCTURE PedalLogicLocals "" 0x4C SYMBOL_TYPE_LINK "PedalLogicLocals" /begin STRUCTURE_COMPONENT initDone _Bool 0 SYMBOL_TYPE_LINK "initDone" /end STRUCTURE_COMPONENT
 /begin STRUCTURE_COMPONENT beenOffPedalOnce _Bool 1 SYMBOL_TYPE_LINK "beenOffPedalOnce" /end STRUCTURE_COMPONENT
 /begin STRUCTURE_COMPONENT pedal1Adaption PedalAdaption 4 SYMBOL_TYPE_LINK "pedal1Adaption" /end STRUCTURE_COMPONENT
 /begin STRUCTURE_COMPONENT pedal2Adaption PedalAdaption 12 SYMBOL_TYPE_LINK "pedal2Adaption" /end STRUCTURE_COMPONENT
 /begin STRUCTURE_COMPONENT sensor1UFilter O1Butter 20 SYMBOL_TYPE_LINK "sensor1UFilter" /end STRUCTURE_COMPONENT
 /begin STRUCTURE_COMPONENT sensor2UFilter O1Butter 44 SYMBOL_TYPE_LINK "sensor2UFilter" /end STRUCTURE_COMPONENT
 /begin STRUCTURE_COMPONENT lastOkPedal tPercent_100_S32 68 SYMBOL_TYPE_LINK "lastOkPedal" /end STRUCTURE_COMPONENT
 /begin STRUCTURE_COMPONENT lastOkPedalTimestamp tMillisecond_U32 72 SYMBOL_TYPE_LINK "lastOkPedalTimestamp" /end STRUCTURE_COMPONENT
/end TYPEDEF_STRUCTURE
/begin TYPEDEF_STRUCTURE LibHybridTorque "" 0xDC SYMBOL_TYPE_LINK "LibHybridTorque"
 /begin STRUCTURE_COMPONENT invTorqueLimitPos uint16_t 0 SYMBOL_TYPE_LINK "invTorqueLimitPos" /end STRUCTURE_COMPONENT
 /begin STRUCTURE_COMPONENT invTorqueLimitNeg uint16_t 2 SYMBOL_TYPE_LINK "invTorqueLimitNeg" /end STRUCTURE_COMPONENT
 /begin STRUCTURE_COMPONENT bmsAvailablePosCurrent uint16_t 4 SYMBOL_TYPE_LINK "bmsAvailablePosCurrent" /end STRUCTURE_COMPONENT
 /begin STRUCTURE_COMPONENT bmsAvailableNegCurrent uint16_t 6 SYMBOL_TYPE_LINK "bmsAvailableNegCurrent" /end STRUCTURE_COMPONENT
 /begin STRUCTURE_COMPONENT motorSpeed tRevolutionPerMinute_S16 8 SYMBOL_TYPE_LINK "motorSpeed" /end STRUCTURE_COMPONENT
 /begin STRUCTURE_COMPONENT motorTorque tNewtonMetre 12 SYMBOL_TYPE_LINK "motorTorque" /end STRUCTURE_COMPONENT
 /begin STRUCTURE_COMPONENT tmTorqueLimitNeg tNewtonMetre 16 SYMBOL_TYPE_LINK "tmTorqueLimitNeg" /end STRUCTURE_COMPONENT
 /begin STRUCTURE_COMPONENT tmTorqueLimitPos tNewtonMetre 20 SYMBOL_TYPE_LINK "tmTorqueLimitPos" /end STRUCTURE_COMPONENT
 /begin STRUCTURE_COMPONENT dcVoltage _float 24 SYMBOL_TYPE_LINK "dcVoltage" /end STRUCTURE_COMPONENT
 /begin STRUCTURE_COMPONENT hvBatterySoc tPercent 28 SYMBOL_TYPE_LINK "hvBatterySoc" /end STRUCTURE_COMPONENT
 /begin STRUCTURE_COMPONENT hvBatterySoe tKilowattHour 32 SYMBOL_TYPE_LINK "hvBatterySoe" /end STRUCTURE_COMPONENT
 /begin STRUCTURE_COMPONENT tqSt tTqMacSt 36 SYMBOL_TYPE_LINK "tqSt" /end STRUCTURE_COMPONENT
 /begin STRUCTURE_COMPONENT invState tInvSmStatus 40 SYMBOL_TYPE_LINK "invState" /end STRUCTURE_COMPONENT
 /begin STRUCTURE_COMPONENT elecTqAllowed _Bool 44 SYMBOL_TYPE_LINK "elecTqAllowed" /end STRUCTURE_COMPONENT
 /begin STRUCTURE_COMPONENT elecMotSpdReq tRevolutionPerMinute_S16 46 SYMBOL_TYPE_LINK "elecMotSpdReq" /end STRUCTURE_COMPONENT
 /begin STRUCTURE_COMPONENT elecMotPwrDmdFromEgyMgr tKilowatt 48 SYMBOL_TYPE_LINK "elecMotPwrDmdFromEgyMgr" /end STRUCTURE_COMPONENT
 /begin STRUCTURE_COMPONENT bmsState tBMSState 52 SYMBOL_TYPE_LINK "bmsState" /end STRUCTURE_COMPONENT
 /begin STRUCTURE_COMPONENT hybState tHybSmState 56 SYMBOL_TYPE_LINK "hybState" /end STRUCTURE_COMPONENT
 /begin STRUCTURE_COMPONENT minTqLimFiltCtx O1Butter 60 SYMBOL_TYPE_LINK "minTqLimFiltCtx" /end STRUCTURE_COMPONENT
 /begin STRUCTURE_COMPONENT maxTqLimFiltCtx O1Butter 84 SYMBOL_TYPE_LINK "maxTqLimFiltCtx" /end STRUCTURE_COMPONENT
 /begin STRUCTURE_COMPONENT posTorqueBms _float 108 SYMBOL_TYPE_LINK "posTorqueBms" /end STRUCTURE_COMPONENT
 /begin STRUCTURE_COMPONENT negTorqueBms _float 112 SYMBOL_TYPE_LINK "negTorqueBms" /end STRUCTURE_COMPONENT
 /begin STRUCTURE_COMPONENT torqueLimitPosRaw _float 116 SYMBOL_TYPE_LINK "torqueLimitPosRaw" /end STRUCTURE_COMPONENT
 /begin STRUCTURE_COMPONENT torqueLimitNegRaw _float 120 SYMBOL_TYPE_LINK "torqueLimitNegRaw" /end STRUCTURE_COMPONENT
 /begin STRUCTURE_COMPONENT torqueLimitPosFiltd _float 124 SYMBOL_TYPE_LINK "torqueLimitPosFiltd" /end STRUCTURE_COMPONENT
 /begin STRUCTURE_COMPONENT torqueLimitNegFiltd _float 128 SYMBOL_TYPE_LINK "torqueLimitNegFiltd" /end STRUCTURE_COMPONENT
 /begin STRUCTURE_COMPONENT elecMotEffDisch _float 132 SYMBOL_TYPE_LINK "elecMotEffDisch" /end STRUCTURE_COMPONENT
 /begin STRUCTURE_COMPONENT elecMotEffChrg _float 136 SYMBOL_TYPE_LINK "elecMotEffChrg" /end STRUCTURE_COMPONENT
 /begin STRUCTURE_COMPONENT torqueLimitPos uint16_t 140 SYMBOL_TYPE_LINK "torqueLimitPos" /end STRUCTURE_COMPONENT
 /begin STRUCTURE_COMPONENT torqueLimitNeg uint16_t 142 SYMBOL_TYPE_LINK "torqueLimitNeg" /end STRUCTURE_COMPONENT
 /begin STRUCTURE_COMPONENT powerLimitPos tKilowatt 144 SYMBOL_TYPE_LINK "powerLimitPos" /end STRUCTURE_COMPONENT
 /begin STRUCTURE_COMPONENT powerLimitNeg tKilowatt 148 SYMBOL_TYPE_LINK "powerLimitNeg" /end STRUCTURE_COMPONENT
 /begin STRUCTURE_COMPONENT elecMotPwr tKilowatt 152 SYMBOL_TYPE_LINK "elecMotPwr" /end STRUCTURE_COMPONENT
 /begin STRUCTURE_COMPONENT elecMotTqReq tNewtonMetre 156 SYMBOL_TYPE_LINK "elecMotTqReq" /end STRUCTURE_COMPONENT
 /begin STRUCTURE_COMPONENT elecMotChrgTqAct tNewtonMetre 160 SYMBOL_TYPE_LINK "elecMotChrgTqAct" /end STRUCTURE_COMPONENT
 /begin STRUCTURE_COMPONENT virtualBattPwr tWatt 164 SYMBOL_TYPE_LINK "virtualBattPwr" /end STRUCTURE_COMPONENT
 /begin STRUCTURE_COMPONENT virtualBattVltg tVolt 168 SYMBOL_TYPE_LINK "virtualBattVltg" /end STRUCTURE_COMPONENT
 /begin STRUCTURE_COMPONENT virtualBattVoc tVolt 172 SYMBOL_TYPE_LINK "virtualBattVoc" /end STRUCTURE_COMPONENT
 /begin STRUCTURE_COMPONENT virtualBattCrnt tAmpere 176 SYMBOL_TYPE_LINK "virtualBattCrnt" /end STRUCTURE_COMPONENT
 /begin STRUCTURE_COMPONENT virtualBattVltgDrp tVolt 180 SYMBOL_TYPE_LINK "virtualBattVltgDrp" /end STRUCTURE_COMPONENT
 /begin STRUCTURE_COMPONENT virtualBattCp tAmpereHour 184 SYMBOL_TYPE_LINK "virtualBattCp" /end STRUCTURE_COMPONENT
 /begin STRUCTURE_COMPONENT estmdBattCp tAmpereHour 188 SYMBOL_TYPE_LINK "estmdBattCp" /end STRUCTURE_COMPONENT
 /begin STRUCTURE_COMPONENT virtualDeltaSoc _float 192 SYMBOL_TYPE_LINK "virtualDeltaSoc" /end STRUCTURE_COMPONENT
 /begin STRUCTURE_COMPONENT virtualSoc _float 196 SYMBOL_TYPE_LINK "virtualSoc" /end STRUCTURE_COMPONENT
 /begin STRUCTURE_COMPONENT virtualSocPrc tPercent_S8 200 SYMBOL_TYPE_LINK "virtualSocPrc" /end STRUCTURE_COMPONENT
 /begin STRUCTURE_COMPONENT virtualSocStart _float 204 SYMBOL_TYPE_LINK "virtualSocStart" /end STRUCTURE_COMPONENT
 /begin STRUCTURE_COMPONENT coulombCounter tAmpereHour 208 SYMBOL_TYPE_LINK "coulombCounter" /end STRUCTURE_COMPONENT
 /begin STRUCTURE_COMPONENT virtualBattTemp tCelsius 212 SYMBOL_TYPE_LINK "virtualBattTemp" /end STRUCTURE_COMPONENT
 /begin STRUCTURE_COMPONENT virtualBattLosses tKilowatt 216 SYMBOL_TYPE_LINK "virtualBattLosses" /end STRUCTURE_COMPONENT
/end TYPEDEF_STRUCTURE
/begin TYPEDEF_STRUCTURE VsoKinStObsvrLocals "" 0x6C SYMBOL_TYPE_LINK "VsoKinStObsvrLocals"
 /begin STRUCTURE_COMPONENT odeExplicitFallback _Bool 0 SYMBOL_TYPE_LINK "odeExplicitFallback" /end STRUCTURE_COMPONENT
 /begin STRUCTURE_COMPONENT ksoStDeriv _float 4 MATRIX_DIM 2 SYMBOL_TYPE_LINK "ksoStDeriv" /end STRUCTURE_COMPONENT
 /begin STRUCTURE_COMPONENT ksoStEst _float 12 MATRIX_DIM 2 SYMBOL_TYPE_LINK "ksoStEst" /end STRUCTURE_COMPONENT
 /begin STRUCTURE_COMPONENT ksoStIni _float 20 MATRIX_DIM 2 SYMBOL_TYPE_LINK "ksoStIni" /end STRUCTURE_COMPONENT
 /begin STRUCTURE_COMPONENT ksoInp _float 28 MATRIX_DIM 2 SYMBOL_TYPE_LINK "ksoInp" /end STRUCTURE_COMPONENT
 /begin STRUCTURE_COMPONENT ksoParams VsoKinStObsvrParams 36 SYMBOL_TYPE_LINK "ksoParams" /end STRUCTURE_COMPONENT
/end TYPEDEF_STRUCTURE
/begin TYPEDEF_STRUCTURE VsoEnvLocals "" 0x14 SYMBOL_TYPE_LINK "VsoEnvLocals" /begin STRUCTURE_COMPONENT initDone _Bool 0 SYMBOL_TYPE_LINK "initDone" /end STRUCTURE_COMPONENT
 /begin STRUCTURE_COMPONENT airDensity tKilogramPerCubeMetre 4 SYMBOL_TYPE_LINK "airDensity" /end STRUCTURE_COMPONENT
 /begin STRUCTURE_COMPONENT dryAirP tPascal 8 SYMBOL_TYPE_LINK "dryAirP" /end STRUCTURE_COMPONENT
 /begin STRUCTURE_COMPONENT satP tPascal 12 SYMBOL_TYPE_LINK "satP" /end STRUCTURE_COMPONENT
 /begin STRUCTURE_COMPONENT watVapP tPascal 16 SYMBOL_TYPE_LINK "watVapP" /end STRUCTURE_COMPONENT
/end TYPEDEF_STRUCTURE
/begin TYPEDEF_STRUCTURE VsoWhlbasedVehSpdLocals "" 0x138 SYMBOL_TYPE_LINK "VsoWhlbasedVehSpdLocals" /begin STRUCTURE_COMPONENT initDone _Bool 0 SYMBOL_TYPE_LINK "initDone" /end STRUCTURE_COMPONENT /begin STRUCTURE_COMPONENT weight _float 4 MATRIX_DIM 4 SYMBOL_TYPE_LINK "weight" /end STRUCTURE_COMPONENT
 /begin STRUCTURE_COMPONENT filterStructVehSpd O2Butter 20 SYMBOL_TYPE_LINK "filterStructVehSpd" /end STRUCTURE_COMPONENT
 /begin STRUCTURE_COMPONENT filterStructVehAccel Tdfd 56 SYMBOL_TYPE_LINK "filterStructVehAccel" /end STRUCTURE_COMPONENT
 /begin STRUCTURE_COMPONENT filterStructWhlAccel Tdfd 96 MATRIX_DIM 4 SYMBOL_TYPE_LINK "filterStructWhlAccel" /end STRUCTURE_COMPONENT
 /begin STRUCTURE_COMPONENT corrdWhlSpd tMetrePerSecond 256 MATRIX_DIM 4 SYMBOL_TYPE_LINK "corrdWhlSpd" /end STRUCTURE_COMPONENT
 /begin STRUCTURE_COMPONENT corrdWhlSpdFrntAvg tMetrePerSecond 272 SYMBOL_TYPE_LINK "corrdWhlSpdFrntAvg" /end STRUCTURE_COMPONENT
 /begin STRUCTURE_COMPONENT corrdWhlSpdReAvg tMetrePerSecond 276 SYMBOL_TYPE_LINK "corrdWhlSpdReAvg" /end STRUCTURE_COMPONENT
 /begin STRUCTURE_COMPONENT wheelbasedVehSpd tMetrePerSecond 280 SYMBOL_TYPE_LINK "wheelbasedVehSpd" /end STRUCTURE_COMPONENT
 /begin STRUCTURE_COMPONENT wheelbasedVehSpdRaw tMetrePerSecond 284 SYMBOL_TYPE_LINK "wheelbasedVehSpdRaw" /end STRUCTURE_COMPONENT
 /begin STRUCTURE_COMPONENT wheelAcceleration tMetrePerSquareSecond 288 MATRIX_DIM 4 SYMBOL_TYPE_LINK "wheelAcceleration" /end STRUCTURE_COMPONENT
 /begin STRUCTURE_COMPONENT wheelbasedVehAcc tMetrePerSquareSecond 304 SYMBOL_TYPE_LINK "wheelbasedVehAcc" /end STRUCTURE_COMPONENT
 /begin STRUCTURE_COMPONENT wheelbasedVehSpdQ tQualifier 308 SYMBOL_TYPE_LINK "wheelbasedVehSpdQ" /end STRUCTURE_COMPONENT
/end TYPEDEF_STRUCTURE
/begin TYPEDEF_STRUCTURE HomologationSafetyLocals "" 0x160 SYMBOL_TYPE_LINK "HomologationSafetyLocals" /begin STRUCTURE_COMPONENT bInitDone _Bool 0 SYMBOL_TYPE_LINK "bInitDone" /end STRUCTURE_COMPONENT /begin STRUCTURE_COMPONENT avasLocals AvasLocals 4 SYMBOL_TYPE_LINK "avasLocals" /end STRUCTURE_COMPONENT
 /begin STRUCTURE_COMPONENT homlnSftyHomldVehVelLocals HomologatedVehVelLocals 20 SYMBOL_TYPE_LINK "homlnSftyHomldVehVelLocals" /end STRUCTURE_COMPONENT
 /begin STRUCTURE_COMPONENT homlnSftyOdometerLocals OdometerLocals 44 SYMBOL_TYPE_LINK "homlnSftyOdometerLocals" /end STRUCTURE_COMPONENT
 /begin STRUCTURE_COMPONENT homlnSftyTpmsSnsrLocals TpmsSnsrLocals 176 SYMBOL_TYPE_LINK "homlnSftyTpmsSnsrLocals" /end STRUCTURE_COMPONENT
 /begin STRUCTURE_COMPONENT homlnSftyTpmsLocals TpmsLocals 268 SYMBOL_TYPE_LINK "homlnSftyTpmsLocals" /end STRUCTURE_COMPONENT
 /begin STRUCTURE_COMPONENT malfunctionLamp tTpmsWarnLamp 348 SYMBOL_TYPE_LINK "malfunctionLamp" /end STRUCTURE_COMPONENT
/end TYPEDEF_STRUCTURE
/begin TYPEDEF_STRUCTURE DriverTorqueReqLocals "" 0x5CC SYMBOL_TYPE_LINK "DriverTorqueReqLocals" /begin STRUCTURE_COMPONENT bAccrReld _Bool 0 SYMBOL_TYPE_LINK "bAccrReld" /end STRUCTURE_COMPONENT /begin STRUCTURE_COMPONENT bAnyPanelOpen _Bool 1 SYMBOL_TYPE_LINK "bAnyPanelOpen" /end STRUCTURE_COMPONENT
 /begin STRUCTURE_COMPONENT bAnyPanelOpenLowVehVel _Bool 2 SYMBOL_TYPE_LINK "bAnyPanelOpenLowVehVel" /end STRUCTURE_COMPONENT
 /begin STRUCTURE_COMPONENT bInitDone _Bool 3 SYMBOL_TYPE_LINK "bInitDone" /end STRUCTURE_COMPONENT
 /begin STRUCTURE_COMPONENT brkSwtFusedSt tEnableState 4 SYMBOL_TYPE_LINK "brkSwtFusedSt" /end STRUCTURE_COMPONENT
 /begin STRUCTURE_COMPONENT drvrTqReqWhlTqReq tNewtonMetre 8 SYMBOL_TYPE_LINK "drvrTqReqWhlTqReq" /end STRUCTURE_COMPONENT
 /begin STRUCTURE_COMPONENT dtrPedlTqReqLocals PedalTorqueReqLocals 12 SYMBOL_TYPE_LINK "dtrPedlTqReqLocals" /end STRUCTURE_COMPONENT
 /begin STRUCTURE_COMPONENT dtrAdpvCrsCtrlLocals AdaptiveCruiseControlLocals 284 SYMBOL_TYPE_LINK "dtrAdpvCrsCtrlLocals" /end STRUCTURE_COMPONENT
 /begin STRUCTURE_COMPONENT dtrAutDrvrCtrlLocals AutomatedDriverControlLocals 800 SYMBOL_TYPE_LINK "dtrAutDrvrCtrlLocals" /end STRUCTURE_COMPONENT
 /begin STRUCTURE_COMPONENT dtrSpdLimrLocals SpeedLimiterLocals 1156 SYMBOL_TYPE_LINK "dtrSpdLimrLocals" /end STRUCTURE_COMPONENT
/end TYPEDEF_STRUCTURE
/begin TYPEDEF_STRUCTURE EnergyInp "" 0xAC SYMBOL_TYPE_LINK "EnergyInp" /begin STRUCTURE_COMPONENT prplMod tPropulsionMode 0 SYMBOL_TYPE_LINK "prplMod" /end STRUCTURE_COMPONENT
 /begin STRUCTURE_COMPONENT perfStgy tPerformanceStrategy 4 SYMBOL_TYPE_LINK "perfStgy" /end STRUCTURE_COMPONENT
 /begin STRUCTURE_COMPONENT perfMod tPerformanceMode 8 SYMBOL_TYPE_LINK "perfMod" /end STRUCTURE_COMPONENT
 /begin STRUCTURE_COMPONENT propshRate tRadianPerSecond 12 SYMBOL_TYPE_LINK "propshRate" /end STRUCTURE_COMPONENT
 /begin STRUCTURE_COMPONENT brkReq tBar 16 SYMBOL_TYPE_LINK "brkReq" /end STRUCTURE_COMPONENT
 /begin STRUCTURE_COMPONENT propshTqReqTot tNewtonMetre 20 SYMBOL_TYPE_LINK "propshTqReqTot" /end STRUCTURE_COMPONENT
 /begin STRUCTURE_COMPONENT pwrSt tPowerState 24 SYMBOL_TYPE_LINK "pwrSt" /end STRUCTURE_COMPONENT
 /begin STRUCTURE_COMPONENT tmState tTqMacSt 28 SYMBOL_TYPE_LINK "tmState" /end STRUCTURE_COMPONENT
 /begin STRUCTURE_COMPONENT vehAcc tMetrePerSquareSecond 32 SYMBOL_TYPE_LINK "vehAcc" /end STRUCTURE_COMPONENT
 /begin STRUCTURE_COMPONENT vehSpd tMetrePerSecond 36 SYMBOL_TYPE_LINK "vehSpd" /end STRUCTURE_COMPONENT
 /begin STRUCTURE_COMPONENT invState tInvSmStatus 40 SYMBOL_TYPE_LINK "invState" /end STRUCTURE_COMPONENT
 /begin STRUCTURE_COMPONENT chrgBtnReq tEnableState 44 SYMBOL_TYPE_LINK "chrgBtnReq" /end STRUCTURE_COMPONENT
 /begin STRUCTURE_COMPONENT elecTqAllwd _Bool 48 SYMBOL_TYPE_LINK "elecTqAllwd" /end STRUCTURE_COMPONENT
 /begin STRUCTURE_COMPONENT propshRateTar tRadianPerSecond 52 SYMBOL_TYPE_LINK "propshRateTar" /end STRUCTURE_COMPONENT
 /begin STRUCTURE_COMPONENT elecMotSpdTar tRevolutionPerMinute_S16 56 SYMBOL_TYPE_LINK "elecMotSpdTar" /end STRUCTURE_COMPONENT
 /begin STRUCTURE_COMPONENT iceTqMax tNewtonMetre 60 SYMBOL_TYPE_LINK "iceTqMax" /end STRUCTURE_COMPONENT
 /begin STRUCTURE_COMPONENT takeoffSt tTakeoffState 64 SYMBOL_TYPE_LINK "takeoffSt" /end STRUCTURE_COMPONENT
 /begin STRUCTURE_COMPONENT propshTqPwtLoss tNewtonMetre 68 SYMBOL_TYPE_LINK "propshTqPwtLoss" /end STRUCTURE_COMPONENT
 /begin STRUCTURE_COMPONENT bHybDrvTakeoffRdy _Bool 72 SYMBOL_TYPE_LINK "bHybDrvTakeoffRdy" /end STRUCTURE_COMPONENT
 /begin STRUCTURE_COMPONENT bmsSt tBMSState 76 SYMBOL_TYPE_LINK "bmsSt" /end STRUCTURE_COMPONENT
 /begin STRUCTURE_COMPONENT hvBattSoc tPercent 80 SYMBOL_TYPE_LINK "hvBattSoc" /end STRUCTURE_COMPONENT
 /begin STRUCTURE_COMPONENT hvBattSocPred tPercent 84 SYMBOL_TYPE_LINK "hvBattSocPred" /end STRUCTURE_COMPONENT
 /begin STRUCTURE_COMPONENT hvBattSoh tPercent_S8 88 SYMBOL_TYPE_LINK "hvBattSoh" /end STRUCTURE_COMPONENT
 /begin STRUCTURE_COMPONENT hvBattVltg tVolt 92 SYMBOL_TYPE_LINK "hvBattVltg" /end STRUCTURE_COMPONENT
 /begin STRUCTURE_COMPONENT hvBattCrnt tAmpere 96 SYMBOL_TYPE_LINK "hvBattCrnt" /end STRUCTURE_COMPONENT
 /begin STRUCTURE_COMPONENT hvBattCp tKilowattHour 100 SYMBOL_TYPE_LINK "hvBattCp" /end STRUCTURE_COMPONENT
 /begin STRUCTURE_COMPONENT battAvlDchaCrnt tAmpere 104 SYMBOL_TYPE_LINK "battAvlDchaCrnt" /end STRUCTURE_COMPONENT
 /begin STRUCTURE_COMPONENT battAvlChrgCrnt tAmpere 108 SYMBOL_TYPE_LINK "battAvlChrgCrnt" /end STRUCTURE_COMPONENT
 /begin STRUCTURE_COMPONENT elecSysSt tElectricalSystemState 112 SYMBOL_TYPE_LINK "elecSysSt" /end STRUCTURE_COMPONENT
 /begin STRUCTURE_COMPONENT elecMaxTq tNewtonMetre 116 SYMBOL_TYPE_LINK "elecMaxTq" /end STRUCTURE_COMPONENT
 /begin STRUCTURE_COMPONENT elecMinTq tNewtonMetre 120 SYMBOL_TYPE_LINK "elecMinTq" /end STRUCTURE_COMPONENT
 /begin STRUCTURE_COMPONENT elecMotSpd tRevolutionPerMinute_S16 124 SYMBOL_TYPE_LINK "elecMotSpd" /end STRUCTURE_COMPONENT
 /begin STRUCTURE_COMPONENT hybSt tHybSmState 128 SYMBOL_TYPE_LINK "hybSt" /end STRUCTURE_COMPONENT
 /begin STRUCTURE_COMPONENT iceMinTq tNewtonMetre 132 SYMBOL_TYPE_LINK "iceMinTq" /end STRUCTURE_COMPONENT
 /begin STRUCTURE_COMPONENT iceSpd tRevolutionPerMinute_S16 136 SYMBOL_TYPE_LINK "iceSpd" /end STRUCTURE_COMPONENT
 /begin STRUCTURE_COMPONENT iceSpdIdle tRevolutionPerMinute_S16 138 SYMBOL_TYPE_LINK "iceSpdIdle" /end STRUCTURE_COMPONENT
 /begin STRUCTURE_COMPONENT engRunng tEngineRunning 140 SYMBOL_TYPE_LINK "engRunng" /end STRUCTURE_COMPONENT
 /begin STRUCTURE_COMPONENT iceCtrlSt tCombustionEngineControlState 144 SYMBOL_TYPE_LINK "iceCtrlSt" /end STRUCTURE_COMPONENT
 /begin STRUCTURE_COMPONENT iceSysSt tIceSystemState 148 SYMBOL_TYPE_LINK "iceSysSt" /end STRUCTURE_COMPONENT
 /begin STRUCTURE_COMPONENT iceTqEstimd tNewtonMetre 152 SYMBOL_TYPE_LINK "iceTqEstimd" /end STRUCTURE_COMPONENT
 /begin STRUCTURE_COMPONENT trsmOilT tCelsius 156 SYMBOL_TYPE_LINK "trsmOilT" /end STRUCTURE_COMPONENT
 /begin STRUCTURE_COMPONENT auxPwrReq48v tKilowatt 160 SYMBOL_TYPE_LINK "auxPwrReq48v" /end STRUCTURE_COMPONENT
 /begin STRUCTURE_COMPONENT auxPwrReq12v tKilowatt 164 SYMBOL_TYPE_LINK "auxPwrReq12v" /end STRUCTURE_COMPONENT
 /begin STRUCTURE_COMPONENT hydPmpPwr48v tKilowatt 168 SYMBOL_TYPE_LINK "hydPmpPwr48v" /end STRUCTURE_COMPONENT
/end TYPEDEF_STRUCTURE
/begin TYPEDEF_STRUCTURE VsoTireRdLocals "" 0x4C SYMBOL_TYPE_LINK "VsoTireRdLocals" /begin STRUCTURE_COMPONENT initDone _Bool 0 SYMBOL_TYPE_LINK "initDone" /end STRUCTURE_COMPONENT
 /begin STRUCTURE_COMPONENT tireRollgRdRaw tMetre 4 MATRIX_DIM 4 SYMBOL_TYPE_LINK "tireRollgRdRaw" /end STRUCTURE_COMPONENT
 /begin STRUCTURE_COMPONENT tireRollgRdAdaptFilter O1Lpf 20 SYMBOL_TYPE_LINK "tireRollgRdAdaptFilter" /end STRUCTURE_COMPONENT
 /begin STRUCTURE_COMPONENT tireRollgRdAdaptFault _Bool 32 MATRIX_DIM 4 SYMBOL_TYPE_LINK "tireRollgRdAdaptFault" /end STRUCTURE_COMPONENT
 /begin STRUCTURE_COMPONENT tireRollgRd tMetre 36 MATRIX_DIM 4 SYMBOL_TYPE_LINK "tireRollgRd" /end STRUCTURE_COMPONENT
 /begin STRUCTURE_COMPONENT tireRollgRdTqAvg tMetre 52 SYMBOL_TYPE_LINK "tireRollgRdTqAvg" /end STRUCTURE_COMPONENT
 /begin STRUCTURE_COMPONENT tireRollgRdQ tQualifier 56 MATRIX_DIM 4 SYMBOL_TYPE_LINK "tireRollgRdQ" /end STRUCTURE_COMPONENT
 /begin STRUCTURE_COMPONENT tireRollgRdTqAvgQ tQualifier 72 SYMBOL_TYPE_LINK "tireRollgRdTqAvgQ" /end STRUCTURE_COMPONENT
/end TYPEDEF_STRUCTURE
/begin TYPEDEF_STRUCTURE RampLimitCtx "" 0x8 SYMBOL_TYPE_LINK "RampLimitCtx" /begin STRUCTURE_COMPONENT Value _float 0 SYMBOL_TYPE_LINK "Value" /end STRUCTURE_COMPONENT /begin STRUCTURE_COMPONENT Gradient _float 4 SYMBOL_TYPE_LINK "Gradient" /end STRUCTURE_COMPONENT /end TYPEDEF_STRUCTURE
/begin TYPEDEF_STRUCTURE tBrkFldLocals "" 0x18 SYMBOL_TYPE_LINK "tBrkFldLocals"
 /begin STRUCTURE_COMPONENT brkFldOorStamp tMillisecond_U32 0 SYMBOL_TYPE_LINK "brkFldOorStamp" /end STRUCTURE_COMPONENT
 /begin STRUCTURE_COMPONENT brkFldLvlTimer tMillisecond_U32 4 SYMBOL_TYPE_LINK "brkFldLvlTimer" /end STRUCTURE_COMPONENT
 /begin STRUCTURE_COMPONENT brkFldLvl tBrakeFluidLevel 8 SYMBOL_TYPE_LINK "brkFldLvl" /end STRUCTURE_COMPONENT
 /begin STRUCTURE_COMPONENT flagCircLow tDiagnos 12 SYMBOL_TYPE_LINK "flagCircLow" /end STRUCTURE_COMPONENT
 /begin STRUCTURE_COMPONENT flagCircHigh tDiagnos 16 SYMBOL_TYPE_LINK "flagCircHigh" /end STRUCTURE_COMPONENT
 /begin STRUCTURE_COMPONENT BrkFldLvlSnsrFaultMask BrkFldLvlSnsrFaultMask 20 SYMBOL_TYPE_LINK "BrkFldLvlSnsrFaultMask" /end STRUCTURE_COMPONENT
/end TYPEDEF_STRUCTURE
/begin TYPEDEF_STRUCTURE OdometerLocals "" 0x84 SYMBOL_TYPE_LINK "OdometerLocals" /begin STRUCTURE_COMPONENT odoCalcEna _Bool 0 SYMBOL_TYPE_LINK "odoCalcEna" /end STRUCTURE_COMPONENT /begin STRUCTURE_COMPONENT odoSyncIssue _Bool 1 SYMBOL_TYPE_LINK "odoSyncIssue" /end STRUCTURE_COMPONENT /begin STRUCTURE_COMPONENT odoVinSyncIssue _Bool 2 SYMBOL_TYPE_LINK "odoVinSyncIssue" /end STRUCTURE_COMPONENT /begin STRUCTURE_COMPONENT odoVinChg _Bool 3 SYMBOL_TYPE_LINK "odoVinChg" /end STRUCTURE_COMPONENT
 /begin STRUCTURE_COMPONENT prevBadQWhl _Bool 4 MATRIX_DIM 4 SYMBOL_TYPE_LINK "prevBadQWhl" /end STRUCTURE_COMPONENT
 /begin STRUCTURE_COMPONENT cntOvf _Bool 8 MATRIX_DIM 4 SYMBOL_TYPE_LINK "cntOvf" /end STRUCTURE_COMPONENT
 /begin STRUCTURE_COMPONENT syncd _Bool 12 SYMBOL_TYPE_LINK "syncd" /end STRUCTURE_COMPONENT
 /begin STRUCTURE_COMPONENT odoCnt10m _float 16 MATRIX_DIM 4 SYMBOL_TYPE_LINK "odoCnt10m" /end STRUCTURE_COMPONENT
 /begin STRUCTURE_COMPONENT lastKwnVin tAscii 32 MATRIX_DIM 4 SYMBOL_TYPE_LINK "lastKwnVin" /end STRUCTURE_COMPONENT
 /begin STRUCTURE_COMPONENT odoVal tKilometre 36 SYMBOL_TYPE_LINK "odoVal" /end STRUCTURE_COMPONENT
 /begin STRUCTURE_COMPONENT odoSyncStrt tKilometre 40 SYMBOL_TYPE_LINK "odoSyncStrt" /end STRUCTURE_COMPONENT
 /begin STRUCTURE_COMPONENT dstAddLoop tMetre 44 MATRIX_DIM 4 SYMBOL_TYPE_LINK "dstAddLoop" /end STRUCTURE_COMPONENT
 /begin STRUCTURE_COMPONENT odoDstTrip tMetre 60 SYMBOL_TYPE_LINK "odoDstTrip" /end STRUCTURE_COMPONENT
 /begin STRUCTURE_COMPONENT odoDstTripWhl tMetre 64 MATRIX_DIM 4 SYMBOL_TYPE_LINK "odoDstTripWhl" /end STRUCTURE_COMPONENT
 /begin STRUCTURE_COMPONENT odoSyncSt tOdoSyncSt 80 SYMBOL_TYPE_LINK "odoSyncSt" /end STRUCTURE_COMPONENT
 /begin STRUCTURE_COMPONENT odoValQ tQualifier 84 SYMBOL_TYPE_LINK "odoValQ" /end STRUCTURE_COMPONENT
 /begin STRUCTURE_COMPONENT accumCnt uint16_t 88 MATRIX_DIM 4 SYMBOL_TYPE_LINK "accumCnt" /end STRUCTURE_COMPONENT
 /begin STRUCTURE_COMPONENT cntUsedLoop uint16_t 96 MATRIX_DIM 4 SYMBOL_TYPE_LINK "cntUsedLoop" /end STRUCTURE_COMPONENT
 /begin STRUCTURE_COMPONENT deltaCnt uint16_t 104 MATRIX_DIM 4 SYMBOL_TYPE_LINK "deltaCnt" /end STRUCTURE_COMPONENT
 /begin STRUCTURE_COMPONENT full10mTrvld uint16_t 112 MATRIX_DIM 4 SYMBOL_TYPE_LINK "full10mTrvld" /end STRUCTURE_COMPONENT
 /begin STRUCTURE_COMPONENT prevCnt uint16_t 120 MATRIX_DIM 4 SYMBOL_TYPE_LINK "prevCnt" /end STRUCTURE_COMPONENT
 /begin STRUCTURE_COMPONENT badQWhlCntr uint8_t 128 SYMBOL_TYPE_LINK "badQWhlCntr" /end STRUCTURE_COMPONENT
/end TYPEDEF_STRUCTURE
/begin TYPEDEF_STRUCTURE EnergyLocals "" 0x13C SYMBOL_TYPE_LINK "EnergyLocals" /begin STRUCTURE_COMPONENT initDone _Bool 0 SYMBOL_TYPE_LINK "initDone" /end STRUCTURE_COMPONENT /begin STRUCTURE_COMPONENT odometer tKilometre 4 SYMBOL_TYPE_LINK "odometer" /end STRUCTURE_COMPONENT
 /begin STRUCTURE_COMPONENT chrgBtnReqPrev tEnableState 8 SYMBOL_TYPE_LINK "chrgBtnReqPrev" /end STRUCTURE_COMPONENT
 /begin STRUCTURE_COMPONENT pwrStPrev tPowerState 12 SYMBOL_TYPE_LINK "pwrStPrev" /end STRUCTURE_COMPONENT
 /begin STRUCTURE_COMPONENT battMaxPwr tKilowatt 16 SYMBOL_TYPE_LINK "battMaxPwr" /end STRUCTURE_COMPONENT
 /begin STRUCTURE_COMPONENT battMinPwr tKilowatt 20 SYMBOL_TYPE_LINK "battMinPwr" /end STRUCTURE_COMPONENT
 /begin STRUCTURE_COMPONENT iceMaxPwr tKilowatt 24 SYMBOL_TYPE_LINK "iceMaxPwr" /end STRUCTURE_COMPONENT
 /begin STRUCTURE_COMPONENT iceMinPwr tKilowatt 28 SYMBOL_TYPE_LINK "iceMinPwr" /end STRUCTURE_COMPONENT
 /begin STRUCTURE_COMPONENT iceIdlePwr tKilowatt 32 SYMBOL_TYPE_LINK "iceIdlePwr" /end STRUCTURE_COMPONENT
 /begin STRUCTURE_COMPONENT elecAvlPosPwr tKilowatt 36 SYMBOL_TYPE_LINK "elecAvlPosPwr" /end STRUCTURE_COMPONENT
 /begin STRUCTURE_COMPONENT elecAvlNegPwr tKilowatt 40 SYMBOL_TYPE_LINK "elecAvlNegPwr" /end STRUCTURE_COMPONENT
 /begin STRUCTURE_COMPONENT elecMaxPwr tKilowatt 44 SYMBOL_TYPE_LINK "elecMaxPwr" /end STRUCTURE_COMPONENT
 /begin STRUCTURE_COMPONENT elecMinPwr tKilowatt 48 SYMBOL_TYPE_LINK "elecMinPwr" /end STRUCTURE_COMPONENT
 /begin STRUCTURE_COMPONENT auxReqPwr tKilowatt 52 SYMBOL_TYPE_LINK "auxReqPwr" /end STRUCTURE_COMPONENT
 /begin STRUCTURE_COMPONENT totPwrReq tKilowatt 56 SYMBOL_TYPE_LINK "totPwrReq" /end STRUCTURE_COMPONENT
 /begin STRUCTURE_COMPONENT propshPwrReq tKilowatt 60 SYMBOL_TYPE_LINK "propshPwrReq" /end STRUCTURE_COMPONENT
 /begin STRUCTURE_COMPONENT propshPwrReqOld tKilowatt 64 SYMBOL_TYPE_LINK "propshPwrReqOld" /end STRUCTURE_COMPONENT
 /begin STRUCTURE_COMPONENT hvBattPwrAct tKilowatt 68 SYMBOL_TYPE_LINK "hvBattPwrAct" /end STRUCTURE_COMPONENT
 /begin STRUCTURE_COMPONENT propshPwrPwtLoss tKilowatt 72 SYMBOL_TYPE_LINK "propshPwrPwtLoss" /end STRUCTURE_COMPONENT
 /begin STRUCTURE_COMPONENT icePwrAct tKilowatt 76 SYMBOL_TYPE_LINK "icePwrAct" /end STRUCTURE_COMPONENT
 /begin STRUCTURE_COMPONENT egyMgrPidIntgrSt tIntegratorState 80 SYMBOL_TYPE_LINK "egyMgrPidIntgrSt" /end STRUCTURE_COMPONENT
 /begin STRUCTURE_COMPONENT socPwrCorrnFB tKilowatt 84 SYMBOL_TYPE_LINK "socPwrCorrnFB" /end STRUCTURE_COMPONENT
 /begin STRUCTURE_COMPONENT socPwrCorrnFF tKilowatt 88 SYMBOL_TYPE_LINK "socPwrCorrnFF" /end STRUCTURE_COMPONENT
 /begin STRUCTURE_COMPONENT socPwrCorrnFltd tKilowatt 92 SYMBOL_TYPE_LINK "socPwrCorrnFltd" /end STRUCTURE_COMPONENT
 /begin STRUCTURE_COMPONENT socCorrLpfCtx O1Lpf 96 SYMBOL_TYPE_LINK "socCorrLpfCtx" /end STRUCTURE_COMPONENT
 /begin STRUCTURE_COMPONENT socPwrCorrnRaw tKilowatt 108 SYMBOL_TYPE_LINK "socPwrCorrnRaw" /end STRUCTURE_COMPONENT
 /begin STRUCTURE_COMPONENT socPwrCorrn tKilowatt 112 SYMBOL_TYPE_LINK "socPwrCorrn" /end STRUCTURE_COMPONENT
 /begin STRUCTURE_COMPONENT elecPwrChrg tKilowatt 116 SYMBOL_TYPE_LINK "elecPwrChrg" /end STRUCTURE_COMPONENT
 /begin STRUCTURE_COMPONENT elecPwrBoost tKilowatt 120 SYMBOL_TYPE_LINK "elecPwrBoost" /end STRUCTURE_COMPONENT
 /begin STRUCTURE_COMPONENT egyMgrPidTimeHrzn tSecond 124 SYMBOL_TYPE_LINK "egyMgrPidTimeHrzn" /end STRUCTURE_COMPONENT
 /begin STRUCTURE_COMPONENT socTgt tPercent 128 SYMBOL_TYPE_LINK "socTgt" /end STRUCTURE_COMPONENT
 /begin STRUCTURE_COMPONENT tranDeplToSust _Bool 132 SYMBOL_TYPE_LINK "tranDeplToSust" /end STRUCTURE_COMPONENT
 /begin STRUCTURE_COMPONENT deltaSoc _float 136 SYMBOL_TYPE_LINK "deltaSoc" /end STRUCTURE_COMPONENT
 /begin STRUCTURE_COMPONENT deltaSocOld _float 140 SYMBOL_TYPE_LINK "deltaSocOld" /end STRUCTURE_COMPONENT
 /begin STRUCTURE_COMPONENT ecmsLam _float 144 SYMBOL_TYPE_LINK "ecmsLam" /end STRUCTURE_COMPONENT
 /begin STRUCTURE_COMPONENT ecmsTheta _float 148 SYMBOL_TYPE_LINK "ecmsTheta" /end STRUCTURE_COMPONENT
 /begin STRUCTURE_COMPONENT ecmsHamiltonian _float 152 SYMBOL_TYPE_LINK "ecmsHamiltonian" /end STRUCTURE_COMPONENT
 /begin STRUCTURE_COMPONENT ecmsIceOptPwr _float 156 SYMBOL_TYPE_LINK "ecmsIceOptPwr" /end STRUCTURE_COMPONENT
 /begin STRUCTURE_COMPONENT ecmsElecMotOptPwr _float 160 SYMBOL_TYPE_LINK "ecmsElecMotOptPwr" /end STRUCTURE_COMPONENT
 /begin STRUCTURE_COMPONENT ecmsDeltaSoc _float 164 SYMBOL_TYPE_LINK "ecmsDeltaSoc" /end STRUCTURE_COMPONENT
 /begin STRUCTURE_COMPONENT fuelMass _float 168 SYMBOL_TYPE_LINK "fuelMass" /end STRUCTURE_COMPONENT
 /begin STRUCTURE_COMPONENT egyMgrPidKp _float 172 SYMBOL_TYPE_LINK "egyMgrPidKp" /end STRUCTURE_COMPONENT
 /begin STRUCTURE_COMPONENT egyMgrPidKi _float 176 SYMBOL_TYPE_LINK "egyMgrPidKi" /end STRUCTURE_COMPONENT
 /begin STRUCTURE_COMPONENT egyMgrPidKd _float 180 SYMBOL_TYPE_LINK "egyMgrPidKd" /end STRUCTURE_COMPONENT
 /begin STRUCTURE_COMPONENT egyMgrPidIntgl _float 184 SYMBOL_TYPE_LINK "egyMgrPidIntgl" /end STRUCTURE_COMPONENT
 /begin STRUCTURE_COMPONENT egyMgrPidIntglLimd _float 188 SYMBOL_TYPE_LINK "egyMgrPidIntglLimd" /end STRUCTURE_COMPONENT
 /begin STRUCTURE_COMPONENT egyMgrPidProp _float 192 SYMBOL_TYPE_LINK "egyMgrPidProp" /end STRUCTURE_COMPONENT
 /begin STRUCTURE_COMPONENT egyMgrPidDeriv _float 196 SYMBOL_TYPE_LINK "egyMgrPidDeriv" /end STRUCTURE_COMPONENT
 /begin STRUCTURE_COMPONENT tmStatePrev tTqMacSt 200 SYMBOL_TYPE_LINK "tmStatePrev" /end STRUCTURE_COMPONENT
 /begin STRUCTURE_COMPONENT socErrRaw _float 204 SYMBOL_TYPE_LINK "socErrRaw" /end STRUCTURE_COMPONENT
 /begin STRUCTURE_COMPONENT evBoostPwr _float 208 SYMBOL_TYPE_LINK "evBoostPwr" /end STRUCTURE_COMPONENT
 /begin STRUCTURE_COMPONENT totPwrReqPrev _float 212 SYMBOL_TYPE_LINK "totPwrReqPrev" /end STRUCTURE_COMPONENT
 /begin STRUCTURE_COMPONENT evBoostRes _float 216 SYMBOL_TYPE_LINK "evBoostRes" /end STRUCTURE_COMPONENT
 /begin STRUCTURE_COMPONENT pwrReqGrad _float 220 SYMBOL_TYPE_LINK "pwrReqGrad" /end STRUCTURE_COMPONENT
 /begin STRUCTURE_COMPONENT evBoostAvl _float 224 SYMBOL_TYPE_LINK "evBoostAvl" /end STRUCTURE_COMPONENT
 /begin STRUCTURE_COMPONENT reessEgyDeltaNet tKilowattHour 228 SYMBOL_TYPE_LINK "reessEgyDeltaNet" /end STRUCTURE_COMPONENT
 /begin STRUCTURE_COMPONENT reessEgyDeltaPos tKilowattHour 232 SYMBOL_TYPE_LINK "reessEgyDeltaPos" /end STRUCTURE_COMPONENT
 /begin STRUCTURE_COMPONENT reessEgyDeltaNeg tKilowattHour 236 SYMBOL_TYPE_LINK "reessEgyDeltaNeg" /end STRUCTURE_COMPONENT
 /begin STRUCTURE_COMPONENT distTrvld tKilometre 240 SYMBOL_TYPE_LINK "distTrvld" /end STRUCTURE_COMPONENT
 /begin STRUCTURE_COMPONENT elecRange tKilometre 244 SYMBOL_TYPE_LINK "elecRange" /end STRUCTURE_COMPONENT
 /begin STRUCTURE_COMPONENT reec _float 248 SYMBOL_TYPE_LINK "reec" /end STRUCTURE_COMPONENT
 /begin STRUCTURE_COMPONENT elecCns _float 252 SYMBOL_TYPE_LINK "elecCns" /end STRUCTURE_COMPONENT
 /begin STRUCTURE_COMPONENT elecCnsDisch _float 256 SYMBOL_TYPE_LINK "elecCnsDisch" /end STRUCTURE_COMPONENT
 /begin STRUCTURE_COMPONENT tqDmdRampCtx RampLimitCtx 260 SYMBOL_TYPE_LINK "tqDmdRampCtx" /end STRUCTURE_COMPONENT
 /begin STRUCTURE_COMPONENT elecMotTqDmdFltdCtx O1Butter 268 SYMBOL_TYPE_LINK "elecMotTqDmdFltdCtx" /end STRUCTURE_COMPONENT
 /begin STRUCTURE_COMPONENT elecMotChrgTqDmdFltdCtx O1Butter 292 SYMBOL_TYPE_LINK "elecMotChrgTqDmdFltdCtx" /end STRUCTURE_COMPONENT
/end TYPEDEF_STRUCTURE
/begin TYPEDEF_STRUCTURE VsoWheelTorquesLocals "" 0x88 SYMBOL_TYPE_LINK "VsoWheelTorquesLocals" /begin STRUCTURE_COMPONENT initDone _Bool 0 SYMBOL_TYPE_LINK "initDone" /end STRUCTURE_COMPONENT
 /begin STRUCTURE_COMPONENT whlTqBrkCoeff _float 4 MATRIX_DIM 4 SYMBOL_TYPE_LINK "whlTqBrkCoeff" /end STRUCTURE_COMPONENT
 /begin STRUCTURE_COMPONENT pFricBrkMaxDegSt tBar_10_S16 20 SYMBOL_TYPE_LINK "pFricBrkMaxDegSt" /end STRUCTURE_COMPONENT
 /begin STRUCTURE_COMPONENT brkTemp tCelsius 24 MATRIX_DIM 4 SYMBOL_TYPE_LINK "brkTemp" /end STRUCTURE_COMPONENT
 /begin STRUCTURE_COMPONENT muBrk tFactor 40 MATRIX_DIM 4 SYMBOL_TYPE_LINK "muBrk" /end STRUCTURE_COMPONENT
 /begin STRUCTURE_COMPONENT whlTq tNewtonMetre 56 MATRIX_DIM 4 SYMBOL_TYPE_LINK "whlTq" /end STRUCTURE_COMPONENT
 /begin STRUCTURE_COMPONENT whlTqBrkMax tNewtonMetre 72 MATRIX_DIM 4 SYMBOL_TYPE_LINK "whlTqBrkMax" /end STRUCTURE_COMPONENT
 /begin STRUCTURE_COMPONENT whlTqBrkMin tNewtonMetre 88 MATRIX_DIM 4 SYMBOL_TYPE_LINK "whlTqBrkMin" /end STRUCTURE_COMPONENT
 /begin STRUCTURE_COMPONENT whlTqBrks tNewtonMetre 104 MATRIX_DIM 4 SYMBOL_TYPE_LINK "whlTqBrks" /end STRUCTURE_COMPONENT
 /begin STRUCTURE_COMPONENT whlTqQ tQualifier 120 MATRIX_DIM 4 SYMBOL_TYPE_LINK "whlTqQ" /end STRUCTURE_COMPONENT
/end TYPEDEF_STRUCTURE
/begin TYPEDEF_STRUCTURE Tdfd "" 0x28 SYMBOL_TYPE_LINK "Tdfd"
 /begin STRUCTURE_COMPONENT normalizedCutoffFreq _float 0 SYMBOL_TYPE_LINK "normalizedCutoffFreq" /end STRUCTURE_COMPONENT
 /begin STRUCTURE_COMPONENT timestep _float 4 SYMBOL_TYPE_LINK "timestep" /end STRUCTURE_COMPONENT
 /begin STRUCTURE_COMPONENT outerFactor _float 8 SYMBOL_TYPE_LINK "outerFactor" /end STRUCTURE_COMPONENT
 /begin STRUCTURE_COMPONENT inputFactor _float 12 SYMBOL_TYPE_LINK "inputFactor" /end STRUCTURE_COMPONENT
 /begin STRUCTURE_COMPONENT outputFactor1 _float 16 SYMBOL_TYPE_LINK "outputFactor1" /end STRUCTURE_COMPONENT
 /begin STRUCTURE_COMPONENT outputFactor2 _float 20 SYMBOL_TYPE_LINK "outputFactor2" /end STRUCTURE_COMPONENT
 /begin STRUCTURE_COMPONENT inputPrevious1 _float 24 SYMBOL_TYPE_LINK "inputPrevious1" /end STRUCTURE_COMPONENT
 /begin STRUCTURE_COMPONENT outputPrevious1 _float 28 SYMBOL_TYPE_LINK "outputPrevious1" /end STRUCTURE_COMPONENT
 /begin STRUCTURE_COMPONENT outputPrevious2 _float 32 SYMBOL_TYPE_LINK "outputPrevious2" /end STRUCTURE_COMPONENT
 /begin STRUCTURE_COMPONENT bInitiated _Bool 36 SYMBOL_TYPE_LINK "bInitiated" /end STRUCTURE_COMPONENT
/end TYPEDEF_STRUCTURE
/begin TYPEDEF_STRUCTURE TpmsSnsrLocals "" 0x5C SYMBOL_TYPE_LINK "TpmsSnsrLocals" /begin STRUCTURE_COMPONENT bIgnActv _Bool 0 SYMBOL_TYPE_LINK "bIgnActv" /end STRUCTURE_COMPONENT
 /begin STRUCTURE_COMPONENT tpmsTireValVld _Bool 1 MATRIX_DIM 4 SYMBOL_TYPE_LINK "tpmsTireValVld" /end STRUCTURE_COMPONENT
 /begin STRUCTURE_COMPONENT tpmsTireP tBar_1000_S16 6 MATRIX_DIM 4 SYMBOL_TYPE_LINK "tpmsTireP" /end STRUCTURE_COMPONENT
 /begin STRUCTURE_COMPONENT tpmsTireT tDegree_10_S16 14 MATRIX_DIM 4 SYMBOL_TYPE_LINK "tpmsTireT" /end STRUCTURE_COMPONENT
 /begin STRUCTURE_COMPONENT tpmsPInvldTmr tMillisecond_U32 24 MATRIX_DIM 4 SYMBOL_TYPE_LINK "tpmsPInvldTmr" /end STRUCTURE_COMPONENT
 /begin STRUCTURE_COMPONENT tpmsTireValQ tQualifier 40 MATRIX_DIM 4 SYMBOL_TYPE_LINK "tpmsTireValQ" /end STRUCTURE_COMPONENT
 /begin STRUCTURE_COMPONENT tpmsSnsrData TpmsSnsrData 56 SYMBOL_TYPE_LINK "tpmsSnsrData" /end STRUCTURE_COMPONENT
/end TYPEDEF_STRUCTURE
/begin TYPEDEF_STRUCTURE EBrakeLocals "" 0x44 SYMBOL_TYPE_LINK "EBrakeLocals"
 /begin STRUCTURE_COMPONENT eBrakeCommand tParkingBrakeRequest 0 SYMBOL_TYPE_LINK "eBrakeCommand" /end STRUCTURE_COMPONENT
 /begin STRUCTURE_COMPONENT runLeftBrake _Bool 4 SYMBOL_TYPE_LINK "runLeftBrake" /end STRUCTURE_COMPONENT
 /begin STRUCTURE_COMPONENT runRightBrake _Bool 5 SYMBOL_TYPE_LINK "runRightBrake" /end STRUCTURE_COMPONENT
 /begin STRUCTURE_COMPONENT bEBrakeForceAdapSave _Bool 6 SYMBOL_TYPE_LINK "bEBrakeForceAdapSave" /end STRUCTURE_COMPONENT
 /begin STRUCTURE_COMPONENT eBrakeState tEBrakeState 8 SYMBOL_TYPE_LINK "eBrakeState" /end STRUCTURE_COMPONENT
 /begin STRUCTURE_COMPONENT eBrakeAdapStPrev tEBrakeState 12 SYMBOL_TYPE_LINK "eBrakeAdapStPrev" /end STRUCTURE_COMPONENT
 /begin STRUCTURE_COMPONENT eBrakeFaults EBrakeFaultMask 16 SYMBOL_TYPE_LINK "eBrakeFaults" /end STRUCTURE_COMPONENT
 /begin STRUCTURE_COMPONENT firstStateRun _Bool 17 SYMBOL_TYPE_LINK "firstStateRun" /end STRUCTURE_COMPONENT
 /begin STRUCTURE_COMPONENT calibrating _Bool 18 SYMBOL_TYPE_LINK "calibrating" /end STRUCTURE_COMPONENT
 /begin STRUCTURE_COMPONENT pwrStIgnPrev _Bool 19 SYMBOL_TYPE_LINK "pwrStIgnPrev" /end STRUCTURE_COMPONENT
 /begin STRUCTURE_COMPONENT leftPosFilter O1Lpf 20 SYMBOL_TYPE_LINK "leftPosFilter" /end STRUCTURE_COMPONENT
 /begin STRUCTURE_COMPONENT rightPosFilter O1Lpf 32 SYMBOL_TYPE_LINK "rightPosFilter" /end STRUCTURE_COMPONENT
 /begin STRUCTURE_COMPONENT leftNegFilter O1Lpf 44 SYMBOL_TYPE_LINK "leftNegFilter" /end STRUCTURE_COMPONENT
 /begin STRUCTURE_COMPONENT rightNegFilter O1Lpf 56 SYMBOL_TYPE_LINK "rightNegFilter" /end STRUCTURE_COMPONENT
/end TYPEDEF_STRUCTURE
/begin TYPEDEF_STRUCTURE VsoSteerLocals "" 0x8 SYMBOL_TYPE_LINK "VsoSteerLocals" /begin STRUCTURE_COMPONENT slipringFrozen _Bool 0 SYMBOL_TYPE_LINK "slipringFrozen" /end STRUCTURE_COMPONENT
 /begin STRUCTURE_COMPONENT lastSlipringNotFrozenTiStamp tMillisecond_U32 4 SYMBOL_TYPE_LINK "lastSlipringNotFrozenTiStamp" /end STRUCTURE_COMPONENT
/end TYPEDEF_STRUCTURE
/begin TYPEDEF_STRUCTURE VsoImuLocals "" 0x2EC SYMBOL_TYPE_LINK "VsoImuLocals" /begin STRUCTURE_COMPONENT initDone _Bool 0 SYMBOL_TYPE_LINK "initDone" /end STRUCTURE_COMPONENT /begin STRUCTURE_COMPONENT variDOmegaZ _float 4 SYMBOL_TYPE_LINK "variDOmegaZ" /end STRUCTURE_COMPONENT
 /begin STRUCTURE_COMPONENT variAccelCog _float 8 MATRIX_DIM 3 SYMBOL_TYPE_LINK "variAccelCog" /end STRUCTURE_COMPONENT
 /begin STRUCTURE_COMPONENT variGyroCog _float 20 SYMBOL_TYPE_LINK "variGyroCog" /end STRUCTURE_COMPONENT
 /begin STRUCTURE_COMPONENT angleError1 tDegree 24 SYMBOL_TYPE_LINK "angleError1" /end STRUCTURE_COMPONENT
 /begin STRUCTURE_COMPONENT angleError2 tDegree 28 SYMBOL_TYPE_LINK "angleError2" /end STRUCTURE_COMPONENT
 /begin STRUCTURE_COMPONENT angleError3 tDegree 32 SYMBOL_TYPE_LINK "angleError3" /end STRUCTURE_COMPONENT
 /begin STRUCTURE_COMPONENT imuCog ImuData 36 SYMBOL_TYPE_LINK "imuCog" /end STRUCTURE_COMPONENT
 /begin STRUCTURE_COMPONENT imuCogFild ImuData 68 SYMBOL_TYPE_LINK "imuCogFild" /end STRUCTURE_COMPONENT
 /begin STRUCTURE_COMPONENT cogAccelVector tMetrePerSquareSecond 100 MATRIX_DIM 3 SYMBOL_TYPE_LINK "cogAccelVector" /end STRUCTURE_COMPONENT
 /begin STRUCTURE_COMPONENT vehYawAccelQ tQualifier 112 SYMBOL_TYPE_LINK "vehYawAccelQ" /end STRUCTURE_COMPONENT
 /begin STRUCTURE_COMPONENT vehRollAg tRadian 116 SYMBOL_TYPE_LINK "vehRollAg" /end STRUCTURE_COMPONENT
 /begin STRUCTURE_COMPONENT vehPitchAg tRadian 120 SYMBOL_TYPE_LINK "vehPitchAg" /end STRUCTURE_COMPONENT
 /begin STRUCTURE_COMPONENT cogGyroVector tRadianPerSecond 124 MATRIX_DIM 3 SYMBOL_TYPE_LINK "cogGyroVector" /end STRUCTURE_COMPONENT
 /begin STRUCTURE_COMPONENT vehYawAccel tRadianPerSquareSecond 136 SYMBOL_TYPE_LINK "vehYawAccel" /end STRUCTURE_COMPONENT
 /begin STRUCTURE_COMPONENT Snsr1 VsoImuLocalSnsr 140 SYMBOL_TYPE_LINK "Snsr1" /end STRUCTURE_COMPONENT
 /begin STRUCTURE_COMPONENT Snsr2 VsoImuLocalSnsr 292 SYMBOL_TYPE_LINK "Snsr2" /end STRUCTURE_COMPONENT
 /begin STRUCTURE_COMPONENT Snsr3 VsoImuLocalSnsr 444 SYMBOL_TYPE_LINK "Snsr3" /end STRUCTURE_COMPONENT
 /begin STRUCTURE_COMPONENT calCntr uint32_t 596 SYMBOL_TYPE_LINK "calCntr" /end STRUCTURE_COMPONENT
 /begin STRUCTURE_COMPONENT errCntr uint32_t 600 SYMBOL_TYPE_LINK "errCntr" /end STRUCTURE_COMPONENT
 /begin STRUCTURE_COMPONENT imuCogAccelFiltCtx O1Butter 604 MATRIX_DIM 3 SYMBOL_TYPE_LINK "imuCogAccelFiltCtx" /end STRUCTURE_COMPONENT
 /begin STRUCTURE_COMPONENT imuCogGyroFiltCtx O1Butter 676 MATRIX_DIM 3 SYMBOL_TYPE_LINK "imuCogGyroFiltCtx" /end STRUCTURE_COMPONENT
/end TYPEDEF_STRUCTURE
/begin TYPEDEF_STRUCTURE CooltSnrsLocals "" 0x94 SYMBOL_TYPE_LINK "CooltSnrsLocals" /begin STRUCTURE_COMPONENT vecTqCooltP tBar_100_S16 0 SYMBOL_TYPE_LINK "vecTqCooltP" /end STRUCTURE_COMPONENT /begin STRUCTURE_COMPONENT cluOilT tCelsius 4 MATRIX_DIM 4 SYMBOL_TYPE_LINK "cluOilT" /end STRUCTURE_COMPONENT
 /begin STRUCTURE_COMPONENT vecTqCooltT tCelsius_10_S16 20 SYMBOL_TYPE_LINK "vecTqCooltT" /end STRUCTURE_COMPONENT
 /begin STRUCTURE_COMPONENT vecTqFrntOilT tCelsius_10_S16 22 SYMBOL_TYPE_LINK "vecTqFrntOilT" /end STRUCTURE_COMPONENT
 /begin STRUCTURE_COMPONENT iceCooltRadrT tCelsius_10_S16 24 SYMBOL_TYPE_LINK "iceCooltRadrT" /end STRUCTURE_COMPONENT
 /begin STRUCTURE_COMPONENT vecTqCooltSnsrPDiagCircLow tDiagnos 28 SYMBOL_TYPE_LINK "vecTqCooltSnsrPDiagCircLow" /end STRUCTURE_COMPONENT
 /begin STRUCTURE_COMPONENT vecTqCooltSnsrPDiagCircHigh tDiagnos 32 SYMBOL_TYPE_LINK "vecTqCooltSnsrPDiagCircHigh" /end STRUCTURE_COMPONENT
 /begin STRUCTURE_COMPONENT vecTqCooltSnsrPDiagOutOfRange tDiagnos 36 SYMBOL_TYPE_LINK "vecTqCooltSnsrPDiagOutOfRange" /end STRUCTURE_COMPONENT
 /begin STRUCTURE_COMPONENT vecTqCooltSnsrTDiagCircLow tDiagnos 40 SYMBOL_TYPE_LINK "vecTqCooltSnsrTDiagCircLow" /end STRUCTURE_COMPONENT
 /begin STRUCTURE_COMPONENT vecTqCooltSnsrTDiagCircHigh tDiagnos 44 SYMBOL_TYPE_LINK "vecTqCooltSnsrTDiagCircHigh" /end STRUCTURE_COMPONENT
 /begin STRUCTURE_COMPONENT vecTqCooltSnsrPCircDiagTimestamp tMillisecond_U32 48 SYMBOL_TYPE_LINK "vecTqCooltSnsrPCircDiagTimestamp" /end STRUCTURE_COMPONENT
 /begin STRUCTURE_COMPONENT vecTqCooltSnsrPOorDiagTimestamp tMillisecond_U32 52 SYMBOL_TYPE_LINK "vecTqCooltSnsrPOorDiagTimestamp" /end STRUCTURE_COMPONENT
 /begin STRUCTURE_COMPONENT vecTqCooltSnsrTCircDiagTimestamp tMillisecond_U32 56 SYMBOL_TYPE_LINK "vecTqCooltSnsrTCircDiagTimestamp" /end STRUCTURE_COMPONENT
 /begin STRUCTURE_COMPONENT vecTqCooltPULastValid tMillivolt_S16 60 SYMBOL_TYPE_LINK "vecTqCooltPULastValid" /end STRUCTURE_COMPONENT
 /begin STRUCTURE_COMPONENT vecTqCooltTULastValid tMillivolt_S16 62 SYMBOL_TYPE_LINK "vecTqCooltTULastValid" /end STRUCTURE_COMPONENT
 /begin STRUCTURE_COMPONENT vecTqCooltTR tOhm 64 SYMBOL_TYPE_LINK "vecTqCooltTR" /end STRUCTURE_COMPONENT
 /begin STRUCTURE_COMPONENT vecTqCooltSnsrFaultMask VecTqCooltSnsrFaultMask 68 SYMBOL_TYPE_LINK "vecTqCooltSnsrFaultMask" /end STRUCTURE_COMPONENT
 /begin STRUCTURE_COMPONENT iceCooltRadrTQ tQualifier 72 SYMBOL_TYPE_LINK "iceCooltRadrTQ" /end STRUCTURE_COMPONENT
 /begin STRUCTURE_COMPONENT vecTqCooltPQ tQualifier 76 SYMBOL_TYPE_LINK "vecTqCooltPQ" /end STRUCTURE_COMPONENT
 /begin STRUCTURE_COMPONENT vecTqFrntOilTQ tQualifier 80 SYMBOL_TYPE_LINK "vecTqFrntOilTQ" /end STRUCTURE_COMPONENT
 /begin STRUCTURE_COMPONENT vecTqCooltTQ tQualifier 84 SYMBOL_TYPE_LINK "vecTqCooltTQ" /end STRUCTURE_COMPONENT
 /begin STRUCTURE_COMPONENT emotCooltP tBar_100_S16 88 SYMBOL_TYPE_LINK "emotCooltP" /end STRUCTURE_COMPONENT
 /begin STRUCTURE_COMPONENT emotCooltPQ tQualifier 92 SYMBOL_TYPE_LINK "emotCooltPQ" /end STRUCTURE_COMPONENT
 /begin STRUCTURE_COMPONENT emotCooltT tCelsius_10_S16 96 SYMBOL_TYPE_LINK "emotCooltT" /end STRUCTURE_COMPONENT
 /begin STRUCTURE_COMPONENT emotCooltTQ tQualifier 100 SYMBOL_TYPE_LINK "emotCooltTQ" /end STRUCTURE_COMPONENT
 /begin STRUCTURE_COMPONENT emotCooltTR tOhm 104 SYMBOL_TYPE_LINK "emotCooltTR" /end STRUCTURE_COMPONENT
 /begin STRUCTURE_COMPONENT emotCooltSnsrPDiagCircLow tDiagnos 108 SYMBOL_TYPE_LINK "emotCooltSnsrPDiagCircLow" /end STRUCTURE_COMPONENT
 /begin STRUCTURE_COMPONENT emotCooltSnsrPDiagCircHigh tDiagnos 112 SYMBOL_TYPE_LINK "emotCooltSnsrPDiagCircHigh" /end STRUCTURE_COMPONENT
 /begin STRUCTURE_COMPONENT emotCooltSnsrPDiagOutOfRange tDiagnos 116 SYMBOL_TYPE_LINK "emotCooltSnsrPDiagOutOfRange" /end STRUCTURE_COMPONENT
 /begin STRUCTURE_COMPONENT emotCooltSnsrTDiagCircLow tDiagnos 120 SYMBOL_TYPE_LINK "emotCooltSnsrTDiagCircLow" /end STRUCTURE_COMPONENT
 /begin STRUCTURE_COMPONENT emotCooltSnsrTDiagCircHigh tDiagnos 124 SYMBOL_TYPE_LINK "emotCooltSnsrTDiagCircHigh" /end STRUCTURE_COMPONENT
 /begin STRUCTURE_COMPONENT emotCooltSnsrPCircDiagTimestamp tMillisecond_U32 128 SYMBOL_TYPE_LINK "emotCooltSnsrPCircDiagTimestamp" /end STRUCTURE_COMPONENT
 /begin STRUCTURE_COMPONENT emotCooltSnsrPOorDiagTimestamp tMillisecond_U32 132 SYMBOL_TYPE_LINK "emotCooltSnsrPOorDiagTimestamp" /end STRUCTURE_COMPONENT
 /begin STRUCTURE_COMPONENT emotCooltSnsrTCircDiagTimestamp tMillisecond_U32 136 SYMBOL_TYPE_LINK "emotCooltSnsrTCircDiagTimestamp" /end STRUCTURE_COMPONENT
 /begin STRUCTURE_COMPONENT emotCooltPULastValid tMillivolt_S16 140 SYMBOL_TYPE_LINK "emotCooltPULastValid" /end STRUCTURE_COMPONENT
 /begin STRUCTURE_COMPONENT emotCooltTULastValid tMillivolt_S16 142 SYMBOL_TYPE_LINK "emotCooltTULastValid" /end STRUCTURE_COMPONENT
 /begin STRUCTURE_COMPONENT emotCooltSnsrFaultMask EmotCooltSnsrFaultMask 144 SYMBOL_TYPE_LINK "emotCooltSnsrFaultMask" /end STRUCTURE_COMPONENT
/end TYPEDEF_STRUCTURE
/begin TYPEDEF_STRUCTURE FrntAxleSnsrFaultMask "" 0x1 SYMBOL_TYPE_LINK "FrntAxleSnsrFaultMask"
 /begin STRUCTURE_COMPONENT frntAxleSnsrFaultMask uint8_t 0 SYMBOL_TYPE_LINK "frntAxleSnsrFaultMask" /end STRUCTURE_COMPONENT
 /begin STRUCTURE_COMPONENT flags FrntAxleSnsrFaultMaskFlags 0 SYMBOL_TYPE_LINK "flags" /end STRUCTURE_COMPONENT
/end TYPEDEF_STRUCTURE
/begin TYPEDEF_STRUCTURE SolnDrvrLocals "" 0x124 SYMBOL_TYPE_LINK "SolnDrvrLocals"
 /begin STRUCTURE_COMPONENT solnDrvrCur tAmpere 0 MATRIX_DIM 4 SYMBOL_TYPE_LINK "solnDrvrCur" /end STRUCTURE_COMPONENT
 /begin STRUCTURE_COMPONENT solnDrvrTemp tCelsius_100_S16 16 MATRIX_DIM 4 SYMBOL_TYPE_LINK "solnDrvrTemp" /end STRUCTURE_COMPONENT
 /begin STRUCTURE_COMPONENT solnDrvrDiagMask uint16_t 24 MATRIX_DIM 4 SYMBOL_TYPE_LINK "solnDrvrDiagMask" /end STRUCTURE_COMPONENT
 /begin STRUCTURE_COMPONENT solnDrvrInitSuccess uint8_t 32 SYMBOL_TYPE_LINK "solnDrvrInitSuccess" /end STRUCTURE_COMPONENT
 /begin STRUCTURE_COMPONENT actvSolnCnt uint8_t 33 SYMBOL_TYPE_LINK "actvSolnCnt" /end STRUCTURE_COMPONENT
 /begin STRUCTURE_COMPONENT solnDrvr SolenoidDriver 36 MATRIX_DIM 4 SYMBOL_TYPE_LINK "solnDrvr" /end STRUCTURE_COMPONENT
/end TYPEDEF_STRUCTURE
/begin TYPEDEF_STRUCTURE ImuData "" 0x20 SYMBOL_TYPE_LINK "ImuData"
 /begin STRUCTURE_COMPONENT accelVector tMetrePerSquareSecond 0 MATRIX_DIM 3 SYMBOL_TYPE_LINK "accelVector" /end STRUCTURE_COMPONENT
 /begin STRUCTURE_COMPONENT gyroVector tRadianPerSecond 12 MATRIX_DIM 3 SYMBOL_TYPE_LINK "gyroVector" /end STRUCTURE_COMPONENT
 /begin STRUCTURE_COMPONENT imuT tCelsius 24 SYMBOL_TYPE_LINK "imuT" /end STRUCTURE_COMPONENT
 /begin STRUCTURE_COMPONENT imuQualifier tQualifier 28 SYMBOL_TYPE_LINK "imuQualifier" /end STRUCTURE_COMPONENT
/end TYPEDEF_STRUCTURE
/begin TYPEDEF_STRUCTURE VsoSteerOutp "" 0xC SYMBOL_TYPE_LINK "VsoSteerOutp" /begin STRUCTURE_COMPONENT steerAg tDegree 0 SYMBOL_TYPE_LINK "steerAg" /end STRUCTURE_COMPONENT
 /begin STRUCTURE_COMPONENT steerAgRate tDegreePerSecond 4 SYMBOL_TYPE_LINK "steerAgRate" /end STRUCTURE_COMPONENT
 /begin STRUCTURE_COMPONENT steerSnsrQ tQualifier 8 SYMBOL_TYPE_LINK "steerSnsrQ" /end STRUCTURE_COMPONENT
/end TYPEDEF_STRUCTURE
/begin TYPEDEF_STRUCTURE VsoWheelAnglesLocals "" 0x2C SYMBOL_TYPE_LINK "VsoWheelAnglesLocals" /begin STRUCTURE_COMPONENT initDone _Bool 0 SYMBOL_TYPE_LINK "initDone" /end STRUCTURE_COMPONENT
 /begin STRUCTURE_COMPONENT whlAgDeg tDegree_10_S16 2 MATRIX_DIM 4 SYMBOL_TYPE_LINK "whlAgDeg" /end STRUCTURE_COMPONENT
 /begin STRUCTURE_COMPONENT whlAg tRadian 12 MATRIX_DIM 4 SYMBOL_TYPE_LINK "whlAg" /end STRUCTURE_COMPONENT
 /begin STRUCTURE_COMPONENT whlAgQ tQualifier 28 MATRIX_DIM 4 SYMBOL_TYPE_LINK "whlAgQ" /end STRUCTURE_COMPONENT
/end TYPEDEF_STRUCTURE
/begin TYPEDEF_STRUCTURE O1Lpf "" 0xC SYMBOL_TYPE_LINK "O1Lpf" /begin STRUCTURE_COMPONENT input _float 0 SYMBOL_TYPE_LINK "input" /end STRUCTURE_COMPONENT /begin STRUCTURE_COMPONENT previous _float 4 SYMBOL_TYPE_LINK "previous" /end STRUCTURE_COMPONENT /begin STRUCTURE_COMPONENT coeff _float 8 SYMBOL_TYPE_LINK "coeff" /end STRUCTURE_COMPONENT /end TYPEDEF_STRUCTURE
/begin TYPEDEF_STRUCTURE WhlCluFrntSnsrFaultMask "" 0x1 SYMBOL_TYPE_LINK "WhlCluFrntSnsrFaultMask"
 /begin STRUCTURE_COMPONENT whlCluFrntSnsrFaultMask uint8_t 0 SYMBOL_TYPE_LINK "whlCluFrntSnsrFaultMask" /end STRUCTURE_COMPONENT
 /begin STRUCTURE_COMPONENT flags WhlCluFrntSnsrFaultMaskFlags 0 SYMBOL_TYPE_LINK "flags" /end STRUCTURE_COMPONENT
/end TYPEDEF_STRUCTURE
/begin TYPEDEF_STRUCTURE AutomatedDriverControlLocals "" 0x164 SYMBOL_TYPE_LINK "AutomatedDriverControlLocals" /begin STRUCTURE_COMPONENT bInitDone _Bool 0 SYMBOL_TYPE_LINK "bInitDone" /end STRUCTURE_COMPONENT
 /begin STRUCTURE_COMPONENT bIsAutDrvrCtrlActv _Bool 1 SYMBOL_TYPE_LINK "bIsAutDrvrCtrlActv" /end STRUCTURE_COMPONENT
 /begin STRUCTURE_COMPONENT bAutDrvrCtrlAllwd _Bool 2 SYMBOL_TYPE_LINK "bAutDrvrCtrlAllwd" /end STRUCTURE_COMPONENT
 /begin STRUCTURE_COMPONENT bAutDrvrCtrlWindUpDetd _Bool 3 SYMBOL_TYPE_LINK "bAutDrvrCtrlWindUpDetd" /end STRUCTURE_COMPONENT
 /begin STRUCTURE_COMPONENT bVelFbCtrlrEna _Bool 4 SYMBOL_TYPE_LINK "bVelFbCtrlrEna" /end STRUCTURE_COMPONENT
 /begin STRUCTURE_COMPONENT bVelFbCtrlrRst _Bool 5 SYMBOL_TYPE_LINK "bVelFbCtrlrRst" /end STRUCTURE_COMPONENT
 /begin STRUCTURE_COMPONENT bAutDrvrCtrlSatnDwnDetd _Bool 6 SYMBOL_TYPE_LINK "bAutDrvrCtrlSatnDwnDetd" /end STRUCTURE_COMPONENT
 /begin STRUCTURE_COMPONENT bAutDrvrCtrlSatnUpDetd _Bool 7 SYMBOL_TYPE_LINK "bAutDrvrCtrlSatnUpDetd" /end STRUCTURE_COMPONENT
 /begin STRUCTURE_COMPONENT autDrvrCtrlOffRsnBitfie AutDrvrCtrlOffRsnBitfield 8 SYMBOL_TYPE_LINK "autDrvrCtrlOffRsnBitfie" /end STRUCTURE_COMPONENT
 /begin STRUCTURE_COMPONENT filterStructTarVel O1Butter 12 SYMBOL_TYPE_LINK "filterStructTarVel" /end STRUCTURE_COMPONENT
 /begin STRUCTURE_COMPONENT filterStructSetVelGrdt O1Butter 36 SYMBOL_TYPE_LINK "filterStructSetVelGrdt" /end STRUCTURE_COMPONENT
 /begin STRUCTURE_COMPONENT autDrvrCtrlSt tAutomatedDriverControlState 60 SYMBOL_TYPE_LINK "autDrvrCtrlSt" /end STRUCTURE_COMPONENT
 /begin STRUCTURE_COMPONENT autDrvrCtrlStPrev tAutomatedDriverControlState 64 SYMBOL_TYPE_LINK "autDrvrCtrlStPrev" /end STRUCTURE_COMPONENT
 /begin STRUCTURE_COMPONENT drvModPrev tDriveMode 68 SYMBOL_TYPE_LINK "drvModPrev" /end STRUCTURE_COMPONENT
 /begin STRUCTURE_COMPONENT autDrvrCtrlDrvModReq tDriveMode 72 SYMBOL_TYPE_LINK "autDrvrCtrlDrvModReq" /end STRUCTURE_COMPONENT
 /begin STRUCTURE_COMPONENT intgtrSt tIntegratorState 76 SYMBOL_TYPE_LINK "intgtrSt" /end STRUCTURE_COMPONENT
 /begin STRUCTURE_COMPONENT autDrvrCycTarVelPrev tKilometrePerHour_10_S16 80 SYMBOL_TYPE_LINK "autDrvrCycTarVelPrev" /end STRUCTURE_COMPONENT
 /begin STRUCTURE_COMPONENT autDrvrCycTarAccelPrev tKilometrePerHour_10_S16 82 SYMBOL_TYPE_LINK "autDrvrCycTarAccelPrev" /end STRUCTURE_COMPONENT
 /begin STRUCTURE_COMPONENT autDrvrCtrlTarVelMin tKilometrePerHour 84 SYMBOL_TYPE_LINK "autDrvrCtrlTarVelMin" /end STRUCTURE_COMPONENT
 /begin STRUCTURE_COMPONENT autDrvrCtrlTarVelMax tKilometrePerHour 88 SYMBOL_TYPE_LINK "autDrvrCtrlTarVelMax" /end STRUCTURE_COMPONENT
 /begin STRUCTURE_COMPONENT autDrvrCtrlTarVelLimd tKilometrePerHour 92 SYMBOL_TYPE_LINK "autDrvrCtrlTarVelLimd" /end STRUCTURE_COMPONENT
 /begin STRUCTURE_COMPONENT autDrvrCtrlTarVelFild tKilometrePerHour 96 SYMBOL_TYPE_LINK "autDrvrCtrlTarVelFild" /end STRUCTURE_COMPONENT
 /begin STRUCTURE_COMPONENT autDrvrCtrlRefVelErr tKilometrePerHour 100 SYMBOL_TYPE_LINK "autDrvrCtrlRefVelErr" /end STRUCTURE_COMPONENT
 /begin STRUCTURE_COMPONENT autDrvrCtrlRefAccel tKilometrePerHour 104 SYMBOL_TYPE_LINK "autDrvrCtrlRefAccel" /end STRUCTURE_COMPONENT
 /begin STRUCTURE_COMPONENT autDrvrCtrlRefVel tKilometrePerHour 108 SYMBOL_TYPE_LINK "autDrvrCtrlRefVel" /end STRUCTURE_COMPONENT
 /begin STRUCTURE_COMPONENT autDrvrCtrlVehVelLgtKph tKilometrePerHour 112 SYMBOL_TYPE_LINK "autDrvrCtrlVehVelLgtKph" /end STRUCTURE_COMPONENT
 /begin STRUCTURE_COMPONENT autDrvrCtrlTarValExtrap tKilometrePerHour 116 SYMBOL_TYPE_LINK "autDrvrCtrlTarValExtrap" /end STRUCTURE_COMPONENT
 /begin STRUCTURE_COMPONENT autDrvrCtrlTarValStep tKilometrePerHour 120 SYMBOL_TYPE_LINK "autDrvrCtrlTarValStep" /end STRUCTURE_COMPONENT
 /begin STRUCTURE_COMPONENT runtimeMs tMillisecond_U32 124 SYMBOL_TYPE_LINK "runtimeMs" /end STRUCTURE_COMPONENT
 /begin STRUCTURE_COMPONENT autDrvrCtrlAllwdTmr tMillisecond_U32 128 SYMBOL_TYPE_LINK "autDrvrCtrlAllwdTmr" /end STRUCTURE_COMPONENT
 /begin STRUCTURE_COMPONENT autDrvrCtrlRefVelTimer tMillisecond_U32 132 SYMBOL_TYPE_LINK "autDrvrCtrlRefVelTimer" /end STRUCTURE_COMPONENT
 /begin STRUCTURE_COMPONENT autDrvrCtrlDrvModReqTmr tMillisecond_U32 136 SYMBOL_TYPE_LINK "autDrvrCtrlDrvModReqTmr" /end STRUCTURE_COMPONENT
 /begin STRUCTURE_COMPONENT autDrvrCtrlWhlTqReqFf tNewtonMetre 140 SYMBOL_TYPE_LINK "autDrvrCtrlWhlTqReqFf" /end STRUCTURE_COMPONENT
 /begin STRUCTURE_COMPONENT autDrvrCtrlWhlTqReqFb tNewtonMetre 144 SYMBOL_TYPE_LINK "autDrvrCtrlWhlTqReqFb" /end STRUCTURE_COMPONENT
 /begin STRUCTURE_COMPONENT autDrvrCtrlWhlTqReqLimd tNewtonMetre 148 SYMBOL_TYPE_LINK "autDrvrCtrlWhlTqReqLimd" /end STRUCTURE_COMPONENT
 /begin STRUCTURE_COMPONENT autDrvrCtrlWhlTqReqFild tNewtonMetre 152 SYMBOL_TYPE_LINK "autDrvrCtrlWhlTqReqFild" /end STRUCTURE_COMPONENT
 /begin STRUCTURE_COMPONENT autDrvrCtrlWhlTqIntglInit tNewtonMetre 156 SYMBOL_TYPE_LINK "autDrvrCtrlWhlTqIntglInit" /end STRUCTURE_COMPONENT
 /begin STRUCTURE_COMPONENT autDrvrCtrlFfWhlTqCmpCoastDwnDrg tNewtonMetre 160 SYMBOL_TYPE_LINK "autDrvrCtrlFfWhlTqCmpCoastDwnDrg" /end STRUCTURE_COMPONENT
 /begin STRUCTURE_COMPONENT autDrvrCtrlFfWhlTqCmpRoadGrad tNewtonMetre 164 SYMBOL_TYPE_LINK "autDrvrCtrlFfWhlTqCmpRoadGrad" /end STRUCTURE_COMPONENT
 /begin STRUCTURE_COMPONENT autDrvrCtrlFfWhlTqCmpRefAccel tNewtonMetre 168 SYMBOL_TYPE_LINK "autDrvrCtrlFfWhlTqCmpRefAccel" /end STRUCTURE_COMPONENT
 /begin STRUCTURE_COMPONENT autDrvrCtrlVelCtrlrLocals VelocityControllerLocals 172 SYMBOL_TYPE_LINK "autDrvrCtrlVelCtrlrLocals" /end STRUCTURE_COMPONENT
 /begin STRUCTURE_COMPONENT autDrvrCtrlOffMaskOut uint16_t 352 SYMBOL_TYPE_LINK "autDrvrCtrlOffMaskOut" /end STRUCTURE_COMPONENT
/end TYPEDEF_STRUCTURE
/begin TYPEDEF_STRUCTURE AdaptiveCruiseControlLocals "" 0x204 SYMBOL_TYPE_LINK "AdaptiveCruiseControlLocals" /begin STRUCTURE_COMPONENT bInitDone _Bool 0 SYMBOL_TYPE_LINK "bInitDone" /end STRUCTURE_COMPONENT /begin STRUCTURE_COMPONENT runtimeMs tMillisecond_U32 4 SYMBOL_TYPE_LINK "runtimeMs" /end STRUCTURE_COMPONENT
 /begin STRUCTURE_COMPONENT accDrvrTakeOffReq tAdasDriverTakeoffRequest 8 SYMBOL_TYPE_LINK "accDrvrTakeOffReq" /end STRUCTURE_COMPONENT
 /begin STRUCTURE_COMPONENT accDistLvlReq tAccDistanceLevel 12 SYMBOL_TYPE_LINK "accDistLvlReq" /end STRUCTURE_COMPONENT
 /begin STRUCTURE_COMPONENT accDistLvl tAccDistanceLevel 16 SYMBOL_TYPE_LINK "accDistLvl" /end STRUCTURE_COMPONENT
 /begin STRUCTURE_COMPONENT accSetVelOrDistLvl tAccSetVelOrDist 20 SYMBOL_TYPE_LINK "accSetVelOrDistLvl" /end STRUCTURE_COMPONENT
 /begin STRUCTURE_COMPONENT accStandgActvReq tAccStationaryRequest 24 SYMBOL_TYPE_LINK "accStandgActvReq" /end STRUCTURE_COMPONENT
 /begin STRUCTURE_COMPONENT accStandgActvReqPrev tAccStationaryRequest 28 SYMBOL_TYPE_LINK "accStandgActvReqPrev" /end STRUCTURE_COMPONENT
 /begin STRUCTURE_COMPONENT accSt tAdaptiveCruiseControlState 32 SYMBOL_TYPE_LINK "accSt" /end STRUCTURE_COMPONENT
 /begin STRUCTURE_COMPONENT accStPrev tAdaptiveCruiseControlState 36 SYMBOL_TYPE_LINK "accStPrev" /end STRUCTURE_COMPONENT
 /begin STRUCTURE_COMPONENT accStFvcm tAdaptiveCruiseControlState 40 SYMBOL_TYPE_LINK "accStFvcm" /end STRUCTURE_COMPONENT
 /begin STRUCTURE_COMPONENT accLastActvSt tAdaptiveCruiseControlState 44 SYMBOL_TYPE_LINK "accLastActvSt" /end STRUCTURE_COMPONENT
 /begin STRUCTURE_COMPONENT accStReq tAdaptiveCruiseControlStateRequest 48 SYMBOL_TYPE_LINK "accStReq" /end STRUCTURE_COMPONENT
 /begin STRUCTURE_COMPONENT accDrvrTakeOverReq tAdasDriverTakeoverRequest 52 SYMBOL_TYPE_LINK "accDrvrTakeOverReq" /end STRUCTURE_COMPONENT
 /begin STRUCTURE_COMPONENT accActrResp tAccActuatorResponse 56 SYMBOL_TYPE_LINK "accActrResp" /end STRUCTURE_COMPONENT
 /begin STRUCTURE_COMPONENT accTarAccelCorrd tMetrePerSquareSecond 60 SYMBOL_TYPE_LINK "accTarAccelCorrd" /end STRUCTURE_COMPONENT
 /begin STRUCTURE_COMPONENT accTarAccelCorrdQ tQualifier 64 SYMBOL_TYPE_LINK "accTarAccelCorrdQ" /end STRUCTURE_COMPONENT
 /begin STRUCTURE_COMPONENT brkPrefillReq tAdasRequest 68 SYMBOL_TYPE_LINK "brkPrefillReq" /end STRUCTURE_COMPONENT
 /begin STRUCTURE_COMPONENT brkJerqReq tAdasRequest 72 SYMBOL_TYPE_LINK "brkJerqReq" /end STRUCTURE_COMPONENT
 /begin STRUCTURE_COMPONENT accScrollBtnPosnDeltaFinal int16_t 76 SYMBOL_TYPE_LINK "accScrollBtnPosnDeltaFinal" /end STRUCTURE_COMPONENT
 /begin STRUCTURE_COMPONENT accScrollBtnPosnDeltaIntgl int16_t 78 SYMBOL_TYPE_LINK "accScrollBtnPosnDeltaIntgl" /end STRUCTURE_COMPONENT
 /begin STRUCTURE_COMPONENT accScrollBtnPosnPrev uint8_t 80 SYMBOL_TYPE_LINK "accScrollBtnPosnPrev" /end STRUCTURE_COMPONENT
 /begin STRUCTURE_COMPONENT accStbyInhbMask uint16_t 82 SYMBOL_TYPE_LINK "accStbyInhbMask" /end STRUCTURE_COMPONENT
 /begin STRUCTURE_COMPONENT accVelCtrlActvInhbMask uint16_t 84 SYMBOL_TYPE_LINK "accVelCtrlActvInhbMask" /end STRUCTURE_COMPONENT
 /begin STRUCTURE_COMPONENT accFolCtrlActvInhbMask uint16_t 86 SYMBOL_TYPE_LINK "accFolCtrlActvInhbMask" /end STRUCTURE_COMPONENT
 /begin STRUCTURE_COMPONENT accOffRsnMask uint16_t 88 SYMBOL_TYPE_LINK "accOffRsnMask" /end STRUCTURE_COMPONENT
 /begin STRUCTURE_COMPONENT accVelStbyRsnMask uint16_t 90 SYMBOL_TYPE_LINK "accVelStbyRsnMask" /end STRUCTURE_COMPONENT
 /begin STRUCTURE_COMPONENT accFolStbyRsnMask uint16_t 92 SYMBOL_TYPE_LINK "accFolStbyRsnMask" /end STRUCTURE_COMPONENT
 /begin STRUCTURE_COMPONENT accFolCtrlUnavlRsnMask uint16_t 94 SYMBOL_TYPE_LINK "accFolCtrlUnavlRsnMask" /end STRUCTURE_COMPONENT
 /begin STRUCTURE_COMPONENT accStbyInhbRsnBitfield AccStbyInhbRsnBitfield 96 SYMBOL_TYPE_LINK "accStbyInhbRsnBitfield" /end STRUCTURE_COMPONENT
 /begin STRUCTURE_COMPONENT accVelCtrlInhbRsnBitfield AccVelCtrlInhbRsnBitfield 98 SYMBOL_TYPE_LINK "accVelCtrlInhbRsnBitfield" /end STRUCTURE_COMPONENT
 /begin STRUCTURE_COMPONENT accFolCtrlInhbRsnBitfield AccFolCtrlInhbRsnBitfield 100 SYMBOL_TYPE_LINK "accFolCtrlInhbRsnBitfield" /end STRUCTURE_COMPONENT
 /begin STRUCTURE_COMPONENT accRefVel tKilometrePerHour 104 SYMBOL_TYPE_LINK "accRefVel" /end STRUCTURE_COMPONENT
 /begin STRUCTURE_COMPONENT accVelGrdtLimLowr tKilometrePerHour 108 SYMBOL_TYPE_LINK "accVelGrdtLimLowr" /end STRUCTURE_COMPONENT
 /begin STRUCTURE_COMPONENT accVelGrdtLimUppr tKilometrePerHour 112 SYMBOL_TYPE_LINK "accVelGrdtLimUppr" /end STRUCTURE_COMPONENT
 /begin STRUCTURE_COMPONENT accVelGrdtPerfModeLimLowr tKilometrePerHour 116 SYMBOL_TYPE_LINK "accVelGrdtPerfModeLimLowr" /end STRUCTURE_COMPONENT
 /begin STRUCTURE_COMPONENT accVelGrdtPerfModeLimUppr tKilometrePerHour 120 SYMBOL_TYPE_LINK "accVelGrdtPerfModeLimUppr" /end STRUCTURE_COMPONENT
 /begin STRUCTURE_COMPONENT accVelGrdtVelErrLimLowr tKilometrePerHour 124 SYMBOL_TYPE_LINK "accVelGrdtVelErrLimLowr" /end STRUCTURE_COMPONENT
 /begin STRUCTURE_COMPONENT accVelGrdtVelErrLimUppr tKilometrePerHour 128 SYMBOL_TYPE_LINK "accVelGrdtVelErrLimUppr" /end STRUCTURE_COMPONENT
 /begin STRUCTURE_COMPONENT accLastActvSetVelReq tKilometrePerHour_10_S16 132 SYMBOL_TYPE_LINK "accLastActvSetVelReq" /end STRUCTURE_COMPONENT
 /begin STRUCTURE_COMPONENT accTarVelLimd tKilometrePerHour_10_S16 134 SYMBOL_TYPE_LINK "accTarVelLimd" /end STRUCTURE_COMPONENT
 /begin STRUCTURE_COMPONENT accTarVelLimdMax tKilometrePerHour_10_S16 136 SYMBOL_TYPE_LINK "accTarVelLimdMax" /end STRUCTURE_COMPONENT
 /begin STRUCTURE_COMPONENT accTarVelLimdMin tKilometrePerHour_10_S16 138 SYMBOL_TYPE_LINK "accTarVelLimdMin" /end STRUCTURE_COMPONENT
 /begin STRUCTURE_COMPONENT accTarVelRounded tKilometrePerHour_10_S16 140 SYMBOL_TYPE_LINK "accTarVelRounded" /end STRUCTURE_COMPONENT
 /begin STRUCTURE_COMPONENT accReqLgtVelErr tKilometrePerHour_10_S16 142 SYMBOL_TYPE_LINK "accReqLgtVelErr" /end STRUCTURE_COMPONENT
 /begin STRUCTURE_COMPONENT accSetVelReq tKilometrePerHour_10_S16 144 SYMBOL_TYPE_LINK "accSetVelReq" /end STRUCTURE_COMPONENT
 /begin STRUCTURE_COMPONENT cTestSetVelIncrPrev tKilometrePerHour_10_S16 146 SYMBOL_TYPE_LINK "cTestSetVelIncrPrev" /end STRUCTURE_COMPONENT
 /begin STRUCTURE_COMPONENT accSetVelReqQ tQualifier 148 SYMBOL_TYPE_LINK "accSetVelReqQ" /end STRUCTURE_COMPONENT
 /begin STRUCTURE_COMPONENT bAccStbyAllwd _Bool 152 SYMBOL_TYPE_LINK "bAccStbyAllwd" /end STRUCTURE_COMPONENT
 /begin STRUCTURE_COMPONENT bAccVelCtrlActvAllwd _Bool 153 SYMBOL_TYPE_LINK "bAccVelCtrlActvAllwd" /end STRUCTURE_COMPONENT
 /begin STRUCTURE_COMPONENT bAccFolCtrlActvAllwd _Bool 154 SYMBOL_TYPE_LINK "bAccFolCtrlActvAllwd" /end STRUCTURE_COMPONENT
 /begin STRUCTURE_COMPONENT bAccStandgActvFromStbyAllwd _Bool 155 SYMBOL_TYPE_LINK "bAccStandgActvFromStbyAllwd" /end STRUCTURE_COMPONENT
 /begin STRUCTURE_COMPONENT bAccStandgActvFromFolCtrlAllwd _Bool 156 SYMBOL_TYPE_LINK "bAccStandgActvFromFolCtrlAllwd" /end STRUCTURE_COMPONENT
 /begin STRUCTURE_COMPONENT bAccOffTrig _Bool 157 SYMBOL_TYPE_LINK "bAccOffTrig" /end STRUCTURE_COMPONENT
 /begin STRUCTURE_COMPONENT bAccStbyFromVelCtrlTrig _Bool 158 SYMBOL_TYPE_LINK "bAccStbyFromVelCtrlTrig" /end STRUCTURE_COMPONENT
 /begin STRUCTURE_COMPONENT bAccStbyFromFolCtrlTrig _Bool 159 SYMBOL_TYPE_LINK "bAccStbyFromFolCtrlTrig" /end STRUCTURE_COMPONENT
 /begin STRUCTURE_COMPONENT bAccSrvReqdTrig _Bool 160 SYMBOL_TYPE_LINK "bAccSrvReqdTrig" /end STRUCTURE_COMPONENT
 /begin STRUCTURE_COMPONENT bAccErrResetInhb _Bool 161 SYMBOL_TYPE_LINK "bAccErrResetInhb" /end STRUCTURE_COMPONENT
 /begin STRUCTURE_COMPONENT bAccOvrdDetd _Bool 162 SYMBOL_TYPE_LINK "bAccOvrdDetd" /end STRUCTURE_COMPONENT
 /begin STRUCTURE_COMPONENT accOvrdInhb _Bool 163 SYMBOL_TYPE_LINK "accOvrdInhb" /end STRUCTURE_COMPONENT
 /begin STRUCTURE_COMPONENT bAccSatnUpDetd _Bool 164 SYMBOL_TYPE_LINK "bAccSatnUpDetd" /end STRUCTURE_COMPONENT
 /begin STRUCTURE_COMPONENT bAccSatnDownDetd _Bool 165 SYMBOL_TYPE_LINK "bAccSatnDownDetd" /end STRUCTURE_COMPONENT
 /begin STRUCTURE_COMPONENT bAccWindUpDetd _Bool 166 SYMBOL_TYPE_LINK "bAccWindUpDetd" /end STRUCTURE_COMPONENT
 /begin STRUCTURE_COMPONENT bAccTranFromStbyToActv _Bool 167 SYMBOL_TYPE_LINK "bAccTranFromStbyToActv" /end STRUCTURE_COMPONENT
 /begin STRUCTURE_COMPONENT bAccTranFromOvrdToActv _Bool 168 SYMBOL_TYPE_LINK "bAccTranFromOvrdToActv" /end STRUCTURE_COMPONENT
 /begin STRUCTURE_COMPONENT bAccSetVelInc _Bool 169 SYMBOL_TYPE_LINK "bAccSetVelInc" /end STRUCTURE_COMPONENT
 /begin STRUCTURE_COMPONENT bVelFbCtrlrEna _Bool 170 SYMBOL_TYPE_LINK "bVelFbCtrlrEna" /end STRUCTURE_COMPONENT
 /begin STRUCTURE_COMPONENT bVelFbCtrlrRst _Bool 171 SYMBOL_TYPE_LINK "bVelFbCtrlrRst" /end STRUCTURE_COMPONENT
 /begin STRUCTURE_COMPONENT bIsAdpvCrsCtrlActv _Bool 172 SYMBOL_TYPE_LINK "bIsAdpvCrsCtrlActv" /end STRUCTURE_COMPONENT
 /begin STRUCTURE_COMPONENT accFvcmAccelReq tMetrePerSquareSecond 176 SYMBOL_TYPE_LINK "accFvcmAccelReq" /end STRUCTURE_COMPONENT
 /begin STRUCTURE_COMPONENT accFvcmAccelReqLimd tMetrePerSquareSecond 180 SYMBOL_TYPE_LINK "accFvcmAccelReqLimd" /end STRUCTURE_COMPONENT
 /begin STRUCTURE_COMPONENT accRefAccel tMetrePerSquareSecond 184 SYMBOL_TYPE_LINK "accRefAccel" /end STRUCTURE_COMPONENT
 /begin STRUCTURE_COMPONENT accTarAccelGrdtLimLowr tMetrePerSquareSecond 188 SYMBOL_TYPE_LINK "accTarAccelGrdtLimLowr" /end STRUCTURE_COMPONENT
 /begin STRUCTURE_COMPONENT accTarAccelGrdtLimUppr tMetrePerSquareSecond 192 SYMBOL_TYPE_LINK "accTarAccelGrdtLimUppr" /end STRUCTURE_COMPONENT
 /begin STRUCTURE_COMPONENT accVehVelLgtRounded tMetrePerSecond 196 SYMBOL_TYPE_LINK "accVehVelLgtRounded" /end STRUCTURE_COMPONENT
 /begin STRUCTURE_COMPONENT accVehAccelLgtRounded tMetrePerSquareSecond 200 SYMBOL_TYPE_LINK "accVehAccelLgtRounded" /end STRUCTURE_COMPONENT
 /begin STRUCTURE_COMPONENT adpvCrsCtrlVelCtrlrLocals VelocityControllerLocals 204 SYMBOL_TYPE_LINK "adpvCrsCtrlVelCtrlrLocals" /end STRUCTURE_COMPONENT
 /begin STRUCTURE_COMPONENT intgtrSt tIntegratorState 384 SYMBOL_TYPE_LINK "intgtrSt" /end STRUCTURE_COMPONENT
 /begin STRUCTURE_COMPONENT accFfWhlTqCmpCoastDwnDrg tNewtonMetre 388 SYMBOL_TYPE_LINK "accFfWhlTqCmpCoastDwnDrg" /end STRUCTURE_COMPONENT
 /begin STRUCTURE_COMPONENT accFfWhlTqCmpRoadGrad tNewtonMetre 392 SYMBOL_TYPE_LINK "accFfWhlTqCmpRoadGrad" /end STRUCTURE_COMPONENT
 /begin STRUCTURE_COMPONENT accFfWhlTqCmpRefAccel tNewtonMetre 396 SYMBOL_TYPE_LINK "accFfWhlTqCmpRefAccel" /end STRUCTURE_COMPONENT
 /begin STRUCTURE_COMPONENT accWhlTqFb tNewtonMetre 400 SYMBOL_TYPE_LINK "accWhlTqFb" /end STRUCTURE_COMPONENT
 /begin STRUCTURE_COMPONENT accWhlTqFf tNewtonMetre 404 SYMBOL_TYPE_LINK "accWhlTqFf" /end STRUCTURE_COMPONENT
 /begin STRUCTURE_COMPONENT accWhlTqLimd tNewtonMetre 408 SYMBOL_TYPE_LINK "accWhlTqLimd" /end STRUCTURE_COMPONENT
 /begin STRUCTURE_COMPONENT accWhlTqFild tNewtonMetre 412 SYMBOL_TYPE_LINK "accWhlTqFild" /end STRUCTURE_COMPONENT
 /begin STRUCTURE_COMPONENT adpvCrsCtrlWhlTqIntglInit tNewtonMetre 416 SYMBOL_TYPE_LINK "adpvCrsCtrlWhlTqIntglInit" /end STRUCTURE_COMPONENT
 /begin STRUCTURE_COMPONENT accRampdRefVelStruct RampLimitCtx 420 SYMBOL_TYPE_LINK "accRampdRefVelStruct" /end STRUCTURE_COMPONENT
 /begin STRUCTURE_COMPONENT accRampdRefAccelStruct RampLimitCtx 428 SYMBOL_TYPE_LINK "accRampdRefAccelStruct" /end STRUCTURE_COMPONENT
 /begin STRUCTURE_COMPONENT accRampdVelGrdtPrev _float 436 SYMBOL_TYPE_LINK "accRampdVelGrdtPrev" /end STRUCTURE_COMPONENT
 /begin STRUCTURE_COMPONENT filterStructSetVelGrdt O1Butter 440 SYMBOL_TYPE_LINK "filterStructSetVelGrdt" /end STRUCTURE_COMPONENT
 /begin STRUCTURE_COMPONENT accSetVelGrdtFiltCoeff _float 464 SYMBOL_TYPE_LINK "accSetVelGrdtFiltCoeff" /end STRUCTURE_COMPONENT
 /begin STRUCTURE_COMPONENT accStbyAllwdTmr tMillisecond_U32 468 SYMBOL_TYPE_LINK "accStbyAllwdTmr" /end STRUCTURE_COMPONENT
 /begin STRUCTURE_COMPONENT accVelCtrlActvAllwdTmr tMillisecond_U32 472 SYMBOL_TYPE_LINK "accVelCtrlActvAllwdTmr" /end STRUCTURE_COMPONENT
 /begin STRUCTURE_COMPONENT accFolCtrlActvAllwdTmr tMillisecond_U32 476 SYMBOL_TYPE_LINK "accFolCtrlActvAllwdTmr" /end STRUCTURE_COMPONENT
 /begin STRUCTURE_COMPONENT accScrollBtnPosnTmr tMillisecond_U32 480 SYMBOL_TYPE_LINK "accScrollBtnPosnTmr" /end STRUCTURE_COMPONENT
 /begin STRUCTURE_COMPONENT accStandgActvTakeOffReqTmr tMillisecond_U32 484 SYMBOL_TYPE_LINK "accStandgActvTakeOffReqTmr" /end STRUCTURE_COMPONENT
 /begin STRUCTURE_COMPONENT accStandgActvTmr tMillisecond_U32 488 SYMBOL_TYPE_LINK "accStandgActvTmr" /end STRUCTURE_COMPONENT
 /begin STRUCTURE_COMPONENT accOvrdInhbTmr tMillisecond_U32 492 SYMBOL_TYPE_LINK "accOvrdInhbTmr" /end STRUCTURE_COMPONENT
 /begin STRUCTURE_COMPONENT accErrResetWaitTmr tMillisecond_U32 496 SYMBOL_TYPE_LINK "accErrResetWaitTmr" /end STRUCTURE_COMPONENT
 /begin STRUCTURE_COMPONENT accOffRsnMaskOutTmr tMillisecond_U32 500 SYMBOL_TYPE_LINK "accOffRsnMaskOutTmr" /end STRUCTURE_COMPONENT
 /begin STRUCTURE_COMPONENT accVelStbyRsnMaskOutTmr tMillisecond_U32 504 SYMBOL_TYPE_LINK "accVelStbyRsnMaskOutTmr" /end STRUCTURE_COMPONENT
 /begin STRUCTURE_COMPONENT accFolStbyRsnMaskOutTmr tMillisecond_U32 508 SYMBOL_TYPE_LINK "accFolStbyRsnMaskOutTmr" /end STRUCTURE_COMPONENT
 /begin STRUCTURE_COMPONENT accEyeqBlkdRsnMaskOutTmr tMillisecond_U32 512 SYMBOL_TYPE_LINK "accEyeqBlkdRsnMaskOutTmr" /end STRUCTURE_COMPONENT
/end TYPEDEF_STRUCTURE
/begin TYPEDEF_STRUCTURE TireMdlPacejkaParam "" 0x54 SYMBOL_TYPE_LINK "TireMdlPacejkaParam" /begin STRUCTURE_COMPONENT tireMdl tTireModel 0 SYMBOL_TYPE_LINK "tireMdl" /end STRUCTURE_COMPONENT /begin STRUCTURE_COMPONENT B tFactor 4 MATRIX_DIM 2 SYMBOL_TYPE_LINK "B" /end STRUCTURE_COMPONENT /begin STRUCTURE_COMPONENT C tFactor 12 MATRIX_DIM 2 SYMBOL_TYPE_LINK "C" /end STRUCTURE_COMPONENT /begin STRUCTURE_COMPONENT D tFactor 20 MATRIX_DIM 2 SYMBOL_TYPE_LINK "D" /end STRUCTURE_COMPONENT /begin STRUCTURE_COMPONENT E tFactor 28 MATRIX_DIM 2 SYMBOL_TYPE_LINK "E" /end STRUCTURE_COMPONENT /begin STRUCTURE_COMPONENT slipFac tFactor 36 MATRIX_DIM 2 SYMBOL_TYPE_LINK "slipFac" /end STRUCTURE_COMPONENT
 /begin STRUCTURE_COMPONENT slipPeakPosn tFactor 44 MATRIX_DIM 2 SYMBOL_TYPE_LINK "slipPeakPosn" /end STRUCTURE_COMPONENT
 /begin STRUCTURE_COMPONENT slipPeakVal tNewton 52 MATRIX_DIM 2 SYMBOL_TYPE_LINK "slipPeakVal" /end STRUCTURE_COMPONENT
 /begin STRUCTURE_COMPONENT Fz tNewton 60 SYMBOL_TYPE_LINK "Fz" /end STRUCTURE_COMPONENT
 /begin STRUCTURE_COMPONENT Fz0 tNewton 64 SYMBOL_TYPE_LINK "Fz0" /end STRUCTURE_COMPONENT
 /begin STRUCTURE_COMPONENT mu tFactor 68 MATRIX_DIM 2 SYMBOL_TYPE_LINK "mu" /end STRUCTURE_COMPONENT
 /begin STRUCTURE_COMPONENT p tBar 76 SYMBOL_TYPE_LINK "p" /end STRUCTURE_COMPONENT
 /begin STRUCTURE_COMPONENT p0 tBar 80 SYMBOL_TYPE_LINK "p0" /end STRUCTURE_COMPONENT
/end TYPEDEF_STRUCTURE
/begin TYPEDEF_STRUCTURE RateSensorCtx "" 0x34 SYMBOL_TYPE_LINK "RateSensorCtx" /begin STRUCTURE_COMPONENT ratePrev _float 0 SYMBOL_TYPE_LINK "ratePrev" /end STRUCTURE_COMPONENT /begin STRUCTURE_COMPONENT timestep _float 4 SYMBOL_TYPE_LINK "timestep" /end STRUCTURE_COMPONENT /begin STRUCTURE_COMPONENT toothPitch _float 8 SYMBOL_TYPE_LINK "toothPitch" /end STRUCTURE_COMPONENT
 /begin STRUCTURE_COMPONENT snsrSt tSensorState 12 MATRIX_DIM 2 SYMBOL_TYPE_LINK "snsrSt" /end STRUCTURE_COMPONENT
 /begin STRUCTURE_COMPONENT cnt_LR uint32_t 20 MATRIX_DIM 2 SYMBOL_TYPE_LINK "cnt_LR" /end STRUCTURE_COMPONENT
 /begin STRUCTURE_COMPONENT time_LR uint32_t 28 MATRIX_DIM 2 SYMBOL_TYPE_LINK "time_LR" /end STRUCTURE_COMPONENT
 /begin STRUCTURE_COMPONENT timeout uint32_t 36 SYMBOL_TYPE_LINK "timeout" /end STRUCTURE_COMPONENT
 /begin STRUCTURE_COMPONENT timeoutStamp uint32_t 40 MATRIX_DIM 2 SYMBOL_TYPE_LINK "timeoutStamp" /end STRUCTURE_COMPONENT
 /begin STRUCTURE_COMPONENT updateCounter uint32_t 48 SYMBOL_TYPE_LINK "updateCounter" /end STRUCTURE_COMPONENT
/end TYPEDEF_STRUCTURE
/begin TYPEDEF_STRUCTURE O1Butter "" 0x18 SYMBOL_TYPE_LINK "O1Butter"
 /begin STRUCTURE_COMPONENT normalizedCutoffFreq _float 0 SYMBOL_TYPE_LINK "normalizedCutoffFreq" /end STRUCTURE_COMPONENT
 /begin STRUCTURE_COMPONENT outerFactor _float 4 SYMBOL_TYPE_LINK "outerFactor" /end STRUCTURE_COMPONENT
 /begin STRUCTURE_COMPONENT outputFactor _float 8 SYMBOL_TYPE_LINK "outputFactor" /end STRUCTURE_COMPONENT
 /begin STRUCTURE_COMPONENT inputPrevious _float 12 SYMBOL_TYPE_LINK "inputPrevious" /end STRUCTURE_COMPONENT
 /begin STRUCTURE_COMPONENT outputPrevious _float 16 SYMBOL_TYPE_LINK "outputPrevious" /end STRUCTURE_COMPONENT
 /begin STRUCTURE_COMPONENT bInitiated _Bool 20 SYMBOL_TYPE_LINK "bInitiated" /end STRUCTURE_COMPONENT
/end TYPEDEF_STRUCTURE
/begin TYPEDEF_STRUCTURE VsoDynStObsvrLocals "" 0x68 SYMBOL_TYPE_LINK "VsoDynStObsvrLocals"
 /begin STRUCTURE_COMPONENT odeExplicitFallback _Bool 0 SYMBOL_TYPE_LINK "odeExplicitFallback" /end STRUCTURE_COMPONENT
 /begin STRUCTURE_COMPONENT dsoStDeriv _float 4 MATRIX_DIM 2 SYMBOL_TYPE_LINK "dsoStDeriv" /end STRUCTURE_COMPONENT
 /begin STRUCTURE_COMPONENT dsoStEst _float 12 MATRIX_DIM 2 SYMBOL_TYPE_LINK "dsoStEst" /end STRUCTURE_COMPONENT
 /begin STRUCTURE_COMPONENT dsoStIni _float 20 MATRIX_DIM 2 SYMBOL_TYPE_LINK "dsoStIni" /end STRUCTURE_COMPONENT
 /begin STRUCTURE_COMPONENT dsoInp _float 28 MATRIX_DIM 1 SYMBOL_TYPE_LINK "dsoInp" /end STRUCTURE_COMPONENT
 /begin STRUCTURE_COMPONENT dsoParams VsoDynStObsvrParams 32 SYMBOL_TYPE_LINK "dsoParams" /end STRUCTURE_COMPONENT
/end TYPEDEF_STRUCTURE
/begin TYPEDEF_STRUCTURE TpmsLocals "" 0x50 SYMBOL_TYPE_LINK "TpmsLocals"
 /begin STRUCTURE_COMPONENT anyTpmsSnsrInvld _Bool 0 SYMBOL_TYPE_LINK "anyTpmsSnsrInvld" /end STRUCTURE_COMPONENT
 /begin STRUCTURE_COMPONENT bIgnActv _Bool 1 SYMBOL_TYPE_LINK "bIgnActv" /end STRUCTURE_COMPONENT
 /begin STRUCTURE_COMPONENT ignActvPrev _Bool 2 SYMBOL_TYPE_LINK "ignActvPrev" /end STRUCTURE_COMPONENT
 /begin STRUCTURE_COMPONENT tpmsMalfunctionDetd _Bool 3 SYMBOL_TYPE_LINK "tpmsMalfunctionDetd" /end STRUCTURE_COMPONENT
 /begin STRUCTURE_COMPONENT tpmsMinSpdReached _Bool 4 SYMBOL_TYPE_LINK "tpmsMinSpdReached" /end STRUCTURE_COMPONENT
 /begin STRUCTURE_COMPONENT tpmsTireFlatP _Bool 5 MATRIX_DIM 4 SYMBOL_TYPE_LINK "tpmsTireFlatP" /end STRUCTURE_COMPONENT
 /begin STRUCTURE_COMPONENT tpmsTireLowP _Bool 9 MATRIX_DIM 4 SYMBOL_TYPE_LINK "tpmsTireLowP" /end STRUCTURE_COMPONENT
 /begin STRUCTURE_COMPONENT tpmsTireLowPDetd _Bool 13 SYMBOL_TYPE_LINK "tpmsTireLowPDetd" /end STRUCTURE_COMPONENT
 /begin STRUCTURE_COMPONENT tpmsTireOverP _Bool 14 MATRIX_DIM 4 SYMBOL_TYPE_LINK "tpmsTireOverP" /end STRUCTURE_COMPONENT
 /begin STRUCTURE_COMPONENT tpmsWarnLampInhbBelowMinSpd _Bool 18 SYMBOL_TYPE_LINK "tpmsWarnLampInhbBelowMinSpd" /end STRUCTURE_COMPONENT
 /begin STRUCTURE_COMPONENT tpmsMinP tBar_1000_S16 20 MATRIX_DIM 4 SYMBOL_TYPE_LINK "tpmsMinP" /end STRUCTURE_COMPONENT
 /begin STRUCTURE_COMPONENT tpmsSpdLim tKilometrePerHour_10_S16 28 SYMBOL_TYPE_LINK "tpmsSpdLim" /end STRUCTURE_COMPONENT
 /begin STRUCTURE_COMPONENT tpmsSpdLimMax tKilometrePerHour_10_S16 30 SYMBOL_TYPE_LINK "tpmsSpdLimMax" /end STRUCTURE_COMPONENT
 /begin STRUCTURE_COMPONENT tpmsSpdLimMin tKilometrePerHour_10_S16 32 SYMBOL_TYPE_LINK "tpmsSpdLimMin" /end STRUCTURE_COMPONENT
 /begin STRUCTURE_COMPONENT tpmsMalfunctionTmr tMillisecond_U32 36 SYMBOL_TYPE_LINK "tpmsMalfunctionTmr" /end STRUCTURE_COMPONENT
 /begin STRUCTURE_COMPONENT tpmsTirePIssueTmr tMillisecond_U32 40 SYMBOL_TYPE_LINK "tpmsTirePIssueTmr" /end STRUCTURE_COMPONENT
 /begin STRUCTURE_COMPONENT tpmsWarnLampFlsgTmr tMillisecond_U32 44 SYMBOL_TYPE_LINK "tpmsWarnLampFlsgTmr" /end STRUCTURE_COMPONENT
 /begin STRUCTURE_COMPONENT tpmsWarnLampPLossTmr tMillisecond_U32 48 SYMBOL_TYPE_LINK "tpmsWarnLampPLossTmr" /end STRUCTURE_COMPONENT
 /begin STRUCTURE_COMPONENT tpmsSpdLimQ tQualifier 52 SYMBOL_TYPE_LINK "tpmsSpdLimQ" /end STRUCTURE_COMPONENT
 /begin STRUCTURE_COMPONENT tpmsSpdLimHit tTpmsSpdLimHit 56 SYMBOL_TYPE_LINK "tpmsSpdLimHit" /end STRUCTURE_COMPONENT
 /begin STRUCTURE_COMPONENT tpmsTirePSt tTpmsTirePState 60 SYMBOL_TYPE_LINK "tpmsTirePSt" /end STRUCTURE_COMPONENT
 /begin STRUCTURE_COMPONENT tpmsWarnLampSts tTpmsWarnLamp 64 SYMBOL_TYPE_LINK "tpmsWarnLampSts" /end STRUCTURE_COMPONENT
 /begin STRUCTURE_COMPONENT tpmsWarnLampStsPrev tTpmsWarnLamp 68 SYMBOL_TYPE_LINK "tpmsWarnLampStsPrev" /end STRUCTURE_COMPONENT
 /begin STRUCTURE_COMPONENT tpmsWarnLampRsn tTpmsWarnLampRsn 72 SYMBOL_TYPE_LINK "tpmsWarnLampRsn" /end STRUCTURE_COMPONENT
 /begin STRUCTURE_COMPONENT tpmsWarnLampRsnAdaptionTmp tTpmsWarnLampRsn 76 SYMBOL_TYPE_LINK "tpmsWarnLampRsnAdaptionTmp" /end STRUCTURE_COMPONENT
/end TYPEDEF_STRUCTURE
/begin TYPEDEF_STRUCTURE HvRequest "" 0x1 SYMBOL_TYPE_LINK "HvRequest" /begin STRUCTURE_COMPONENT flags HvRequestFlags 0 SYMBOL_TYPE_LINK "flags" /end STRUCTURE_COMPONENT /begin STRUCTURE_COMPONENT raw uint8_t 0 SYMBOL_TYPE_LINK "raw" /end STRUCTURE_COMPONENT /end TYPEDEF_STRUCTURE
/begin TYPEDEF_STRUCTURE WhlCluRearSnsrFaultMask "" 0x1 SYMBOL_TYPE_LINK "WhlCluRearSnsrFaultMask"
 /begin STRUCTURE_COMPONENT whlCluRearSnsrFaultMask uint8_t 0 SYMBOL_TYPE_LINK "whlCluRearSnsrFaultMask" /end STRUCTURE_COMPONENT
 /begin STRUCTURE_COMPONENT flags WhlCluRearSnsrFaultMaskFlags 0 SYMBOL_TYPE_LINK "flags" /end STRUCTURE_COMPONENT
/end TYPEDEF_STRUCTURE
/begin TYPEDEF_STRUCTURE VsoKinStObsvrParams "" 0x48 SYMBOL_TYPE_LINK "VsoKinStObsvrParams" /begin STRUCTURE_COMPONENT yMeasd _float 0 MATRIX_DIM 1 SYMBOL_TYPE_LINK "yMeasd" /end STRUCTURE_COMPONENT /begin STRUCTURE_COMPONENT F _float 4 SYMBOL_TYPE_LINK "F" /end STRUCTURE_COMPONENT /begin STRUCTURE_COMPONENT A _float 8 MATRIX_DIM 2 2 SYMBOL_TYPE_LINK "A" /end STRUCTURE_COMPONENT /begin STRUCTURE_COMPONENT B _float 24 MATRIX_DIM 2 2 SYMBOL_TYPE_LINK "B" /end STRUCTURE_COMPONENT /begin STRUCTURE_COMPONENT C _float 40 MATRIX_DIM 1 2 SYMBOL_TYPE_LINK "C" /end STRUCTURE_COMPONENT /begin STRUCTURE_COMPONENT L _float 48 MATRIX_DIM 2 1 SYMBOL_TYPE_LINK "L" /end STRUCTURE_COMPONENT /begin STRUCTURE_COMPONENT LC _float 56 MATRIX_DIM 2 2 SYMBOL_TYPE_LINK "LC" /end STRUCTURE_COMPONENT /end TYPEDEF_STRUCTURE
/begin TYPEDEF_STRUCTURE PedalAdaption "" 0x8 SYMBOL_TYPE_LINK "PedalAdaption" /begin STRUCTURE_COMPONENT uMin tMillivolt_S32 0 SYMBOL_TYPE_LINK "uMin" /end STRUCTURE_COMPONENT /begin STRUCTURE_COMPONENT uMax tMillivolt_S32 4 SYMBOL_TYPE_LINK "uMax" /end STRUCTURE_COMPONENT /end TYPEDEF_STRUCTURE
/begin TYPEDEF_STRUCTURE HomologatedVehVelLocals "" 0x18 SYMBOL_TYPE_LINK "HomologatedVehVelLocals" /begin STRUCTURE_COMPONENT bInitDone _Bool 0 SYMBOL_TYPE_LINK "bInitDone" /end STRUCTURE_COMPONENT
 /begin STRUCTURE_COMPONENT homldVehVel tKilometrePerHour_10_S16 2 SYMBOL_TYPE_LINK "homldVehVel" /end STRUCTURE_COMPONENT
 /begin STRUCTURE_COMPONENT indcdVehVel tKilometrePerHour_10_S16 4 SYMBOL_TYPE_LINK "indcdVehVel" /end STRUCTURE_COMPONENT
 /begin STRUCTURE_COMPONENT trueVehVelAbs tKilometrePerHour_10_S16 6 SYMBOL_TYPE_LINK "trueVehVelAbs" /end STRUCTURE_COMPONENT
 /begin STRUCTURE_COMPONENT homldVehVelQ tQualifier 8 SYMBOL_TYPE_LINK "homldVehVelQ" /end STRUCTURE_COMPONENT
 /begin STRUCTURE_COMPONENT indcdVehVelQ tQualifier 12 SYMBOL_TYPE_LINK "indcdVehVelQ" /end STRUCTURE_COMPONENT
 /begin STRUCTURE_COMPONENT trueVehVelQ tQualifier 16 SYMBOL_TYPE_LINK "trueVehVelQ" /end STRUCTURE_COMPONENT
 /begin STRUCTURE_COMPONENT trueVehVelSrc tTrueVehVelSrc 20 SYMBOL_TYPE_LINK "trueVehVelSrc" /end STRUCTURE_COMPONENT
/end TYPEDEF_STRUCTURE
/begin TYPEDEF_STRUCTURE AccStbyInhbRsnBitfield "" 0x2 SYMBOL_TYPE_LINK "AccStbyInhbRsnBitfield"
 /begin STRUCTURE_COMPONENT accStbyInhbFlg AccStbyInhbFlg 0 SYMBOL_TYPE_LINK "accStbyInhbFlg" /end STRUCTURE_COMPONENT
 /begin STRUCTURE_COMPONENT accStbyInhbMask uint16_t 0 SYMBOL_TYPE_LINK "accStbyInhbMask" /end STRUCTURE_COMPONENT
/end TYPEDEF_STRUCTURE
/begin TYPEDEF_STRUCTURE VelocityControllerLocals "" 0xB4 SYMBOL_TYPE_LINK "VelocityControllerLocals"
 /begin STRUCTURE_COMPONENT bVelCtrlrWhlTqFfSatnDwnDetd _Bool 0 SYMBOL_TYPE_LINK "bVelCtrlrWhlTqFfSatnDwnDetd" /end STRUCTURE_COMPONENT
 /begin STRUCTURE_COMPONENT bVelCtrlrWhlTqFfSatnUpDetd _Bool 1 SYMBOL_TYPE_LINK "bVelCtrlrWhlTqFfSatnUpDetd" /end STRUCTURE_COMPONENT
 /begin STRUCTURE_COMPONENT bVelCtrlrWhlTqIntglSatnDwnDetd _Bool 2 SYMBOL_TYPE_LINK "bVelCtrlrWhlTqIntglSatnDwnDetd" /end STRUCTURE_COMPONENT
 /begin STRUCTURE_COMPONENT bVelCtrlrWhlTqIntglSatnUpDetd _Bool 3 SYMBOL_TYPE_LINK "bVelCtrlrWhlTqIntglSatnUpDetd" /end STRUCTURE_COMPONENT
 /begin STRUCTURE_COMPONENT bVelCtrlrWhlTqPIDSatnDwnDetd _Bool 4 SYMBOL_TYPE_LINK "bVelCtrlrWhlTqPIDSatnDwnDetd" /end STRUCTURE_COMPONENT
 /begin STRUCTURE_COMPONENT bVelCtrlrWhlTqPIDSatnUpDetd _Bool 5 SYMBOL_TYPE_LINK "bVelCtrlrWhlTqPIDSatnUpDetd" /end STRUCTURE_COMPONENT
 /begin STRUCTURE_COMPONENT bVelCtrlrWhlTqTotSatnDwnDetd _Bool 6 SYMBOL_TYPE_LINK "bVelCtrlrWhlTqTotSatnDwnDetd" /end STRUCTURE_COMPONENT
 /begin STRUCTURE_COMPONENT bVelCtrlrWhlTqTotSatnUpDetd _Bool 7 SYMBOL_TYPE_LINK "bVelCtrlrWhlTqTotSatnUpDetd" /end STRUCTURE_COMPONENT
 /begin STRUCTURE_COMPONENT bVelCtrlrSatnDwnDetd _Bool 8 SYMBOL_TYPE_LINK "bVelCtrlrSatnDwnDetd" /end STRUCTURE_COMPONENT
 /begin STRUCTURE_COMPONENT bVelCtrlrSatnUpDetd _Bool 9 SYMBOL_TYPE_LINK "bVelCtrlrSatnUpDetd" /end STRUCTURE_COMPONENT
 /begin STRUCTURE_COMPONENT bInitDone _Bool 10 SYMBOL_TYPE_LINK "bInitDone" /end STRUCTURE_COMPONENT
 /begin STRUCTURE_COMPONENT velCtrlrWhlTqFilCoeffPrev _float 12 SYMBOL_TYPE_LINK "velCtrlrWhlTqFilCoeffPrev" /end STRUCTURE_COMPONENT
 /begin STRUCTURE_COMPONENT filterStructVelErrDeriv Dfd 16 SYMBOL_TYPE_LINK "filterStructVelErrDeriv" /end STRUCTURE_COMPONENT
 /begin STRUCTURE_COMPONENT velCtrlrOutpWhlTqFilStructO1Butter O1Butter 60 SYMBOL_TYPE_LINK "velCtrlrOutpWhlTqFilStructO1Butter" /end STRUCTURE_COMPONENT
 /begin STRUCTURE_COMPONENT velCtrlrOutpWhlTqFilStructO2Butter O2Butter 84 SYMBOL_TYPE_LINK "velCtrlrOutpWhlTqFilStructO2Butter" /end STRUCTURE_COMPONENT
 /begin STRUCTURE_COMPONENT whlTqFilTypePrev tLowPassFilterType 120 SYMBOL_TYPE_LINK "whlTqFilTypePrev" /end STRUCTURE_COMPONENT
 /begin STRUCTURE_COMPONENT velCtrlrVelErr tMetrePerSecond 124 SYMBOL_TYPE_LINK "velCtrlrVelErr" /end STRUCTURE_COMPONENT
 /begin STRUCTURE_COMPONENT velCtrlrAccelErr tMetrePerSquareSecond 128 SYMBOL_TYPE_LINK "velCtrlrAccelErr" /end STRUCTURE_COMPONENT
 /begin STRUCTURE_COMPONENT velCtrlrWhlTqDeriv tNewtonMetre 132 SYMBOL_TYPE_LINK "velCtrlrWhlTqDeriv" /end STRUCTURE_COMPONENT
 /begin STRUCTURE_COMPONENT velCtrlrWhlTqFfLimd tNewtonMetre 136 SYMBOL_TYPE_LINK "velCtrlrWhlTqFfLimd" /end STRUCTURE_COMPONENT
 /begin STRUCTURE_COMPONENT velCtrlrWhlTqIntgl tNewtonMetre 140 SYMBOL_TYPE_LINK "velCtrlrWhlTqIntgl" /end STRUCTURE_COMPONENT
 /begin STRUCTURE_COMPONENT velCtrlrWhlTqIntglLimd tNewtonMetre 144 SYMBOL_TYPE_LINK "velCtrlrWhlTqIntglLimd" /end STRUCTURE_COMPONENT
 /begin STRUCTURE_COMPONENT velCtrlrWhlTqIntglPrev tNewtonMetre 148 SYMBOL_TYPE_LINK "velCtrlrWhlTqIntglPrev" /end STRUCTURE_COMPONENT
 /begin STRUCTURE_COMPONENT velCtrlrWhlTqOutp tNewtonMetre 152 SYMBOL_TYPE_LINK "velCtrlrWhlTqOutp" /end STRUCTURE_COMPONENT
 /begin STRUCTURE_COMPONENT velCtrlrWhlTqPID tNewtonMetre 156 SYMBOL_TYPE_LINK "velCtrlrWhlTqPID" /end STRUCTURE_COMPONENT
 /begin STRUCTURE_COMPONENT velCtrlrWhlTqPIDLimd tNewtonMetre 160 SYMBOL_TYPE_LINK "velCtrlrWhlTqPIDLimd" /end STRUCTURE_COMPONENT
 /begin STRUCTURE_COMPONENT velCtrlrWhlTqProp tNewtonMetre 164 SYMBOL_TYPE_LINK "velCtrlrWhlTqProp" /end STRUCTURE_COMPONENT
 /begin STRUCTURE_COMPONENT velCtrlrWhlTqTot tNewtonMetre 168 SYMBOL_TYPE_LINK "velCtrlrWhlTqTot" /end STRUCTURE_COMPONENT
 /begin STRUCTURE_COMPONENT velCtrlrWhlTqTotFild tNewtonMetre 172 SYMBOL_TYPE_LINK "velCtrlrWhlTqTotFild" /end STRUCTURE_COMPONENT
 /begin STRUCTURE_COMPONENT velCtrlrWhlTqTotLimd tNewtonMetre 176 SYMBOL_TYPE_LINK "velCtrlrWhlTqTotLimd" /end STRUCTURE_COMPONENT
/end TYPEDEF_STRUCTURE
/begin TYPEDEF_STRUCTURE VecTqCooltSnsrFaultMask "" 0x1 SYMBOL_TYPE_LINK "VecTqCooltSnsrFaultMask"
 /begin STRUCTURE_COMPONENT vecTqCooltSnsrFaultMask uint8_t 0 SYMBOL_TYPE_LINK "vecTqCooltSnsrFaultMask" /end STRUCTURE_COMPONENT
 /begin STRUCTURE_COMPONENT flags VecTqCooltSnsrFaultMaskFlags 0 SYMBOL_TYPE_LINK "flags" /end STRUCTURE_COMPONENT
/end TYPEDEF_STRUCTURE
/begin TYPEDEF_STRUCTURE TpmsSnsrData "" 0x24 SYMBOL_TYPE_LINK "TpmsSnsrData"
 /begin STRUCTURE_COMPONENT tpmsTireT tDegree_10_S16 0 MATRIX_DIM 4 SYMBOL_TYPE_LINK "tpmsTireT" /end STRUCTURE_COMPONENT
 /begin STRUCTURE_COMPONENT tpmsTireP tBar_1000_S16 8 MATRIX_DIM 4 SYMBOL_TYPE_LINK "tpmsTireP" /end STRUCTURE_COMPONENT
 /begin STRUCTURE_COMPONENT tpmsTireValQ tQualifier 16 MATRIX_DIM 4 SYMBOL_TYPE_LINK "tpmsTireValQ" /end STRUCTURE_COMPONENT
 /begin STRUCTURE_COMPONENT tpmsTiout _Bool 32 MATRIX_DIM 4 SYMBOL_TYPE_LINK "tpmsTiout" /end STRUCTURE_COMPONENT
/end TYPEDEF_STRUCTURE
/begin TYPEDEF_STRUCTURE AccVelCtrlInhbRsnBitfield "" 0x2 SYMBOL_TYPE_LINK "AccVelCtrlInhbRsnBitfield"
 /begin STRUCTURE_COMPONENT accVelCtrlInhbFlg AccVelCtrlInhbFlg 0 SYMBOL_TYPE_LINK "accVelCtrlInhbFlg" /end STRUCTURE_COMPONENT
 /begin STRUCTURE_COMPONENT accVelCtrlInhbMask uint16_t 0 SYMBOL_TYPE_LINK "accVelCtrlInhbMask" /end STRUCTURE_COMPONENT
/end TYPEDEF_STRUCTURE
/begin TYPEDEF_STRUCTURE SolenoidDriver "" 0x40 SYMBOL_TYPE_LINK "SolenoidDriver" /begin STRUCTURE_COMPONENT config HardwareConfig 0 SYMBOL_TYPE_LINK "config" /end STRUCTURE_COMPONENT
 /begin STRUCTURE_COMPONENT currentRequest tAmpere 20 SYMBOL_TYPE_LINK "currentRequest" /end STRUCTURE_COMPONENT
 /begin STRUCTURE_COMPONENT ditheringAmplitude tAmpere 24 SYMBOL_TYPE_LINK "ditheringAmplitude" /end STRUCTURE_COMPONENT
 /begin STRUCTURE_COMPONENT ditheringFrequency tHertz 28 SYMBOL_TYPE_LINK "ditheringFrequency" /end STRUCTURE_COMPONENT
 /begin STRUCTURE_COMPONENT ditheringPeakHold _float 32 SYMBOL_TYPE_LINK "ditheringPeakHold" /end STRUCTURE_COMPONENT
 /begin STRUCTURE_COMPONENT diagnostics SolenoidDriverDiagnostics 36 SYMBOL_TYPE_LINK "diagnostics" /end STRUCTURE_COMPONENT
 /begin STRUCTURE_COMPONENT isActive uint64_t_0x80 38 SYMBOL_TYPE_LINK "isActive" /end STRUCTURE_COMPONENT
 /begin STRUCTURE_COMPONENT measurements SolenoidDriverMeasurements 40 SYMBOL_TYPE_LINK "measurements" /end STRUCTURE_COMPONENT
/end TYPEDEF_STRUCTURE
/begin TYPEDEF_STRUCTURE EmotCooltSnsrFaultMask "" 0x1 SYMBOL_TYPE_LINK "EmotCooltSnsrFaultMask"
 /begin STRUCTURE_COMPONENT emotCooltSnsrFaultMask uint8_t 0 SYMBOL_TYPE_LINK "emotCooltSnsrFaultMask" /end STRUCTURE_COMPONENT
 /begin STRUCTURE_COMPONENT flags EmotCooltSnsrFaultMaskFlags 0 SYMBOL_TYPE_LINK "flags" /end STRUCTURE_COMPONENT
/end TYPEDEF_STRUCTURE
/begin TYPEDEF_STRUCTURE AccFolCtrlInhbRsnBitfield "" 0x2 SYMBOL_TYPE_LINK "AccFolCtrlInhbRsnBitfield"
 /begin STRUCTURE_COMPONENT accFolCtrlInhbFlg AccFolCtrlInhbFlg 0 SYMBOL_TYPE_LINK "accFolCtrlInhbFlg" /end STRUCTURE_COMPONENT
 /begin STRUCTURE_COMPONENT accFolCtrlInhbMask uint16_t 0 SYMBOL_TYPE_LINK "accFolCtrlInhbMask" /end STRUCTURE_COMPONENT
/end TYPEDEF_STRUCTURE
/begin TYPEDEF_STRUCTURE AutDrvrCtrlOffRsnBitfield "" 0x2 SYMBOL_TYPE_LINK "AutDrvrCtrlOffRsnBitfield"
 /begin STRUCTURE_COMPONENT autDrvrCtrlOffRsnFlg AutDrvrCtrlOffRsnFlg 0 SYMBOL_TYPE_LINK "autDrvrCtrlOffRsnFlg" /end STRUCTURE_COMPONENT
 /begin STRUCTURE_COMPONENT autDrvrCtrlOffRsnMask uint16_t 0 SYMBOL_TYPE_LINK "autDrvrCtrlOffRsnMask" /end STRUCTURE_COMPONENT
/end TYPEDEF_STRUCTURE
/begin TYPEDEF_STRUCTURE VsoDynStObsvrParams "" 0x48 SYMBOL_TYPE_LINK "VsoDynStObsvrParams" /begin STRUCTURE_COMPONENT yMeasd _float 0 MATRIX_DIM 2 SYMBOL_TYPE_LINK "yMeasd" /end STRUCTURE_COMPONENT /begin STRUCTURE_COMPONENT A _float 8 MATRIX_DIM 2 2 SYMBOL_TYPE_LINK "A" /end STRUCTURE_COMPONENT /begin STRUCTURE_COMPONENT B _float 24 MATRIX_DIM 2 1 SYMBOL_TYPE_LINK "B" /end STRUCTURE_COMPONENT /begin STRUCTURE_COMPONENT C _float 32 MATRIX_DIM 2 2 SYMBOL_TYPE_LINK "C" /end STRUCTURE_COMPONENT /begin STRUCTURE_COMPONENT D _float 48 MATRIX_DIM 2 1 SYMBOL_TYPE_LINK "D" /end STRUCTURE_COMPONENT /begin STRUCTURE_COMPONENT L _float 56 MATRIX_DIM 2 2 SYMBOL_TYPE_LINK "L" /end STRUCTURE_COMPONENT /end TYPEDEF_STRUCTURE
/begin TYPEDEF_STRUCTURE O2Butter "" 0x24 SYMBOL_TYPE_LINK "O2Butter"
 /begin STRUCTURE_COMPONENT normalizedCutoffFreq _float 0 SYMBOL_TYPE_LINK "normalizedCutoffFreq" /end STRUCTURE_COMPONENT
 /begin STRUCTURE_COMPONENT outerFactor _float 4 SYMBOL_TYPE_LINK "outerFactor" /end STRUCTURE_COMPONENT
 /begin STRUCTURE_COMPONENT outputFactor1 _float 8 SYMBOL_TYPE_LINK "outputFactor1" /end STRUCTURE_COMPONENT
 /begin STRUCTURE_COMPONENT outputFactor2 _float 12 SYMBOL_TYPE_LINK "outputFactor2" /end STRUCTURE_COMPONENT
 /begin STRUCTURE_COMPONENT inputPrevious1 _float 16 SYMBOL_TYPE_LINK "inputPrevious1" /end STRUCTURE_COMPONENT
 /begin STRUCTURE_COMPONENT inputPrevious2 _float 20 SYMBOL_TYPE_LINK "inputPrevious2" /end STRUCTURE_COMPONENT
 /begin STRUCTURE_COMPONENT outputPrevious1 _float 24 SYMBOL_TYPE_LINK "outputPrevious1" /end STRUCTURE_COMPONENT
 /begin STRUCTURE_COMPONENT outputPrevious2 _float 28 SYMBOL_TYPE_LINK "outputPrevious2" /end STRUCTURE_COMPONENT
 /begin STRUCTURE_COMPONENT bInitiated _Bool 32 SYMBOL_TYPE_LINK "bInitiated" /end STRUCTURE_COMPONENT
/end TYPEDEF_STRUCTURE
/begin TYPEDEF_STRUCTURE SpeedLimiterLocals "" 0x148 SYMBOL_TYPE_LINK "SpeedLimiterLocals"
 /begin STRUCTURE_COMPONENT bAnyPanelOpenLtch _Bool 0 SYMBOL_TYPE_LINK "bAnyPanelOpenLtch" /end STRUCTURE_COMPONENT
 /begin STRUCTURE_COMPONENT bInitDone _Bool 1 SYMBOL_TYPE_LINK "bInitDone" /end STRUCTURE_COMPONENT
 /begin STRUCTURE_COMPONENT bSpdLimLiftOffDetd _Bool 2 SYMBOL_TYPE_LINK "bSpdLimLiftOffDetd" /end STRUCTURE_COMPONENT
 /begin STRUCTURE_COMPONENT bSpdLimMaskArr _Bool 3 MATRIX_DIM 12 SYMBOL_TYPE_LINK "bSpdLimMaskArr" /end STRUCTURE_COMPONENT
 /begin STRUCTURE_COMPONENT bVelCtrlrSatnDownDetd _Bool 15 SYMBOL_TYPE_LINK "bVelCtrlrSatnDownDetd" /end STRUCTURE_COMPONENT
 /begin STRUCTURE_COMPONENT bVelCtrlrSatnUpDetd _Bool 16 SYMBOL_TYPE_LINK "bVelCtrlrSatnUpDetd" /end STRUCTURE_COMPONENT
 /begin STRUCTURE_COMPONENT bVelFbCtrlrEna _Bool 17 SYMBOL_TYPE_LINK "bVelFbCtrlrEna" /end STRUCTURE_COMPONENT
 /begin STRUCTURE_COMPONENT bVelCtrlrRst _Bool 18 SYMBOL_TYPE_LINK "bVelCtrlrRst" /end STRUCTURE_COMPONENT
 /begin STRUCTURE_COMPONENT spdLimWhlTqSign _float 20 SYMBOL_TYPE_LINK "spdLimWhlTqSign" /end STRUCTURE_COMPONENT
 /begin STRUCTURE_COMPONENT spdLimBitfield SpdLimRsnBitfield 24 SYMBOL_TYPE_LINK "spdLimBitfield" /end STRUCTURE_COMPONENT
 /begin STRUCTURE_COMPONENT filterStructSpdLimWhlTqReq O1Butter 28 SYMBOL_TYPE_LINK "filterStructSpdLimWhlTqReq" /end STRUCTURE_COMPONENT
 /begin STRUCTURE_COMPONENT intgtrSt tIntegratorState 52 SYMBOL_TYPE_LINK "intgtrSt" /end STRUCTURE_COMPONENT
 /begin STRUCTURE_COMPONENT spdLimRampGrdtLimLowr tKilometrePerHour_10_S16 56 SYMBOL_TYPE_LINK "spdLimRampGrdtLimLowr" /end STRUCTURE_COMPONENT
 /begin STRUCTURE_COMPONENT spdLimRampGrdtLimUppr tKilometrePerHour_10_S16 58 SYMBOL_TYPE_LINK "spdLimRampGrdtLimUppr" /end STRUCTURE_COMPONENT
 /begin STRUCTURE_COMPONENT spdLimRampdVelVal tKilometrePerHour_10_S16 60 SYMBOL_TYPE_LINK "spdLimRampdVelVal" /end STRUCTURE_COMPONENT
 /begin STRUCTURE_COMPONENT spdLimThdActvt tKilometrePerHour_10_S16 62 SYMBOL_TYPE_LINK "spdLimThdActvt" /end STRUCTURE_COMPONENT
 /begin STRUCTURE_COMPONENT spdLimThdDeactvt tKilometrePerHour_10_S16 64 SYMBOL_TYPE_LINK "spdLimThdDeactvt" /end STRUCTURE_COMPONENT
 /begin STRUCTURE_COMPONENT spdLimVelCal tKilometrePerHour_10_S16 66 SYMBOL_TYPE_LINK "spdLimVelCal" /end STRUCTURE_COMPONENT
 /begin STRUCTURE_COMPONENT spdLimVel tKilometrePerHour_10_S16 68 SYMBOL_TYPE_LINK "spdLimVel" /end STRUCTURE_COMPONENT
 /begin STRUCTURE_COMPONENT spdLimVelLocalHold tKilometrePerHour_10_S16 70 SYMBOL_TYPE_LINK "spdLimVelLocalHold" /end STRUCTURE_COMPONENT
 /begin STRUCTURE_COMPONENT vehVelAbsKph tKilometrePerHour_10_S16 72 SYMBOL_TYPE_LINK "vehVelAbsKph" /end STRUCTURE_COMPONENT
 /begin STRUCTURE_COMPONENT spdLimLiftOffDetdTmr tMillisecond_U32 76 SYMBOL_TYPE_LINK "spdLimLiftOffDetdTmr" /end STRUCTURE_COMPONENT
 /begin STRUCTURE_COMPONENT spdLimRuntimeMs tMillisecond_U32 80 SYMBOL_TYPE_LINK "spdLimRuntimeMs" /end STRUCTURE_COMPONENT
 /begin STRUCTURE_COMPONENT spdLimVelLimMps tMetrePerSecond 84 SYMBOL_TYPE_LINK "spdLimVelLimMps" /end STRUCTURE_COMPONENT
 /begin STRUCTURE_COMPONENT spdLimFfWhlTqCmpCoastDwnDrg tNewtonMetre 88 SYMBOL_TYPE_LINK "spdLimFfWhlTqCmpCoastDwnDrg" /end STRUCTURE_COMPONENT
 /begin STRUCTURE_COMPONENT spdLimFfWhlTqCmpRoadGrad tNewtonMetre 92 SYMBOL_TYPE_LINK "spdLimFfWhlTqCmpRoadGrad" /end STRUCTURE_COMPONENT
 /begin STRUCTURE_COMPONENT spdLimIntvWhlTqThdActvt tNewtonMetre 96 SYMBOL_TYPE_LINK "spdLimIntvWhlTqThdActvt" /end STRUCTURE_COMPONENT
 /begin STRUCTURE_COMPONENT spdLimIntvWhlTqThdDeactvt tNewtonMetre 100 SYMBOL_TYPE_LINK "spdLimIntvWhlTqThdDeactvt" /end STRUCTURE_COMPONENT
 /begin STRUCTURE_COMPONENT spdLimWhlTqFb tNewtonMetre 104 SYMBOL_TYPE_LINK "spdLimWhlTqFb" /end STRUCTURE_COMPONENT
 /begin STRUCTURE_COMPONENT spdLimWhlTqFf tNewtonMetre 108 SYMBOL_TYPE_LINK "spdLimWhlTqFf" /end STRUCTURE_COMPONENT
 /begin STRUCTURE_COMPONENT spdLimWhlTqFild tNewtonMetre 112 SYMBOL_TYPE_LINK "spdLimWhlTqFild" /end STRUCTURE_COMPONENT
 /begin STRUCTURE_COMPONENT spdLimWhlTqIntglInit tNewtonMetre 116 SYMBOL_TYPE_LINK "spdLimWhlTqIntglInit" /end STRUCTURE_COMPONENT
 /begin STRUCTURE_COMPONENT spdLimWhlTqLimd tNewtonMetre 120 SYMBOL_TYPE_LINK "spdLimWhlTqLimd" /end STRUCTURE_COMPONENT
 /begin STRUCTURE_COMPONENT spdLimWhlTqTot tNewtonMetre 124 SYMBOL_TYPE_LINK "spdLimWhlTqTot" /end STRUCTURE_COMPONENT
 /begin STRUCTURE_COMPONENT spdLimWhlTqTotPrev tNewtonMetre 128 SYMBOL_TYPE_LINK "spdLimWhlTqTotPrev" /end STRUCTURE_COMPONENT
 /begin STRUCTURE_COMPONENT spdLimRampdVelStructLocal RampLimitCtx 132 SYMBOL_TYPE_LINK "spdLimRampdVelStructLocal" /end STRUCTURE_COMPONENT
 /begin STRUCTURE_COMPONENT spdLimActvRsn tSpdLimRsnIdx 140 SYMBOL_TYPE_LINK "spdLimActvRsn" /end STRUCTURE_COMPONENT
 /begin STRUCTURE_COMPONENT spdLimSt tSpeedLimiterState 144 SYMBOL_TYPE_LINK "spdLimSt" /end STRUCTURE_COMPONENT
 /begin STRUCTURE_COMPONENT spdLimVelCtrlrLocals VelocityControllerLocals 148 SYMBOL_TYPE_LINK "spdLimVelCtrlrLocals" /end STRUCTURE_COMPONENT
/end TYPEDEF_STRUCTURE
/begin TYPEDEF_STRUCTURE AvasLocals "" 0x10 SYMBOL_TYPE_LINK "AvasLocals" /begin STRUCTURE_COMPONENT bInitDone _Bool 0 SYMBOL_TYPE_LINK "bInitDone" /end STRUCTURE_COMPONENT /begin STRUCTURE_COMPONENT avasMod tAvasMod 4 SYMBOL_TYPE_LINK "avasMod" /end STRUCTURE_COMPONENT
 /begin STRUCTURE_COMPONENT avasSpeakerReq tEnableState 8 SYMBOL_TYPE_LINK "avasSpeakerReq" /end STRUCTURE_COMPONENT
 /begin STRUCTURE_COMPONENT avasFanFrntReqPerc tPercent_S8 12 SYMBOL_TYPE_LINK "avasFanFrntReqPerc" /end STRUCTURE_COMPONENT
 /begin STRUCTURE_COMPONENT avasFanReReqPerc tPercent_S8 13 SYMBOL_TYPE_LINK "avasFanReReqPerc" /end STRUCTURE_COMPONENT
/end TYPEDEF_STRUCTURE
/begin TYPEDEF_STRUCTURE QuadSensorCtx "" 0x54 SYMBOL_TYPE_LINK "QuadSensorCtx" /begin STRUCTURE_COMPONENT ratePrev _float 0 SYMBOL_TYPE_LINK "ratePrev" /end STRUCTURE_COMPONENT /begin STRUCTURE_COMPONENT timestep _float 4 SYMBOL_TYPE_LINK "timestep" /end STRUCTURE_COMPONENT /begin STRUCTURE_COMPONENT toothPitch _float 8 SYMBOL_TYPE_LINK "toothPitch" /end STRUCTURE_COMPONENT
 /begin STRUCTURE_COMPONENT snsrSt tSensorState 12 MATRIX_DIM 4 SYMBOL_TYPE_LINK "snsrSt" /end STRUCTURE_COMPONENT
 /begin STRUCTURE_COMPONENT cnt_LR uint32_t 28 MATRIX_DIM 4 SYMBOL_TYPE_LINK "cnt_LR" /end STRUCTURE_COMPONENT
 /begin STRUCTURE_COMPONENT time_LR uint32_t 44 MATRIX_DIM 4 SYMBOL_TYPE_LINK "time_LR" /end STRUCTURE_COMPONENT
 /begin STRUCTURE_COMPONENT timeout uint32_t 60 SYMBOL_TYPE_LINK "timeout" /end STRUCTURE_COMPONENT
 /begin STRUCTURE_COMPONENT timeoutStamp uint32_t 64 MATRIX_DIM 4 SYMBOL_TYPE_LINK "timeoutStamp" /end STRUCTURE_COMPONENT
 /begin STRUCTURE_COMPONENT updateCounter uint32_t 80 SYMBOL_TYPE_LINK "updateCounter" /end STRUCTURE_COMPONENT
/end TYPEDEF_STRUCTURE
/begin TYPEDEF_STRUCTURE VsoImuLocalSnsr "" 0x98 SYMBOL_TYPE_LINK "VsoImuLocalSnsr"
 /begin STRUCTURE_COMPONENT CVsoImuAccelVari _float 0 SYMBOL_TYPE_LINK "CVsoImuAccelVari" /end STRUCTURE_COMPONENT
 /begin STRUCTURE_COMPONENT CVsoImuGyroVari _float 4 SYMBOL_TYPE_LINK "CVsoImuGyroVari" /end STRUCTURE_COMPONENT
 /begin STRUCTURE_COMPONENT CVsoImuRotMatrix _float 8 MATRIX_DIM 9 SYMBOL_TYPE_LINK "CVsoImuRotMatrix" /end STRUCTURE_COMPONENT
 /begin STRUCTURE_COMPONENT recursiveSumSquareErrorsAccel _float 44 MATRIX_DIM 3 SYMBOL_TYPE_LINK "recursiveSumSquareErrorsAccel" /end STRUCTURE_COMPONENT
 /begin STRUCTURE_COMPONENT recursiveSumSquareErrorsGyro _float 56 MATRIX_DIM 3 SYMBOL_TYPE_LINK "recursiveSumSquareErrorsGyro" /end STRUCTURE_COMPONENT
 /begin STRUCTURE_COMPONENT variSnsrAccelCog _float 68 MATRIX_DIM 3 SYMBOL_TYPE_LINK "variSnsrAccelCog" /end STRUCTURE_COMPONENT
 /begin STRUCTURE_COMPONENT CVsoImuOffsVect tMetre 80 MATRIX_DIM 3 SYMBOL_TYPE_LINK "CVsoImuOffsVect" /end STRUCTURE_COMPONENT
 /begin STRUCTURE_COMPONENT accelVector tMetrePerSquareSecond 92 MATRIX_DIM 3 SYMBOL_TYPE_LINK "accelVector" /end STRUCTURE_COMPONENT
 /begin STRUCTURE_COMPONENT accelVectorCog tMetrePerSquareSecond 104 MATRIX_DIM 3 SYMBOL_TYPE_LINK "accelVectorCog" /end STRUCTURE_COMPONENT
 /begin STRUCTURE_COMPONENT recursiveAverageAccel tMetrePerSquareSecond 116 MATRIX_DIM 3 SYMBOL_TYPE_LINK "recursiveAverageAccel" /end STRUCTURE_COMPONENT
 /begin STRUCTURE_COMPONENT gyroVector tRadianPerSecond 128 MATRIX_DIM 3 SYMBOL_TYPE_LINK "gyroVector" /end STRUCTURE_COMPONENT
 /begin STRUCTURE_COMPONENT recursiveAverageGyro tRadianPerSecond 140 MATRIX_DIM 3 SYMBOL_TYPE_LINK "recursiveAverageGyro" /end STRUCTURE_COMPONENT
/end TYPEDEF_STRUCTURE
/begin TYPEDEF_STRUCTURE Dfd "" 0x2C SYMBOL_TYPE_LINK "Dfd"
 /begin STRUCTURE_COMPONENT normalizedCutoffFreq _float 0 SYMBOL_TYPE_LINK "normalizedCutoffFreq" /end STRUCTURE_COMPONENT
 /begin STRUCTURE_COMPONENT timestep _float 4 SYMBOL_TYPE_LINK "timestep" /end STRUCTURE_COMPONENT
 /begin STRUCTURE_COMPONENT outerFactor _float 8 SYMBOL_TYPE_LINK "outerFactor" /end STRUCTURE_COMPONENT
 /begin STRUCTURE_COMPONENT inputFactor _float 12 SYMBOL_TYPE_LINK "inputFactor" /end STRUCTURE_COMPONENT
 /begin STRUCTURE_COMPONENT outputFactor1 _float 16 SYMBOL_TYPE_LINK "outputFactor1" /end STRUCTURE_COMPONENT
 /begin STRUCTURE_COMPONENT outputFactor2 _float 20 SYMBOL_TYPE_LINK "outputFactor2" /end STRUCTURE_COMPONENT
 /begin STRUCTURE_COMPONENT inputPrevious1 _float 24 SYMBOL_TYPE_LINK "inputPrevious1" /end STRUCTURE_COMPONENT
 /begin STRUCTURE_COMPONENT inputPrevious2 _float 28 SYMBOL_TYPE_LINK "inputPrevious2" /end STRUCTURE_COMPONENT
 /begin STRUCTURE_COMPONENT outputPrevious1 _float 32 SYMBOL_TYPE_LINK "outputPrevious1" /end STRUCTURE_COMPONENT
 /begin STRUCTURE_COMPONENT outputPrevious2 _float 36 SYMBOL_TYPE_LINK "outputPrevious2" /end STRUCTURE_COMPONENT
 /begin STRUCTURE_COMPONENT bInitiated _Bool 40 SYMBOL_TYPE_LINK "bInitiated" /end STRUCTURE_COMPONENT
/end TYPEDEF_STRUCTURE
/begin TYPEDEF_STRUCTURE PedalTorqueReqLocals "" 0x110 SYMBOL_TYPE_LINK "PedalTorqueReqLocals"
 /begin STRUCTURE_COMPONENT bDrvrAccrPedlPercBto _Bool 0 SYMBOL_TYPE_LINK "bDrvrAccrPedlPercBto" /end STRUCTURE_COMPONENT
 /begin STRUCTURE_COMPONENT bEmgyParkBrkEngd _Bool 1 SYMBOL_TYPE_LINK "bEmgyParkBrkEngd" /end STRUCTURE_COMPONENT
 /begin STRUCTURE_COMPONENT bInitDone _Bool 2 SYMBOL_TYPE_LINK "bInitDone" /end STRUCTURE_COMPONENT
 /begin STRUCTURE_COMPONENT bParkBtnRisngEdge _Bool 3 SYMBOL_TYPE_LINK "bParkBtnRisngEdge" /end STRUCTURE_COMPONENT
 /begin STRUCTURE_COMPONENT bDrvrWhlTqPedlMapEngDragCompEna _Bool 4 SYMBOL_TYPE_LINK "bDrvrWhlTqPedlMapEngDragCompEna" /end STRUCTURE_COMPONENT
 /begin STRUCTURE_COMPONENT drvrWhlTqCubic _float 8 SYMBOL_TYPE_LINK "drvrWhlTqCubic" /end STRUCTURE_COMPONENT
 /begin STRUCTURE_COMPONENT drvrWhlTqSlope _float 12 SYMBOL_TYPE_LINK "drvrWhlTqSlope" /end STRUCTURE_COMPONENT
 /begin STRUCTURE_COMPONENT filterStructDrvrWhlTqReq O1Butter 16 SYMBOL_TYPE_LINK "filterStructDrvrWhlTqReq" /end STRUCTURE_COMPONENT
 /begin STRUCTURE_COMPONENT parkBtnStPrev tEnableState 40 SYMBOL_TYPE_LINK "parkBtnStPrev" /end STRUCTURE_COMPONENT
 /begin STRUCTURE_COMPONENT drvrGearReq tGear 44 SYMBOL_TYPE_LINK "drvrGearReq" /end STRUCTURE_COMPONENT
 /begin STRUCTURE_COMPONENT pedlMapMaxSpd tKilometrePerHour_10_S32 48 SYMBOL_TYPE_LINK "pedlMapMaxSpd" /end STRUCTURE_COMPONENT
 /begin STRUCTURE_COMPONENT pedlMapMaxSpdRamped tKilometrePerHour_10_S32 52 SYMBOL_TYPE_LINK "pedlMapMaxSpdRamped" /end STRUCTURE_COMPONENT
 /begin STRUCTURE_COMPONENT pedlMapVelKph tKilometrePerHour_10_S32 56 SYMBOL_TYPE_LINK "pedlMapVelKph" /end STRUCTURE_COMPONENT
 /begin STRUCTURE_COMPONENT vehVelLgtKphS32 tKilometrePerHour_10_S32 60 SYMBOL_TYPE_LINK "vehVelLgtKphS32" /end STRUCTURE_COMPONENT
 /begin STRUCTURE_COMPONENT shiftReqFreezeTmr tMillisecond_U32 64 SYMBOL_TYPE_LINK "shiftReqFreezeTmr" /end STRUCTURE_COMPONENT
 /begin STRUCTURE_COMPONENT shiftReqTmr tMillisecond_U32 68 SYMBOL_TYPE_LINK "shiftReqTmr" /end STRUCTURE_COMPONENT
 /begin STRUCTURE_COMPONENT timestampEmgyParkBrkEngd tMillisecond_U32 72 SYMBOL_TYPE_LINK "timestampEmgyParkBrkEngd" /end STRUCTURE_COMPONENT
 /begin STRUCTURE_COMPONENT drvrWhlTqDrag tNewtonMetre 76 SYMBOL_TYPE_LINK "drvrWhlTqDrag" /end STRUCTURE_COMPONENT
 /begin STRUCTURE_COMPONENT drvrWhlTqMapPeak tNewtonMetre 80 SYMBOL_TYPE_LINK "drvrWhlTqMapPeak" /end STRUCTURE_COMPONENT
 /begin STRUCTURE_COMPONENT drvrWhlTqMapPeakRamped tNewtonMetre 84 SYMBOL_TYPE_LINK "drvrWhlTqMapPeakRamped" /end STRUCTURE_COMPONENT
 /begin STRUCTURE_COMPONENT drvrWhlTqRegen tNewtonMetre 88 SYMBOL_TYPE_LINK "drvrWhlTqRegen" /end STRUCTURE_COMPONENT
 /begin STRUCTURE_COMPONENT drvrWhlTqRegenEng tNewtonMetre 92 SYMBOL_TYPE_LINK "drvrWhlTqRegenEng" /end STRUCTURE_COMPONENT
 /begin STRUCTURE_COMPONENT drvrWhlTqRegenLim tNewtonMetre 96 SYMBOL_TYPE_LINK "drvrWhlTqRegenLim" /end STRUCTURE_COMPONENT
 /begin STRUCTURE_COMPONENT drvrWhlTqRegenRaw tNewtonMetre 100 SYMBOL_TYPE_LINK "drvrWhlTqRegenRaw" /end STRUCTURE_COMPONENT
 /begin STRUCTURE_COMPONENT drvrWhlTqRegenTar tNewtonMetre 104 SYMBOL_TYPE_LINK "drvrWhlTqRegenTar" /end STRUCTURE_COMPONENT
 /begin STRUCTURE_COMPONENT drvrWhlTqRegenTarRamped tNewtonMetre 108 SYMBOL_TYPE_LINK "drvrWhlTqRegenTarRamped" /end STRUCTURE_COMPONENT
 /begin STRUCTURE_COMPONENT drvrWhlTqReqAccrNegRawIvt tNewtonMetre 112 SYMBOL_TYPE_LINK "drvrWhlTqReqAccrNegRawIvt" /end STRUCTURE_COMPONENT
 /begin STRUCTURE_COMPONENT drvrWhlTqReqFild tNewtonMetre 116 SYMBOL_TYPE_LINK "drvrWhlTqReqFild" /end STRUCTURE_COMPONENT
 /begin STRUCTURE_COMPONENT drvrWhlTqReqIvt tNewtonMetre 120 SYMBOL_TYPE_LINK "drvrWhlTqReqIvt" /end STRUCTURE_COMPONENT
 /begin STRUCTURE_COMPONENT drvrWhlTqReqLimd tNewtonMetre 124 SYMBOL_TYPE_LINK "drvrWhlTqReqLimd" /end STRUCTURE_COMPONENT
 /begin STRUCTURE_COMPONENT drvrWhlTqReqValLimLowr tNewtonMetre 128 SYMBOL_TYPE_LINK "drvrWhlTqReqValLimLowr" /end STRUCTURE_COMPONENT
 /begin STRUCTURE_COMPONENT drvrWhlTqReqValLimUppr tNewtonMetre 132 SYMBOL_TYPE_LINK "drvrWhlTqReqValLimUppr" /end STRUCTURE_COMPONENT
 /begin STRUCTURE_COMPONENT pedlWhlTqReqAccrNegRaw tNewtonMetre 136 SYMBOL_TYPE_LINK "pedlWhlTqReqAccrNegRaw" /end STRUCTURE_COMPONENT
 /begin STRUCTURE_COMPONENT pedlWhlTqReqFinal tNewtonMetre 140 SYMBOL_TYPE_LINK "pedlWhlTqReqFinal" /end STRUCTURE_COMPONENT
 /begin STRUCTURE_COMPONENT drvrBrkPedlWhlTqDtReq tNewtonMetre_100_S32 144 SYMBOL_TYPE_LINK "drvrBrkPedlWhlTqDtReq" /end STRUCTURE_COMPONENT
 /begin STRUCTURE_COMPONENT drvrWhlTqReqAccrNegRaw tNewtonMetre_100_S32 148 SYMBOL_TYPE_LINK "drvrWhlTqReqAccrNegRaw" /end STRUCTURE_COMPONENT
 /begin STRUCTURE_COMPONENT drvrWhlTqReqBasMap tNewtonMetre_100_S32 152 SYMBOL_TYPE_LINK "drvrWhlTqReqBasMap" /end STRUCTURE_COMPONENT
 /begin STRUCTURE_COMPONENT drvrWhlTqReqBto tNewtonMetre_100_S32 156 SYMBOL_TYPE_LINK "drvrWhlTqReqBto" /end STRUCTURE_COMPONENT
 /begin STRUCTURE_COMPONENT drvrWhlTqReqGrdtLowrLim tNewtonMetre_100_S32 160 SYMBOL_TYPE_LINK "drvrWhlTqReqGrdtLowrLim" /end STRUCTURE_COMPONENT
 /begin STRUCTURE_COMPONENT drvrWhlTqReqGrdtUpprLim tNewtonMetre_100_S32 164 SYMBOL_TYPE_LINK "drvrWhlTqReqGrdtUpprLim" /end STRUCTURE_COMPONENT
 /begin STRUCTURE_COMPONENT drvrWhlTqReqMap tNewtonMetre_100_S32 168 SYMBOL_TYPE_LINK "drvrWhlTqReqMap" /end STRUCTURE_COMPONENT
 /begin STRUCTURE_COMPONENT drvrWhlTqReqRaw tNewtonMetre_100_S32 172 SYMBOL_TYPE_LINK "drvrWhlTqReqRaw" /end STRUCTURE_COMPONENT
 /begin STRUCTURE_COMPONENT drvrWhlTqReqTrackMap tNewtonMetre_100_S32 176 SYMBOL_TYPE_LINK "drvrWhlTqReqTrackMap" /end STRUCTURE_COMPONENT
 /begin STRUCTURE_COMPONENT paddleComb tPaddleComb 180 SYMBOL_TYPE_LINK "paddleComb" /end STRUCTURE_COMPONENT
 /begin STRUCTURE_COMPONENT paddleCombPrev tPaddleComb 184 SYMBOL_TYPE_LINK "paddleCombPrev" /end STRUCTURE_COMPONENT
 /begin STRUCTURE_COMPONENT drvrWhlTqSpdPed tPercent 188 SYMBOL_TYPE_LINK "drvrWhlTqSpdPed" /end STRUCTURE_COMPONENT
 /begin STRUCTURE_COMPONENT drvrAccrPedlPercLimd tPercent_100_S16 192 SYMBOL_TYPE_LINK "drvrAccrPedlPercLimd" /end STRUCTURE_COMPONENT
 /begin STRUCTURE_COMPONENT drvrWhlTqReqAccrNegRawIvtQ tQualifier 196 SYMBOL_TYPE_LINK "drvrWhlTqReqAccrNegRawIvtQ" /end STRUCTURE_COMPONENT
 /begin STRUCTURE_COMPONENT pedlWhlTqReqAccrNegRawQ tQualifier 200 SYMBOL_TYPE_LINK "pedlWhlTqReqAccrNegRawQ" /end STRUCTURE_COMPONENT
 /begin STRUCTURE_COMPONENT drvrWhlTqReqRampedStruct RampLimitCtx 204 SYMBOL_TYPE_LINK "drvrWhlTqReqRampedStruct" /end STRUCTURE_COMPONENT
 /begin STRUCTURE_COMPONENT rampedDrvrWhlTqPeakStr RampLimitCtx 212 SYMBOL_TYPE_LINK "rampedDrvrWhlTqPeakStr" /end STRUCTURE_COMPONENT
 /begin STRUCTURE_COMPONENT rampedDrvrWhlTqRegenStr RampLimitCtx 220 SYMBOL_TYPE_LINK "rampedDrvrWhlTqRegenStr" /end STRUCTURE_COMPONENT
 /begin STRUCTURE_COMPONENT rampedDrvrWhlTqReqBtoStr RampLimitCtx 228 SYMBOL_TYPE_LINK "rampedDrvrWhlTqReqBtoStr" /end STRUCTURE_COMPONENT
 /begin STRUCTURE_COMPONENT rampedDrvrWhlTqReqStruct RampLimitCtx 236 SYMBOL_TYPE_LINK "rampedDrvrWhlTqReqStruct" /end STRUCTURE_COMPONENT
 /begin STRUCTURE_COMPONENT rampedDrvrWhlTqSpdStr RampLimitCtx 244 SYMBOL_TYPE_LINK "rampedDrvrWhlTqSpdStr" /end STRUCTURE_COMPONENT
 /begin STRUCTURE_COMPONENT drvrRevIceSpdReq tRevolutionPerMinute_S16 252 SYMBOL_TYPE_LINK "drvrRevIceSpdReq" /end STRUCTURE_COMPONENT
 /begin STRUCTURE_COMPONENT shiftReq tShiftRequest 256 SYMBOL_TYPE_LINK "shiftReq" /end STRUCTURE_COMPONENT
 /begin STRUCTURE_COMPONENT shiftReqPrev tShiftRequest 260 SYMBOL_TYPE_LINK "shiftReqPrev" /end STRUCTURE_COMPONENT
 /begin STRUCTURE_COMPONENT btoTranSt tTorqueRequestTransitionState 264 SYMBOL_TYPE_LINK "btoTranSt" /end STRUCTURE_COMPONENT
 /begin STRUCTURE_COMPONENT pedlMapTranSt tTorqueRequestTransitionState 268 SYMBOL_TYPE_LINK "pedlMapTranSt" /end STRUCTURE_COMPONENT
/end TYPEDEF_STRUCTURE
/begin TYPEDEF_STRUCTURE BrkFldLvlSnsrFaultMask "" 0x1 SYMBOL_TYPE_LINK "BrkFldLvlSnsrFaultMask"
 /begin STRUCTURE_COMPONENT BrkFldLvlSnsrFaultMask uint8_t 0 SYMBOL_TYPE_LINK "BrkFldLvlSnsrFaultMask" /end STRUCTURE_COMPONENT
 /begin STRUCTURE_COMPONENT flags _unnamed_structure_00 0 SYMBOL_TYPE_LINK "flags" /end STRUCTURE_COMPONENT
/end TYPEDEF_STRUCTURE
/begin TYPEDEF_STRUCTURE FrntAxleSnsrFaultMaskFlags "" 0x1 SYMBOL_TYPE_LINK "FrntAxleSnsrFaultMaskFlags" /begin STRUCTURE_COMPONENT _bit_fill_ uint8_t_0xF0 0 SYMBOL_TYPE_LINK "_bit_fill_" /end STRUCTURE_COMPONENT /begin STRUCTURE_COMPONENT redundFault uint8_t_0x8 0 SYMBOL_TYPE_LINK "redundFault" /end STRUCTURE_COMPONENT /begin STRUCTURE_COMPONENT dirBitFault uint8_t_0x4 0 SYMBOL_TYPE_LINK "dirBitFault" /end STRUCTURE_COMPONENT /begin STRUCTURE_COMPONENT chnFault uint8_t_0x2 0 SYMBOL_TYPE_LINK "chnFault" /end STRUCTURE_COMPONENT
 /begin STRUCTURE_COMPONENT manualShutoff uint8_t_0x1 0 SYMBOL_TYPE_LINK "manualShutoff" /end STRUCTURE_COMPONENT
/end TYPEDEF_STRUCTURE
/begin TYPEDEF_STRUCTURE EBrakeFaultMask "" 0x1 SYMBOL_TYPE_LINK "EBrakeFaultMask" /begin STRUCTURE_COMPONENT all uint8_t 0 SYMBOL_TYPE_LINK "all" /end STRUCTURE_COMPONENT /begin STRUCTURE_COMPONENT b EBrakeFaultMaskB 0 SYMBOL_TYPE_LINK "b" /end STRUCTURE_COMPONENT /end TYPEDEF_STRUCTURE
/begin TYPEDEF_STRUCTURE WhlCluFrntSnsrFaultMaskFlags "" 0x1 SYMBOL_TYPE_LINK "WhlCluFrntSnsrFaultMaskFlags" /begin STRUCTURE_COMPONENT _bit_fill_ uint8_t_0xFC 0 SYMBOL_TYPE_LINK "_bit_fill_" /end STRUCTURE_COMPONENT /begin STRUCTURE_COMPONENT redundFault uint8_t_0x2 0 SYMBOL_TYPE_LINK "redundFault" /end STRUCTURE_COMPONENT
 /begin STRUCTURE_COMPONENT manualShutoff uint8_t_0x1 0 SYMBOL_TYPE_LINK "manualShutoff" /end STRUCTURE_COMPONENT
/end TYPEDEF_STRUCTURE
/begin TYPEDEF_STRUCTURE HvRequestFlags "" 0x1 SYMBOL_TYPE_LINK "HvRequestFlags" /begin STRUCTURE_COMPONENT reserved uint8_t_0xC0 0 SYMBOL_TYPE_LINK "reserved" /end STRUCTURE_COMPONENT /begin STRUCTURE_COMPONENT cooling uint8_t_0x20 0 SYMBOL_TYPE_LINK "cooling" /end STRUCTURE_COMPONENT /begin STRUCTURE_COMPONENT hvCharging uint8_t_0x10 0 SYMBOL_TYPE_LINK "hvCharging" /end STRUCTURE_COMPONENT /begin STRUCTURE_COMPONENT lvCharging uint8_t_0x8 0 SYMBOL_TYPE_LINK "lvCharging" /end STRUCTURE_COMPONENT
 /begin STRUCTURE_COMPONENT climateControl uint8_t_0x4 0 SYMBOL_TYPE_LINK "climateControl" /end STRUCTURE_COMPONENT
 /begin STRUCTURE_COMPONENT ignition uint8_t_0x2 0 SYMBOL_TYPE_LINK "ignition" /end STRUCTURE_COMPONENT
/end TYPEDEF_STRUCTURE
/begin TYPEDEF_STRUCTURE HardwareConfig "" 0x14 SYMBOL_TYPE_LINK "HardwareConfig" /begin STRUCTURE_COMPONENT channel tTle92464ChannelType 0 SYMBOL_TYPE_LINK "channel" /end STRUCTURE_COMPONENT /begin STRUCTURE_COMPONENT isParallel uint8_t 12 SYMBOL_TYPE_LINK "isParallel" /end STRUCTURE_COMPONENT /begin STRUCTURE_COMPONENT sysClk _float 16 SYMBOL_TYPE_LINK "sysClk" /end STRUCTURE_COMPONENT /end TYPEDEF_STRUCTURE
/begin TYPEDEF_STRUCTURE AccStbyInhbFlg "" 0x2 SYMBOL_TYPE_LINK "AccStbyInhbFlg"
 /begin STRUCTURE_COMPONENT anyQualifierFlt uint16_t_0x1000 0 SYMBOL_TYPE_LINK "anyQualifierFlt" /end STRUCTURE_COMPONENT
 /begin STRUCTURE_COMPONENT anyDoorOpenLowVehVel uint16_t_0x800 0 SYMBOL_TYPE_LINK "anyDoorOpenLowVehVel" /end STRUCTURE_COMPONENT
 /begin STRUCTURE_COMPONENT anyPassSeatblt uint16_t_0x400 0 SYMBOL_TYPE_LINK "anyPassSeatblt" /end STRUCTURE_COMPONENT
 /begin STRUCTURE_COMPONENT epbSts uint16_t_0x200 0 SYMBOL_TYPE_LINK "epbSts" /end STRUCTURE_COMPONENT
 /begin STRUCTURE_COMPONENT drvMod uint16_t_0x100 0 SYMBOL_TYPE_LINK "drvMod" /end STRUCTURE_COMPONENT
 /begin STRUCTURE_COMPONENT airbFlt uint16_t_0x80 0 SYMBOL_TYPE_LINK "airbFlt" /end STRUCTURE_COMPONENT
 /begin STRUCTURE_COMPONENT pwtFail uint16_t_0x40 0 SYMBOL_TYPE_LINK "pwtFail" /end STRUCTURE_COMPONENT
 /begin STRUCTURE_COMPONENT ecmFlt uint16_t_0x20 0 SYMBOL_TYPE_LINK "ecmFlt" /end STRUCTURE_COMPONENT
 /begin STRUCTURE_COMPONENT epsFlt uint16_t_0x10 0 SYMBOL_TYPE_LINK "epsFlt" /end STRUCTURE_COMPONENT
 /begin STRUCTURE_COMPONENT iebFlt uint16_t_0x8 0 SYMBOL_TYPE_LINK "iebFlt" /end STRUCTURE_COMPONENT
 /begin STRUCTURE_COMPONENT escOff uint16_t_0x4 0 SYMBOL_TYPE_LINK "escOff" /end STRUCTURE_COMPONENT
 /begin STRUCTURE_COMPONENT tcsOff uint16_t_0x2 0 SYMBOL_TYPE_LINK "tcsOff" /end STRUCTURE_COMPONENT
 /begin STRUCTURE_COMPONENT absFlt uint16_t_0x1 0 SYMBOL_TYPE_LINK "absFlt" /end STRUCTURE_COMPONENT
/end TYPEDEF_STRUCTURE
/begin TYPEDEF_STRUCTURE WhlCluRearSnsrFaultMaskFlags "" 0x1 SYMBOL_TYPE_LINK "WhlCluRearSnsrFaultMaskFlags" /begin STRUCTURE_COMPONENT _bit_fill_ uint8_t_0xF0 0 SYMBOL_TYPE_LINK "_bit_fill_" /end STRUCTURE_COMPONENT /begin STRUCTURE_COMPONENT redundFault uint8_t_0x8 0 SYMBOL_TYPE_LINK "redundFault" /end STRUCTURE_COMPONENT /begin STRUCTURE_COMPONENT dirBitFault uint8_t_0x4 0 SYMBOL_TYPE_LINK "dirBitFault" /end STRUCTURE_COMPONENT /begin STRUCTURE_COMPONENT chnFault uint8_t_0x2 0 SYMBOL_TYPE_LINK "chnFault" /end STRUCTURE_COMPONENT
 /begin STRUCTURE_COMPONENT manualShutoff uint8_t_0x1 0 SYMBOL_TYPE_LINK "manualShutoff" /end STRUCTURE_COMPONENT
/end TYPEDEF_STRUCTURE
/begin TYPEDEF_STRUCTURE VecTqCooltSnsrFaultMaskFlags "" 0x1 SYMBOL_TYPE_LINK "VecTqCooltSnsrFaultMaskFlags" /begin STRUCTURE_COMPONENT _bit_fill_ uint8_t_0xE0 0 SYMBOL_TYPE_LINK "_bit_fill_" /end STRUCTURE_COMPONENT
 /begin STRUCTURE_COMPONENT tSnsrCircHigh uint8_t_0x10 0 SYMBOL_TYPE_LINK "tSnsrCircHigh" /end STRUCTURE_COMPONENT
 /begin STRUCTURE_COMPONENT tSnsrCircLow uint8_t_0x8 0 SYMBOL_TYPE_LINK "tSnsrCircLow" /end STRUCTURE_COMPONENT
 /begin STRUCTURE_COMPONENT pSnsrOutOfRange uint8_t_0x4 0 SYMBOL_TYPE_LINK "pSnsrOutOfRange" /end STRUCTURE_COMPONENT
 /begin STRUCTURE_COMPONENT pSnsrCircHigh uint8_t_0x2 0 SYMBOL_TYPE_LINK "pSnsrCircHigh" /end STRUCTURE_COMPONENT
 /begin STRUCTURE_COMPONENT pSnsrCircLow uint8_t_0x1 0 SYMBOL_TYPE_LINK "pSnsrCircLow" /end STRUCTURE_COMPONENT
/end TYPEDEF_STRUCTURE
/begin TYPEDEF_STRUCTURE SolenoidDriverDiagnostics "" 0x2 SYMBOL_TYPE_LINK "SolenoidDriverDiagnostics" /begin STRUCTURE_COMPONENT B SolenoidDriverDiagnosticsB 0 SYMBOL_TYPE_LINK "B" /end STRUCTURE_COMPONENT /begin STRUCTURE_COMPONENT R uint16_t 0 SYMBOL_TYPE_LINK "R" /end STRUCTURE_COMPONENT /end TYPEDEF_STRUCTURE
/begin TYPEDEF_STRUCTURE AccVelCtrlInhbFlg "" 0x2 SYMBOL_TYPE_LINK "AccVelCtrlInhbFlg" /begin STRUCTURE_COMPONENT vehVelLow uint16_t_0x20 0 SYMBOL_TYPE_LINK "vehVelLow" /end STRUCTURE_COMPONENT /begin STRUCTURE_COMPONENT vehVelHigh uint16_t_0x10 0 SYMBOL_TYPE_LINK "vehVelHigh" /end STRUCTURE_COMPONENT /begin STRUCTURE_COMPONENT steerOor uint16_t_0x8 0 SYMBOL_TYPE_LINK "steerOor" /end STRUCTURE_COMPONENT /begin STRUCTURE_COMPONENT drvrBrk uint16_t_0x4 0 SYMBOL_TYPE_LINK "drvrBrk" /end STRUCTURE_COMPONENT
 /begin STRUCTURE_COMPONENT spdLimStActv uint16_t_0x2 0 SYMBOL_TYPE_LINK "spdLimStActv" /end STRUCTURE_COMPONENT
 /begin STRUCTURE_COMPONENT stbyInhbMask uint16_t_0x1 0 SYMBOL_TYPE_LINK "stbyInhbMask" /end STRUCTURE_COMPONENT
/end TYPEDEF_STRUCTURE
/begin TYPEDEF_STRUCTURE SolenoidDriverMeasurements "" 0x18 SYMBOL_TYPE_LINK "SolenoidDriverMeasurements" /begin STRUCTURE_COMPONENT current tAmpere 0 SYMBOL_TYPE_LINK "current" /end STRUCTURE_COMPONENT
 /begin STRUCTURE_COMPONENT measurementPeriod tMillisecond_U32 4 SYMBOL_TYPE_LINK "measurementPeriod" /end STRUCTURE_COMPONENT
 /begin STRUCTURE_COMPONENT pwmOnTime tMillisecond_U32 8 SYMBOL_TYPE_LINK "pwmOnTime" /end STRUCTURE_COMPONENT
 /begin STRUCTURE_COMPONENT pwmDuty _float 12 SYMBOL_TYPE_LINK "pwmDuty" /end STRUCTURE_COMPONENT
 /begin STRUCTURE_COMPONENT temperature tCelsius_100_S16 16 SYMBOL_TYPE_LINK "temperature" /end STRUCTURE_COMPONENT
 /begin STRUCTURE_COMPONENT voltage tVolt 20 SYMBOL_TYPE_LINK "voltage" /end STRUCTURE_COMPONENT
/end TYPEDEF_STRUCTURE
/begin TYPEDEF_STRUCTURE EmotCooltSnsrFaultMaskFlags "" 0x1 SYMBOL_TYPE_LINK "EmotCooltSnsrFaultMaskFlags" /begin STRUCTURE_COMPONENT _bit_fill_ uint8_t_0xE0 0 SYMBOL_TYPE_LINK "_bit_fill_" /end STRUCTURE_COMPONENT
 /begin STRUCTURE_COMPONENT tSnsrCircHigh uint8_t_0x10 0 SYMBOL_TYPE_LINK "tSnsrCircHigh" /end STRUCTURE_COMPONENT
 /begin STRUCTURE_COMPONENT tSnsrCircLow uint8_t_0x8 0 SYMBOL_TYPE_LINK "tSnsrCircLow" /end STRUCTURE_COMPONENT
 /begin STRUCTURE_COMPONENT pSnsrOutOfRange uint8_t_0x4 0 SYMBOL_TYPE_LINK "pSnsrOutOfRange" /end STRUCTURE_COMPONENT
 /begin STRUCTURE_COMPONENT pSnsrCircHigh uint8_t_0x2 0 SYMBOL_TYPE_LINK "pSnsrCircHigh" /end STRUCTURE_COMPONENT
 /begin STRUCTURE_COMPONENT pSnsrCircLow uint8_t_0x1 0 SYMBOL_TYPE_LINK "pSnsrCircLow" /end STRUCTURE_COMPONENT
/end TYPEDEF_STRUCTURE
/begin TYPEDEF_STRUCTURE AccFolCtrlInhbFlg "" 0x2 SYMBOL_TYPE_LINK "AccFolCtrlInhbFlg"
 /begin STRUCTURE_COMPONENT anyAccQualifierFlt uint16_t_0x800 0 SYMBOL_TYPE_LINK "anyAccQualifierFlt" /end STRUCTURE_COMPONENT
 /begin STRUCTURE_COMPONENT vehVelHigh uint16_t_0x400 0 SYMBOL_TYPE_LINK "vehVelHigh" /end STRUCTURE_COMPONENT
 /begin STRUCTURE_COMPONENT steerOor uint16_t_0x200 0 SYMBOL_TYPE_LINK "steerOor" /end STRUCTURE_COMPONENT
 /begin STRUCTURE_COMPONENT drvrBrk uint16_t_0x100 0 SYMBOL_TYPE_LINK "drvrBrk" /end STRUCTURE_COMPONENT
 /begin STRUCTURE_COMPONENT perfMod uint16_t_0x80 0 SYMBOL_TYPE_LINK "perfMod" /end STRUCTURE_COMPONENT
 /begin STRUCTURE_COMPONENT fwdVehDistFlt uint16_t_0x40 0 SYMBOL_TYPE_LINK "fwdVehDistFlt" /end STRUCTURE_COMPONENT
 /begin STRUCTURE_COMPONENT standstillTmr uint16_t_0x20 0 SYMBOL_TYPE_LINK "standstillTmr" /end STRUCTURE_COMPONENT
 /begin STRUCTURE_COMPONENT fwdVehDetnLostClsRng uint16_t_0x10 0 SYMBOL_TYPE_LINK "fwdVehDetnLostClsRng" /end STRUCTURE_COMPONENT
 /begin STRUCTURE_COMPONENT fvcmSysErr uint16_t_0x8 0 SYMBOL_TYPE_LINK "fvcmSysErr" /end STRUCTURE_COMPONENT
 /begin STRUCTURE_COMPONENT adasCommFlt uint16_t_0x4 0 SYMBOL_TYPE_LINK "adasCommFlt" /end STRUCTURE_COMPONENT
 /begin STRUCTURE_COMPONENT spdLimStActv uint16_t_0x2 0 SYMBOL_TYPE_LINK "spdLimStActv" /end STRUCTURE_COMPONENT
 /begin STRUCTURE_COMPONENT stbyInhbMask uint16_t_0x1 0 SYMBOL_TYPE_LINK "stbyInhbMask" /end STRUCTURE_COMPONENT
/end TYPEDEF_STRUCTURE
/begin TYPEDEF_STRUCTURE AutDrvrCtrlOffRsnFlg "" 0x2 SYMBOL_TYPE_LINK "AutDrvrCtrlOffRsnFlg"
 /begin STRUCTURE_COMPONENT anyQualifierFlt uint16_t_0x800 0 SYMBOL_TYPE_LINK "anyQualifierFlt" /end STRUCTURE_COMPONENT
 /begin STRUCTURE_COMPONENT autDrvrCycNotRdy uint16_t_0x400 0 SYMBOL_TYPE_LINK "autDrvrCycNotRdy" /end STRUCTURE_COMPONENT
 /begin STRUCTURE_COMPONENT spdLimStActv uint16_t_0x200 0 SYMBOL_TYPE_LINK "spdLimStActv" /end STRUCTURE_COMPONENT
 /begin STRUCTURE_COMPONENT shiftModNotAuto uint16_t_0x100 0 SYMBOL_TYPE_LINK "shiftModNotAuto" /end STRUCTURE_COMPONENT
 /begin STRUCTURE_COMPONENT drvModNotAllwd uint16_t_0x80 0 SYMBOL_TYPE_LINK "drvModNotAllwd" /end STRUCTURE_COMPONENT
 /begin STRUCTURE_COMPONENT perfModNotAllwd uint16_t_0x40 0 SYMBOL_TYPE_LINK "perfModNotAllwd" /end STRUCTURE_COMPONENT
 /begin STRUCTURE_COMPONENT pwrStOff uint16_t_0x20 0 SYMBOL_TYPE_LINK "pwrStOff" /end STRUCTURE_COMPONENT
 /begin STRUCTURE_COMPONENT suppgMod uint16_t_0x10 0 SYMBOL_TYPE_LINK "suppgMod" /end STRUCTURE_COMPONENT
 /begin STRUCTURE_COMPONENT dynoTimeout uint16_t_0x8 0 SYMBOL_TYPE_LINK "dynoTimeout" /end STRUCTURE_COMPONENT
 /begin STRUCTURE_COMPONENT autDrvrMstSwtOff uint16_t_0x4 0 SYMBOL_TYPE_LINK "autDrvrMstSwtOff" /end STRUCTURE_COMPONENT
/end TYPEDEF_STRUCTURE
/begin TYPEDEF_STRUCTURE SpdLimRsnBitfield "" 0x2 SYMBOL_TYPE_LINK "SpdLimRsnBitfield" /begin STRUCTURE_COMPONENT spdLimFlg SpdLimFlg 0 SYMBOL_TYPE_LINK "spdLimFlg" /end STRUCTURE_COMPONENT /begin STRUCTURE_COMPONENT spdLimMask uint16_t 0 SYMBOL_TYPE_LINK "spdLimMask" /end STRUCTURE_COMPONENT /end TYPEDEF_STRUCTURE
/begin TYPEDEF_STRUCTURE EBrakeFaultMaskB "" 0x1 SYMBOL_TYPE_LINK "EBrakeFaultMaskB"
 /begin STRUCTURE_COMPONENT eBrakesNotHolding uint8_t_0x80 0 SYMBOL_TYPE_LINK "eBrakesNotHolding" /end STRUCTURE_COMPONENT
 /begin STRUCTURE_COMPONENT leftOpenLoad uint8_t_0x40 0 SYMBOL_TYPE_LINK "leftOpenLoad" /end STRUCTURE_COMPONENT
 /begin STRUCTURE_COMPONENT rightOpenLoad uint8_t_0x20 0 SYMBOL_TYPE_LINK "rightOpenLoad" /end STRUCTURE_COMPONENT
 /begin STRUCTURE_COMPONENT leftStuck uint8_t_0x10 0 SYMBOL_TYPE_LINK "leftStuck" /end STRUCTURE_COMPONENT
 /begin STRUCTURE_COMPONENT rightStuck uint8_t_0x8 0 SYMBOL_TYPE_LINK "rightStuck" /end STRUCTURE_COMPONENT
 /begin STRUCTURE_COMPONENT leftOverCurrent uint8_t_0x4 0 SYMBOL_TYPE_LINK "leftOverCurrent" /end STRUCTURE_COMPONENT
 /begin STRUCTURE_COMPONENT rightOverCurrent uint8_t_0x2 0 SYMBOL_TYPE_LINK "rightOverCurrent" /end STRUCTURE_COMPONENT
/end TYPEDEF_STRUCTURE
/begin TYPEDEF_STRUCTURE SolenoidDriverDiagnosticsB "" 0x2 SYMBOL_TYPE_LINK "SolenoidDriverDiagnosticsB"
 /begin STRUCTURE_COMPONENT overTemperature uint16_t_0x400 0 SYMBOL_TYPE_LINK "overTemperature" /end STRUCTURE_COMPONENT
 /begin STRUCTURE_COMPONENT overCurrent uint16_t_0x200 0 SYMBOL_TYPE_LINK "overCurrent" /end STRUCTURE_COMPONENT
 /begin STRUCTURE_COMPONENT openLoadOrShortGround uint16_t_0x100 0 SYMBOL_TYPE_LINK "openLoadOrShortGround" /end STRUCTURE_COMPONENT
 /begin STRUCTURE_COMPONENT openLoad uint16_t_0x80 0 SYMBOL_TYPE_LINK "openLoad" /end STRUCTURE_COMPONENT
 /begin STRUCTURE_COMPONENT shortGround uint16_t_0x40 0 SYMBOL_TYPE_LINK "shortGround" /end STRUCTURE_COMPONENT
 /begin STRUCTURE_COMPONENT iccPwmRegulationWarning uint16_t_0x20 0 SYMBOL_TYPE_LINK "iccPwmRegulationWarning" /end STRUCTURE_COMPONENT
 /begin STRUCTURE_COMPONENT iccCurrentRegulationWarning uint16_t_0x10 0 SYMBOL_TYPE_LINK "iccCurrentRegulationWarning" /end STRUCTURE_COMPONENT
 /begin STRUCTURE_COMPONENT overTemperatureWarning uint16_t_0x8 0 SYMBOL_TYPE_LINK "overTemperatureWarning" /end STRUCTURE_COMPONENT
 /begin STRUCTURE_COMPONENT openLoadOrShortGroundWarning uint16_t_0x4 0 SYMBOL_TYPE_LINK "openLoadOrShortGroundWarning" /end STRUCTURE_COMPONENT
 /begin STRUCTURE_COMPONENT faultState uint16_t_0x2 0 SYMBOL_TYPE_LINK "faultState" /end STRUCTURE_COMPONENT
 /begin STRUCTURE_COMPONENT faultStateFB uint16_t_0x1 0 SYMBOL_TYPE_LINK "faultStateFB" /end STRUCTURE_COMPONENT
/end TYPEDEF_STRUCTURE
/begin TYPEDEF_STRUCTURE SpdLimFlg "" 0x2 SYMBOL_TYPE_LINK "SpdLimFlg" /begin STRUCTURE_COMPONENT dtLim uint16_t_0x400 0 SYMBOL_TYPE_LINK "dtLim" /end STRUCTURE_COMPONENT /begin STRUCTURE_COMPONENT turtle uint16_t_0x200 0 SYMBOL_TYPE_LINK "turtle" /end STRUCTURE_COMPONENT /begin STRUCTURE_COMPONENT limp uint16_t_0x100 0 SYMBOL_TYPE_LINK "limp" /end STRUCTURE_COMPONENT /begin STRUCTURE_COMPONENT asf uint16_t_0x80 0 SYMBOL_TYPE_LINK "asf" /end STRUCTURE_COMPONENT /begin STRUCTURE_COMPONENT tpms uint16_t_0x40 0 SYMBOL_TYPE_LINK "tpms" /end STRUCTURE_COMPONENT /begin STRUCTURE_COMPONENT dynoMod uint16_t_0x20 0 SYMBOL_TYPE_LINK "dynoMod" /end STRUCTURE_COMPONENT /begin STRUCTURE_COMPONENT liftMod uint16_t_0x10 0 SYMBOL_TYPE_LINK "liftMod" /end STRUCTURE_COMPONENT
 /begin STRUCTURE_COMPONENT panelOpenLowVehVel uint16_t_0x8 0 SYMBOL_TYPE_LINK "panelOpenLowVehVel" /end STRUCTURE_COMPONENT
 /begin STRUCTURE_COMPONENT holdSpdLim uint16_t_0x4 0 SYMBOL_TYPE_LINK "holdSpdLim" /end STRUCTURE_COMPONENT
 /begin STRUCTURE_COMPONENT normSpdLim uint16_t_0x2 0 SYMBOL_TYPE_LINK "normSpdLim" /end STRUCTURE_COMPONENT
 /begin STRUCTURE_COMPONENT CTestSpdLim uint16_t_0x1 0 SYMBOL_TYPE_LINK "CTestSpdLim" /end STRUCTURE_COMPONENT
/end TYPEDEF_STRUCTURE
/begin INSTANCE taskHybridTorque "" TaskHybridTorque 0x40034570 READ_WRITE SYMBOL_LINK "taskHybridTorque" 0
 /begin IF_DATA XCP
  /begin DAQ_EVENT VARIABLE /begin DEFAULT_EVENT_LIST EVENT 3 /end DEFAULT_EVENT_LIST /end DAQ_EVENT
 /end IF_DATA
/end INSTANCE
/begin INSTANCE taskHybridSm "" TaskHybridSm 0x40034528 READ_WRITE SYMBOL_LINK "taskHybridSm" 0
 /begin IF_DATA XCP
  /begin DAQ_EVENT VARIABLE /begin DEFAULT_EVENT_LIST EVENT 3 /end DEFAULT_EVENT_LIST /end DAQ_EVENT
 /end IF_DATA
/end INSTANCE
/begin INSTANCE taskEnergyManager "" TaskEnergyManager 0x40034650 READ_WRITE SYMBOL_LINK "taskEnergyManager" 0
 /begin IF_DATA XCP
  /begin DAQ_EVENT VARIABLE /begin DEFAULT_EVENT_LIST EVENT 3 /end DEFAULT_EVENT_LIST /end DAQ_EVENT
 /end IF_DATA
/end INSTANCE
/begin INSTANCE taskDynVso "" TaskDynamicsVso 0x40035484 READ_WRITE SYMBOL_LINK "taskDynVso" 0
 /begin IF_DATA XCP
  /begin DAQ_EVENT VARIABLE /begin DEFAULT_EVENT_LIST EVENT 3 /end DEFAULT_EVENT_LIST /end DAQ_EVENT
 /end IF_DATA
/end INSTANCE
/begin INSTANCE taskDynDtr "" TaskDynamicsDtr 0x40035FC4 READ_WRITE SYMBOL_LINK "taskDynDtr" 0
 /begin IF_DATA XCP
  /begin DAQ_EVENT VARIABLE /begin DEFAULT_EVENT_LIST EVENT 3 /end DEFAULT_EVENT_LIST /end DAQ_EVENT
 /end IF_DATA
/end INSTANCE
/begin INSTANCE taskDynHomlnSfty "" TaskDynamicsHomlnSfty 0x40036854 READ_WRITE SYMBOL_LINK "taskDynHomlnSfty" 0
 /begin IF_DATA XCP
  /begin DAQ_EVENT VARIABLE /begin DEFAULT_EVENT_LIST EVENT 3 /end DEFAULT_EVENT_LIST /end DAQ_EVENT
 /end IF_DATA
/end INSTANCE
/begin INSTANCE taskHmi "" TaskHmi 0x40036E94 READ_WRITE SYMBOL_LINK "taskHmi" 0
 /begin IF_DATA XCP
  /begin DAQ_EVENT VARIABLE /begin DEFAULT_EVENT_LIST EVENT 3 /end DEFAULT_EVENT_LIST /end DAQ_EVENT
 /end IF_DATA
/end INSTANCE
/begin INSTANCE taskHwio1ms "" TaskHwio1ms 0x40036E9C READ_WRITE SYMBOL_LINK "taskHwio1ms" 0
 /begin IF_DATA XCP
  /begin DAQ_EVENT VARIABLE /begin DEFAULT_EVENT_LIST EVENT 3 /end DEFAULT_EVENT_LIST /end DAQ_EVENT
 /end IF_DATA
/end INSTANCE
/begin INSTANCE taskHwio100ms "" TaskHwio100ms 0x40037210 READ_WRITE SYMBOL_LINK "taskHwio100ms" 0
 /begin IF_DATA XCP
  /begin DAQ_EVENT VARIABLE /begin DEFAULT_EVENT_LIST EVENT 3 /end DEFAULT_EVENT_LIST /end DAQ_EVENT
 /end IF_DATA
/end INSTANCE
/begin INSTANCE taskHwioSolndrv "" TaskHwioSolndrv 0x40037330 READ_WRITE SYMBOL_LINK "taskHwioSolndrv" 0
 /begin IF_DATA XCP
  /begin DAQ_EVENT VARIABLE /begin DEFAULT_EVENT_LIST EVENT 3 /end DEFAULT_EVENT_LIST /end DAQ_EVENT
 /end IF_DATA
/end INSTANCE
/begin COMPU_METHOD tFactor "" IDENTICAL "%.6" "" /end COMPU_METHOD
/begin COMPU_METHOD tPercent "" IDENTICAL "%.1" "%" /end COMPU_METHOD
/begin COMPU_METHOD tPercent_100_S16 "" LINEAR "%.2" "%" COEFFS_LINEAR 0.010000 0 /end COMPU_METHOD
/begin COMPU_METHOD tPercent_S8 "" IDENTICAL "%.0" "%" /end COMPU_METHOD
/begin COMPU_METHOD tPercent_100_S32 "" LINEAR "%.2" "%" COEFFS_LINEAR 0.010000 0 /end COMPU_METHOD
/begin COMPU_METHOD tSecond "" IDENTICAL "%.3" "s" /end COMPU_METHOD
/begin COMPU_METHOD tHertz "" IDENTICAL "%.3" "Hz" /end COMPU_METHOD
/begin COMPU_METHOD tMillisecond_U32 "" IDENTICAL "%.3" "ms" /end COMPU_METHOD
/begin COMPU_METHOD tMetre "" IDENTICAL "%.4" "m" /end COMPU_METHOD
/begin COMPU_METHOD tKilometre "" IDENTICAL "%.3" "km" /end COMPU_METHOD
/begin COMPU_METHOD tMetreSquared "" IDENTICAL "%.4" "m2" /end COMPU_METHOD
/begin COMPU_METHOD tMetrePerSecond "" IDENTICAL "%.3" "m/s" /end COMPU_METHOD
/begin COMPU_METHOD tKilometrePerHour "" IDENTICAL "%.3" "km/h" /end COMPU_METHOD
/begin COMPU_METHOD tKilometrePerHour_10_S16 "" LINEAR "%.1" "km/h" COEFFS_LINEAR 0.100000 0 /end COMPU_METHOD
/begin COMPU_METHOD tKilometrePerHour_10_S32 "" LINEAR "%.1" "km/h" COEFFS_LINEAR 0.100000 0 /end COMPU_METHOD
/begin COMPU_METHOD tMetrePerSquareSecond "" IDENTICAL "%.3" "m/s2" /end COMPU_METHOD
/begin COMPU_METHOD tRadian "" IDENTICAL "%.3" "rad" /end COMPU_METHOD
/begin COMPU_METHOD tDegree "" IDENTICAL "%.3" "deg" /end COMPU_METHOD
/begin COMPU_METHOD tDegree_10_S16 "" LINEAR "%.1" "deg" COEFFS_LINEAR 0.100000 0 /end COMPU_METHOD
/begin COMPU_METHOD tRadianPerSecond "" IDENTICAL "%.3" "rad/s" /end COMPU_METHOD
/begin COMPU_METHOD tRadianPerSecond_100_U16 "" LINEAR "%.2" "rad/s" COEFFS_LINEAR 0.010000 0 /end COMPU_METHOD
/begin COMPU_METHOD tRevolutionPerMinute_S16 "" IDENTICAL "%.0" "rpm" /end COMPU_METHOD
/begin COMPU_METHOD tDegreePerSecond "" IDENTICAL "%.3" "deg/s" /end COMPU_METHOD
/begin COMPU_METHOD tRadianPerSquareSecond "" IDENTICAL "%.3" "rad/s2" /end COMPU_METHOD
/begin COMPU_METHOD tKilogram "" IDENTICAL "%.3" "kg" /end COMPU_METHOD
/begin COMPU_METHOD tNewton "" IDENTICAL "%.3" "N" /end COMPU_METHOD
/begin COMPU_METHOD tNewtonMetre "" IDENTICAL "%.3" "Nm" /end COMPU_METHOD
/begin COMPU_METHOD tNewtonMetre_100_S32 "" LINEAR "%.2" "Nm" COEFFS_LINEAR 0.010000 0 /end COMPU_METHOD
/begin COMPU_METHOD tKilowatt "" IDENTICAL "%.3" "kW" /end COMPU_METHOD
/begin COMPU_METHOD tKilowattHour "" IDENTICAL "%.3" "kWh" /end COMPU_METHOD
/begin COMPU_METHOD tWatt "" IDENTICAL "%.1" "W" /end COMPU_METHOD
/begin COMPU_METHOD tCelsius "" IDENTICAL "%.3" "C" /end COMPU_METHOD
/begin COMPU_METHOD tCelsius_10_S16 "" LINEAR "%.1" "C" COEFFS_LINEAR 0.100000 0 /end COMPU_METHOD
/begin COMPU_METHOD tCelsius_100_S16 "" LINEAR "%.2" "C" COEFFS_LINEAR 0.010000 0 /end COMPU_METHOD
/begin COMPU_METHOD tPascal "" IDENTICAL "%.3" "Pa" /end COMPU_METHOD
/begin COMPU_METHOD tBar "" IDENTICAL "%.3" "bar" /end COMPU_METHOD
/begin COMPU_METHOD tBar_10_S16 "" LINEAR "%.1" "bar" COEFFS_LINEAR 0.100000 0 /end COMPU_METHOD
/begin COMPU_METHOD tBar_100_S16 "" LINEAR "%.2" "bar" COEFFS_LINEAR 0.010000 0 /end COMPU_METHOD
/begin COMPU_METHOD tBar_1000_S16 "" LINEAR "%.3" "bar" COEFFS_LINEAR 0.001000 0 /end COMPU_METHOD
/begin COMPU_METHOD tOhm "" IDENTICAL "%.3" "Ohm" /end COMPU_METHOD
/begin COMPU_METHOD tKilogramPerCubeMetre "" IDENTICAL "%.4" "kg/m3" /end COMPU_METHOD
/begin COMPU_METHOD tAmpere "" IDENTICAL "%.3" "A" /end COMPU_METHOD
/begin COMPU_METHOD tAmpereHour "" IDENTICAL "%.3" "Ah" /end COMPU_METHOD
/begin COMPU_METHOD tMillivolt_S16 "" IDENTICAL "%.0" "mV" /end COMPU_METHOD
/begin COMPU_METHOD tMillivolt_S32 "" IDENTICAL "%.0" "mV" /end COMPU_METHOD
/begin COMPU_METHOD tVolt "" IDENTICAL "%.3" "V" /end COMPU_METHOD
/begin COMPU_METHOD tAscii "" IDENTICAL "%.0" "ascii" /end COMPU_METHOD
/begin COMPU_METHOD tQualifier "" TAB_VERB "%.0" "" COMPU_TAB_REF tQualifier /end COMPU_METHOD
/begin COMPU_METHOD tAvasMod "" TAB_VERB "%.0" "" COMPU_TAB_REF tAvasMod /end COMPU_METHOD
/begin COMPU_METHOD tDiagnos "" TAB_VERB "%.0" "" COMPU_TAB_REF tDiagnos /end COMPU_METHOD
/begin COMPU_METHOD tIntegratorState "" TAB_VERB "%.0" "" COMPU_TAB_REF tIntegratorState /end COMPU_METHOD
/begin COMPU_METHOD tTqMacSt "" TAB_VERB "%.0" "" COMPU_TAB_REF tTqMacSt /end COMPU_METHOD
/begin COMPU_METHOD tPropulsionMode "" TAB_VERB "%.0" "" COMPU_TAB_REF tPropulsionMode /end COMPU_METHOD
/begin COMPU_METHOD tLowPassFilterType "" TAB_VERB "%.0" "" COMPU_TAB_REF tLowPassFilterType /end COMPU_METHOD
/begin COMPU_METHOD tSpeedLimiterState "" TAB_VERB "%.0" "" COMPU_TAB_REF tSpeedLimiterState /end COMPU_METHOD
/begin COMPU_METHOD tSpdLimRsnIdx "" TAB_VERB "%.0" "" COMPU_TAB_REF tSpdLimRsnIdx /end COMPU_METHOD
/begin COMPU_METHOD tDriveMode "" TAB_VERB "%.0" "" COMPU_TAB_REF tDriveMode /end COMPU_METHOD
/begin COMPU_METHOD tShiftRequest "" TAB_VERB "%.0" "" COMPU_TAB_REF tShiftRequest /end COMPU_METHOD
/begin COMPU_METHOD tGear "" TAB_VERB "%.0" "" COMPU_TAB_REF tGear /end COMPU_METHOD
/begin COMPU_METHOD tPerformanceMode "" TAB_VERB "%.0" "" COMPU_TAB_REF tPerformanceMode /end COMPU_METHOD
/begin COMPU_METHOD tEnableState "" TAB_VERB "%.0" "" COMPU_TAB_REF tEnableState /end COMPU_METHOD
/begin COMPU_METHOD tPaddleComb "" TAB_VERB "%.0" "" COMPU_TAB_REF tPaddleComb /end COMPU_METHOD
/begin COMPU_METHOD tPerformanceStrategy "" TAB_VERB "%.0" "" COMPU_TAB_REF tPerformanceStrategy /end COMPU_METHOD
/begin COMPU_METHOD tIceSystemState "" TAB_VERB "%.0" "" COMPU_TAB_REF tIceSystemState /end COMPU_METHOD
/begin COMPU_METHOD tElectricalSystemState "" TAB_VERB "%.0" "" COMPU_TAB_REF tElectricalSystemState /end COMPU_METHOD
/begin COMPU_METHOD tPowerState "" TAB_VERB "%.0" "" COMPU_TAB_REF tPowerState /end COMPU_METHOD
/begin COMPU_METHOD tEBrakeState "" TAB_VERB "%.0" "" COMPU_TAB_REF tEBrakeState /end COMPU_METHOD
/begin COMPU_METHOD tParkingBrakeRequest "" TAB_VERB "%.0" "" COMPU_TAB_REF tParkingBrakeRequest /end COMPU_METHOD
/begin COMPU_METHOD tRollingState "" TAB_VERB "%.0" "" COMPU_TAB_REF tRollingState /end COMPU_METHOD
/begin COMPU_METHOD tEngineRunning "" TAB_VERB "%.0" "" COMPU_TAB_REF tEngineRunning /end COMPU_METHOD
/begin COMPU_METHOD tTakeoffState "" TAB_VERB "%.0" "" COMPU_TAB_REF tTakeoffState /end COMPU_METHOD
/begin COMPU_METHOD tCombustionEngineControlState "" TAB_VERB "%.0" "" COMPU_TAB_REF tCombustionEngineControlState /end COMPU_METHOD
/begin COMPU_METHOD tTireModel "" TAB_VERB "%.0" "" COMPU_TAB_REF tTireModel /end COMPU_METHOD
/begin COMPU_METHOD tAdasRequest "" TAB_VERB "%.0" "" COMPU_TAB_REF tAdasRequest /end COMPU_METHOD
/begin COMPU_METHOD tHybSmState "" TAB_VERB "%.0" "" COMPU_TAB_REF tHybSmState /end COMPU_METHOD
/begin COMPU_METHOD tBMSState "" TAB_VERB "%.0" "" COMPU_TAB_REF tBMSState /end COMPU_METHOD
/begin COMPU_METHOD tInvSmStatus "" TAB_VERB "%.0" "" COMPU_TAB_REF tInvSmStatus /end COMPU_METHOD
/begin COMPU_METHOD tChargePortStatus "" TAB_VERB "%.0" "" COMPU_TAB_REF tChargePortStatus /end COMPU_METHOD
/begin COMPU_METHOD tAccStationaryRequest "" TAB_VERB "%.0" "" COMPU_TAB_REF tAccStationaryRequest /end COMPU_METHOD
/begin COMPU_METHOD tAdasDriverTakeoverRequest "" TAB_VERB "%.0" "" COMPU_TAB_REF tAdasDriverTakeoverRequest /end COMPU_METHOD
/begin COMPU_METHOD tAdasDriverTakeoffRequest "" TAB_VERB "%.0" "" COMPU_TAB_REF tAdasDriverTakeoffRequest /end COMPU_METHOD
/begin COMPU_METHOD tAdaptiveCruiseControlState "" TAB_VERB "%.0" "" COMPU_TAB_REF tAdaptiveCruiseControlState /end COMPU_METHOD
/begin COMPU_METHOD tAdaptiveCruiseControlStateRequest "" TAB_VERB "%.0" "" COMPU_TAB_REF tAdaptiveCruiseControlStateRequest /end COMPU_METHOD
/begin COMPU_METHOD tAccActuatorResponse "" TAB_VERB "%.0" "" COMPU_TAB_REF tAccActuatorResponse /end COMPU_METHOD
/begin COMPU_METHOD tAccDistanceLevel "" TAB_VERB "%.0" "" COMPU_TAB_REF tAccDistanceLevel /end COMPU_METHOD
/begin COMPU_METHOD tAccSetVelOrDist "" TAB_VERB "%.0" "" COMPU_TAB_REF tAccSetVelOrDist /end COMPU_METHOD
/begin COMPU_METHOD tAutomatedDriverControlState "" TAB_VERB "%.0" "" COMPU_TAB_REF tAutomatedDriverControlState /end COMPU_METHOD
/begin COMPU_METHOD tLvBatteryStatus "" TAB_VERB "%.0" "" COMPU_TAB_REF tLvBatteryStatus /end COMPU_METHOD
/begin COMPU_METHOD tTpmsWarnLamp "" TAB_VERB "%.0" "" COMPU_TAB_REF tTpmsWarnLamp /end COMPU_METHOD
/begin COMPU_METHOD tTpmsWarnLampRsn "" TAB_VERB "%.0" "" COMPU_TAB_REF tTpmsWarnLampRsn /end COMPU_METHOD
/begin COMPU_METHOD tTpmsSpdLimHit "" TAB_VERB "%.0" "" COMPU_TAB_REF tTpmsSpdLimHit /end COMPU_METHOD
/begin COMPU_METHOD tBrakeFluidLevel "" TAB_VERB "%.0" "" COMPU_TAB_REF tBrakeFluidLevel /end COMPU_METHOD
/begin COMPU_METHOD tIceStartCmd "" TAB_VERB "%.0" "" COMPU_TAB_REF tIceStartCmd /end COMPU_METHOD
/begin COMPU_METHOD tVsoVehicleMotionObserverSwt "" TAB_VERB "%.0" "" COMPU_TAB_REF tVsoVehicleMotionObserverSwt /end COMPU_METHOD
/begin COMPU_METHOD tLvBatteryType "" TAB_VERB "%.0" "" COMPU_TAB_REF tLvBatteryType /end COMPU_METHOD
/begin COMPU_METHOD tTrueVehVelSrc "" TAB_VERB "%.0" "" COMPU_TAB_REF tTrueVehVelSrc /end COMPU_METHOD
/begin COMPU_METHOD tTorqueRequestTransitionState "" TAB_VERB "%.0" "" COMPU_TAB_REF tTorqueRequestTransitionState /end COMPU_METHOD
/begin COMPU_METHOD tTpmsTirePState "" TAB_VERB "%.0" "" COMPU_TAB_REF tTpmsTirePState /end COMPU_METHOD
/begin COMPU_METHOD tSensorState "" TAB_VERB "%.0" "" COMPU_TAB_REF tSensorState /end COMPU_METHOD
/begin COMPU_METHOD tHybMod "" TAB_VERB "%.0" "" COMPU_TAB_REF tHybMod /end COMPU_METHOD
/begin COMPU_METHOD tTle92464ChannelType "" TAB_VERB "%.0" "" COMPU_TAB_REF tTle92464ChannelType /end COMPU_METHOD
/begin COMPU_METHOD tOdoSyncSt "" TAB_VERB "%.0" "" COMPU_TAB_REF tOdoSyncSt /end COMPU_METHOD
/begin COMPU_METHOD tOdeStatus "" TAB_VERB "%.0" "" COMPU_TAB_REF tOdeStatus /end COMPU_METHOD
/begin COMPU_VTAB tQualifier "" TAB_VERB 4 0 "Q_NOT_INITIALIZED" 1 "Q_FAULTY" 2 "Q_NORMAL" 3 "Q_LOW_QUALITY" /end COMPU_VTAB
/begin COMPU_VTAB tAvasMod "" TAB_VERB 4 0 "AVAS_MOD_OFF" 1 "AVAS_MOD_FAN_STBY" 2 "AVAS_MOD_FAN" 3 "AVAS_MOD_SPEAKER" /end COMPU_VTAB
/begin COMPU_VTAB tDiagnos "" TAB_VERB 3 0 "DIAG_UNKNOWN" 1 "DIAG_BAD" 2 "DIAG_OK" /end COMPU_VTAB
/begin COMPU_VTAB tIntegratorState "" TAB_VERB 5 0 "INTGTR_RESET" 1 "INTGTR_FREEZE" 2 "INTGTR_LIMIT" 3 "INTGTR_INTEGRATE" 4 "INTGTR_INITIALIZE" /end COMPU_VTAB
/begin COMPU_VTAB tTqMacSt "" TAB_VERB 21 0 "TQ_MAC_ST_UNKNOWN" 1 "TQ_MAC_ST_TQ_OFF" 2 "TQ_MAC_ST_ELEC_IDLE" 3 "TQ_MAC_ST_ELEC_DRIVE" 4 "TQ_MAC_ST_CRK_PARK" 5 "TQ_MAC_ST_CRK_STATY" 6 "TQ_MAC_ST_CRK_DRVG" 7 "TQ_MAC_ST_HYB_IDLE" 8 "TQ_MAC_ST_HYB_DRV" 9 "TQ_MAC_ST_HYB_DECOUPL_IDLE" 10 "TQ_MAC_ST_HYB_DECOUPL_DRV" 11 "TQ_MAC_ST_HYB_RVSG" 12 "TQ_MAC_ST_HYB_LNCH" 13 "TQ_MAC_ST_ICE_IDLE" 14 "TQ_MAC_ST_ICE_DRIVE" 15 "TQ_MAC_ST_ICE_RVSG" 16 "TQ_MAC_ST_ELEC_TURTLE" 17 "TQ_MAC_ST_ELEC_TURTLE_IDLE" 18 "TQ_MAC_ST_ICE_TURTLE" 19 "TQ_MAC_ST_ICE_TURTLE_IDLE" 20 "TQ_MAC_ST_LENGTH" /end COMPU_VTAB
/begin COMPU_VTAB tPropulsionMode "" TAB_VERB 5 0 "PRPL_MOD_UNKNOWN" 1 "PRPL_MOD_ELEC_FORCED" 2 "PRPL_MOD_ELEC" 3 "PRPL_MOD_HYBRID" 4 "PRPL_MOD_ICE_FORCED" /end COMPU_VTAB
/begin COMPU_VTAB tLowPassFilterType "" TAB_VERB 2 0 "LPF_TYPE_O1_BUTTER" 1 "LPF_TYPE_O2_BUTTER" /end COMPU_VTAB
/begin COMPU_VTAB tSpeedLimiterState "" TAB_VERB 4 0 "SPD_LIM_ST_OFF" 1 "SPD_LIM_ST_STBY" 2 "SPD_LIM_ST_ACTIVE" 3 "SPD_LIM_ST_ERROR" /end COMPU_VTAB
/begin COMPU_VTAB tSpdLimRsnIdx "" TAB_VERB 13 0 "SPD_LIM_RSN_NONE" 1 "SPD_LIM_RSN_CTEST" 2 "SPD_LIM_RSN_NORMAL" 3 "SPD_LIM_RSN_HOLD" 4 "SPD_LIM_RSN_PANEL" 5 "SPD_LIM_RSN_LIFT" 6 "SPD_LIM_RSN_DYNO" 7 "SPD_LIM_RSN_TPMS" 8 "SPD_LIM_RSN_ASF" 9 "SPD_LIM_RSN_LIMP" 10 "SPD_LIM_RSN_TURTLE" 11 "SPD_LIM_RSN_DT_LIM" 12 "SPD_LIM_RSN_LENGTH" /end COMPU_VTAB
/begin COMPU_VTAB tDriveMode "" TAB_VERB 6 0 "DRV_MOD_UNKNOWN" 1 "DRV_MOD_PARK" 2 "DRV_MOD_NEUTRAL" 3 "DRV_MOD_REVERSE" 4 "DRV_MOD_DRIVE" 5 "NUM_OF_DRV_MOD" /end COMPU_VTAB
/begin COMPU_VTAB tShiftRequest "" TAB_VERB 3 0 "SHIFT_REQ_UNKNOWN" 1 "SHIFT_REQ_DOWNSHIFT" 2 "SHIFT_REQ_UPSHIFT" /end COMPU_VTAB
/begin COMPU_VTAB tGear "" TAB_VERB 11 0 "GEAR_INVALID" 1 "GEAR_1" 2 "GEAR_2" 3 "GEAR_3" 4 "GEAR_4" 5 "GEAR_5" 6 "GEAR_6" 7 "GEAR_7" 8 "GEAR_8" 9 "GEAR_9" 10 "GEAR_N" /end COMPU_VTAB
/begin COMPU_VTAB tPerformanceMode "" TAB_VERB 8 0 "PERF_MOD_UNKNOWN" 1 "PERF_MOD_GHOST_EV" 2 "PERF_MOD_COMFORT" 3 "PERF_MOD_WET_SNOW" 4 "PERF_MOD_SPORT" 5 "PERF_MOD_TRACK" 6 "PERF_MOD_INDIVIDUAL" 7 "NUM_OF_PERF_MOD" /end COMPU_VTAB
/begin COMPU_VTAB tEnableState "" TAB_VERB 4 0 "ENA_ST_UNKNOWN" 1 "ENA_ST_OFF" 2 "ENA_ST_ON" 3 "ENA_ST_FLT" /end COMPU_VTAB
/begin COMPU_VTAB tPaddleComb "" TAB_VERB 5 0 "PADDLE_UNKNOWN" 1 "PADDLE_RELEASED" 2 "PADDLE_DOWN" 3 "PADDLE_UP" 4 "PADDLE_BOTH" /end COMPU_VTAB
/begin COMPU_VTAB tPerformanceStrategy "" TAB_VERB 4 0 "PERF_STGY_UKWN" 1 "PERF_STGY_ENDURANCE" 2 "PERF_STGY_POWER" 3 "PERF_STGY_HOT_LAP" /end COMPU_VTAB
/begin COMPU_VTAB tIceSystemState "" TAB_VERB 5 0 "ICE_SYS_ST_UNKNOWN" 1 "ICE_SYS_ST_CRITICAL_FAULT" 2 "ICE_SYS_ST_LIMP" 3 "ICE_SYS_ST_NOT_READY" 4 "ICE_SYS_ST_READY" /end COMPU_VTAB
/begin COMPU_VTAB tElectricalSystemState "" TAB_VERB 6 0 "EL_SYS_ST_UNKNOWN" 1 "EL_SYS_ST_OFF" 2 "EL_SYS_ST_NORMAL" 3 "EL_SYS_ST_LIMP" 4 "EL_SYS_ST_MOTOR_FAULT" 5 "EL_SYS_ST_FORCE_SHUTDOWN" /end COMPU_VTAB
/begin COMPU_VTAB tPowerState "" TAB_VERB 16 0 "PWR_ST_UNAVL" 1 "PWR_ST_SLEEP" 2 "PWR_ST_THERM_MNGT" 3 "PWR_ST_POST_CRASH" 4 "PWR_ST_INTRUSION" 5 "PWR_ST_BATT_CHRGN" 6 "PWR_ST_USR_ACS" 7 "PWR_ST_IGN" 8 "PWR_ST_FLASHING" 15 "PWR_ST_INVLD" /end COMPU_VTAB
/begin COMPU_VTAB tEBrakeState "" TAB_VERB 6 0 "E_BRAKE_SM_UNKNOWN" 1 "E_BRAKE_SM_ENGAGING" 2 "E_BRAKE_SM_ENGAGED" 3 "E_BRAKE_SM_DISENGAGING" 4 "E_BRAKE_SM_DISENGAGED" 5 "E_BRAKE_SM_FAULT" /end COMPU_VTAB
/begin COMPU_VTAB tParkingBrakeRequest "" TAB_VERB 3 0 "PRKG_BRK_REQ_UNKNOWN" 1 "PRKG_BRK_REQ_DISENGAGE" 2 "PRKG_BRK_REQ_ENGAGE" /end COMPU_VTAB
/begin COMPU_VTAB tRollingState "" TAB_VERB 5 0 "ROLLING_UNKNOWN" 1 "ROLLING_STATIONARY" 2 "ROLLING_FORWARD" 3 "ROLLING_REARWARD" 4 "ROLLING_OVERSPEED" /end COMPU_VTAB
/begin COMPU_VTAB tEngineRunning "" TAB_VERB 4 0 "ENG_RUNNG_SIGNAL_UNQUALIFIED" 1 "ENG_RUNNG_RESERVED" 2 "ENG_RUNNG_FALSE" 3 "ENG_RUNNG_TRUE" /end COMPU_VTAB
/begin COMPU_VTAB tTakeoffState "" TAB_VERB 5 0 "TAKEOFF_ST_SPD_RAMP" 1 "TAKEOFF_ST_COUPLE" 2 "TAKEOFF_ST_READY" 3 "TAKEOFF_ST_TQ_RAMP" 4 "TAKEOFF_ST_DRIVE" /end COMPU_VTAB
/begin COMPU_VTAB tCombustionEngineControlState "" TAB_VERB 7 0 "ICE_ST_UNKNOWN" 1 "ICE_ST_OFF" 2 "ICE_ST_DECOUPL_IDLE" 3 "ICE_ST_DECOUPL_SPD_CTRL" 4 "ICE_ST_COUPL_TQ_CTRL" 5 "ICE_ST_COUPL_SPD_CTRL" 6 "ICE_ST_UNAVAILABLE" /end COMPU_VTAB
/begin COMPU_VTAB tTireModel "" TAB_VERB 5 0 "TIRE_MDL_UNKNOWN" 1 "TIRE_MDL_CUP2" 2 "TIRE_MDL_CUP2R" 3 "TIRE_MDL_ALPIN" 4 "NUM_OF_TIRE_MDLS" /end COMPU_VTAB
/begin COMPU_VTAB tAdasRequest "" TAB_VERB 3 0 "ADAS_UNKNOWN" 1 "ADAS_NO_REQUEST" 2 "ADAS_REQUEST" /end COMPU_VTAB
/begin COMPU_VTAB tHybSmState "" TAB_VERB 7 0 "HYB_SM_OFF" 1 "HYB_SM_SHUTDOWN" 2 "HYB_SM_SAFESTATE" 3 "HYB_SM_PRECHARGING" 4 "HYB_SM_LIVE" 5 "HYB_SM_RUNNING" 6 "HYB_SM_CHARGING" /end COMPU_VTAB
/begin COMPU_VTAB tBMSState "" TAB_VERB 7 0 "BMS_STATE_UNKNOWN" 1 "BMS_STATE_IDLE" 2 "BMS_STATE_PRECHARGING" 3 "BMS_STATE_RUNNING" 4 "BMS_STATE_CHARGING" 5 "BMS_STATE_SHUTDOWN" 6 "BMS_STATE_SAFESTATE" /end COMPU_VTAB
/begin COMPU_VTAB tInvSmStatus "" TAB_VERB 6 0 "INV_SM_INIT" 1 "INV_SM_SELFCHECK" 2 "INV_SM_READY" 3 "INV_SM_RUNNING" 4 "INV_SM_SHUTDOWN" 5 "INV_SM_SAFESTATE" /end COMPU_VTAB
/begin COMPU_VTAB tChargePortStatus "" TAB_VERB 4 0 "CHARGE_PORT_STATUS_UNKNOWN" 1 "CHARGE_PORT_STATUS_UNPLUGGED" 2 "CHARGE_PORT_STATUS_PLUGGED" 3 "CHARGE_PORT_STATUS_MAX" /end COMPU_VTAB
/begin COMPU_VTAB tAccStationaryRequest "" TAB_VERB 3 0 "ACC_STATY_REQ_UNKNOWN" 1 "ACC_STATY_REQ_STATY" 2 "ACC_STATY_REQ_GO" /end COMPU_VTAB
/begin COMPU_VTAB tAdasDriverTakeoverRequest "" TAB_VERB 4 0 "ADAS_TAKEOVER_REQ_UNKNOWN" 1 "ADAS_TAKEOVER_REQ_FALSE" 2 "ADAS_TAKEOVER_REQ_WARN" 3 "ADAS_TAKEOVER_REQ_EM" /end COMPU_VTAB
/begin COMPU_VTAB tAdasDriverTakeoffRequest "" TAB_VERB 3 0 "ACC_TAKEOFF_REQ_UNKNOWN" 1 "ACC_TAKEOFF_REQ_FALSE" 2 "ACC_TAKEOFF_REQ_TRUE" /end COMPU_VTAB
/begin COMPU_VTAB tAdaptiveCruiseControlState "" TAB_VERB 9 0 "ACC_ST_UNKNOWN" 1 "ACC_ST_OFF" 2 "ACC_ST_PASSIVE" 3 "ACC_ST_STBY" 4 "ACC_ST_ACTV_VEL_CTRL" 5 "ACC_ST_ACTV_FOL_CTRL" 6 "ACC_ST_ACTV_STANDG_ACTV" 7 "ACC_ST_OVRD" 8 "ACC_ST_ERROR" /end COMPU_VTAB
/begin COMPU_VTAB tAdaptiveCruiseControlStateRequest "" TAB_VERB 5 0 "ACC_ST_REQ_UNKNOWN" 1 "ACC_ST_REQ_OFF" 2 "ACC_ST_REQ_STBY" 3 "ACC_ST_REQ_ACTV_VEL_CTRL" 4 "ACC_ST_REQ_ACTV_FOL_CTRL" /end COMPU_VTAB
/begin COMPU_VTAB tAccActuatorResponse "" TAB_VERB 6 0 "ACC_ACTR_UNKNOWN" 1 "ACC_ACTR_NO_REQ" 2 "ACC_ACTR_HONORED" 3 "ACC_ACTR_LOST_ARBN" 4 "ACC_ACTR_NOT_ALLWD" 5 "ACC_ACTR_CDN_NOT_OK" /end COMPU_VTAB
/begin COMPU_VTAB tAccDistanceLevel "" TAB_VERB 5 0 "ACC_DIST_LVL_UNKNOWN" 1 "ACC_DIST_LVL_0" 2 "ACC_DIST_LVL_1" 3 "ACC_DIST_LVL_2" 4 "ACC_DIST_LVL_3" /end COMPU_VTAB
/begin COMPU_VTAB tAccSetVelOrDist "" TAB_VERB 5 0 "ACC_SET_UNKNOWN" 1 "ACC_SET_NONE" 2 "ACC_SET_VEL" 3 "ACC_SET_VEL_ONLY" 4 "ACC_SET_DIST" /end COMPU_VTAB
/begin COMPU_VTAB tAutomatedDriverControlState "" TAB_VERB 6 0 "AUT_DRVR_CTRL_ST_UKWN" 1 "AUT_DRVR_CTRL_ST_OFF" 2 "AUT_DRVR_CTRL_ST_RDY" 3 "AUT_DRVR_CTRL_ST_ACTV" 4 "AUT_DRVR_CTRL_ST_OVRD" 5 "AUT_DRVR_CTRL_ST_SHUTDWN" /end COMPU_VTAB
/begin COMPU_VTAB tLvBatteryStatus "" TAB_VERB 4 0 "LV_BATTERY_STATUS_UNKNOWN" 1 "LV_BATTERY_STATUS_NORMAL" 2 "LV_BATTERY_STATUS_WARNING" 3 "LV_BATTERY_STATUS_FAULT" /end COMPU_VTAB
/begin COMPU_VTAB tTpmsWarnLamp "" TAB_VERB 4 0 "TPMS_WARN_LAMP_UNKNOWN" 1 "TPMS_WARN_LAMP_OFF" 2 "TPMS_WARN_LAMP_FLASHING" 3 "TPMS_WARN_LAMP_ON" /end COMPU_VTAB
/begin COMPU_VTAB tTpmsWarnLampRsn "" TAB_VERB 4 0 "TPMS_WARN_LAMP_REASON_UNKNOWN" 1 "TPMS_WARN_LAMP_REASON_NONE" 2 "TPMS_WARN_LAMP_REASON_MALFUNCTION" 3 "TPMS_WARN_LAMP_REASON_P_LOSS" /end COMPU_VTAB
/begin COMPU_VTAB tTpmsSpdLimHit "" TAB_VERB 3 0 "TPMS_SPD_LIM_HIT_UNKNOWN" 1 "TPMS_SPD_LIM_HIT_TRUE" 2 "TPMS_SPD_LIM_HIT_FALSE" /end COMPU_VTAB
/begin COMPU_VTAB tBrakeFluidLevel "" TAB_VERB 4 0 "BRK_FLUID_LVL_UNKNOWN" 1 "BRK_FLUID_LVL_LOW" 2 "BRK_FLUID_LVL_OK" 3 "BRK_FLUID_LVL_FAULT" /end COMPU_VTAB
/begin COMPU_VTAB tIceStartCmd "" TAB_VERB 3 0 "ICE_START_NONE" 1 "ICE_START_NOW" 2 "ICE_START_AT_STOP" /end COMPU_VTAB
/begin COMPU_VTAB tVsoVehicleMotionObserverSwt "" TAB_VERB 5 0 "VSO_VMO_SWT_OFF" 1 "VSO_VMO_SWT_KIN" 2 "VSO_VMO_SWT_DYN" 3 "VSO_VMO_SWT_HYB" 4 "VSO_VMO_SWT_DEBUG" /end COMPU_VTAB
/begin COMPU_VTAB tLvBatteryType "" TAB_VERB 2 0 "LV_BATT_UNKNOW" 1 "LV_BATT_PS000172_A123" /end COMPU_VTAB
/begin COMPU_VTAB tTrueVehVelSrc "" TAB_VERB 2 0 "TRUE_VEH_VEL_NONE" 1 "TRUE_VEH_VEL_VSO" /end COMPU_VTAB
/begin COMPU_VTAB tTorqueRequestTransitionState "" TAB_VERB 4 0 "TRAN_ST_DISABLED" 1 "TRAN_ST_ENABLED" 2 "TRAN_ST_DISABLING" 3 "TRAN_ST_ENABLING" /end COMPU_VTAB
/begin COMPU_VTAB tTpmsTirePState "" TAB_VERB 5 0 "TIRE_P_ST_UNKNOWN" 1 "TIRE_P_ST_OK" 2 "TIRE_P_ST_LOW_P" 3 "TIRE_P_ST_FLAT_TIRE" 4 "TIRE_P_ST_OVER_P" /end COMPU_VTAB
/begin COMPU_VTAB tSensorState "" TAB_VERB 6 0 "SNSR_ST_UKNOWN" 1 "SNSR_ST_FAULTY" 2 "SNSR_ST_INIT" 3 "SNSR_ST_TIMEOUT" 4 "SNSR_ST_PENDING" 5 "SNSR_ST_VALID" /end COMPU_VTAB
/begin COMPU_VTAB tHybMod "" TAB_VERB 3 0 "CHARGE_DEPLETING" 1 "CHARGE_SUSTAINING" 2 "CHARGE_INCREASING" /end COMPU_VTAB
/begin COMPU_VTAB tTle92464ChannelType "" TAB_VERB 5 0 "TLE92464EDHP_CHAN_0" 1 "TLE92464EDHP_CHAN_1" 2 "TLE92464EDHP_CHAN_2" 3 "TLE92464EDHP_CHAN_3" 4 "TLE92464EDHP_CHAN_MAX" /end COMPU_VTAB
/begin COMPU_VTAB tOdoSyncSt "" TAB_VERB 4 0 "ODO_INIT" 1 "ODO_SYNCING" 2 "ODO_FORCED_CALCN" 3 "ODO_SYNCED" /end COMPU_VTAB
/begin COMPU_VTAB tOdeStatus "" TAB_VERB 3 0 "ODE_STS_SOLUTION_FOUND" 1 "ODE_STS_INPUT_ERROR" 2 "ODE_STS_ALGORITHM_ERROR" /end COMPU_VTAB
/begin GROUP setup ""
 /begin REF_MEASUREMENT taskDynDtr taskDynHomlnSfty taskDynVso taskEnergyManager taskHmi taskHwio100ms taskHwio1ms taskHwioSolndrv taskHybridSm taskHybridTorque /end REF_MEASUREMENT
/end GROUP
/end MODULE
/end PROJECT
