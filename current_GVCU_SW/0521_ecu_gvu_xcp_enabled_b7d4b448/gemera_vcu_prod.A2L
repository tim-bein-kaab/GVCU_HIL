ASAP2_VERSION 1 71
/begin PROJECT GEMERA ""
/begin MODULE GVCU ""
/begin MOD_COMMON "" BYTE_ORDER MSB_FIRST ALIGNMENT_BYTE 1 ALIGNMENT_WORD 2 ALIGNMENT_LONG 4 ALIGNMENT_FLOAT16_IEEE 2 ALIGNMENT_FLOAT32_IEEE 4 ALIGNMENT_FLOAT64_IEEE 8 ALIGNMENT_INT64 8 /end MOD_COMMON
/begin TYPEDEF_MEASUREMENT tGear "" ULONG tGear 0 0 0 10 /end TYPEDEF_MEASUREMENT
/begin TYPEDEF_MEASUREMENT uint32_t_0xFFFFFFC0 "" ULONG NO_COMPU_METHOD 0 0 0 67108863 BIT_MASK 0xFFFFFFC0 /end TYPEDEF_MEASUREMENT
/begin TYPEDEF_MEASUREMENT tMegaJoule "" FLOAT32_IEEE tMegaJoule 0 0 -3.40282346639E+38 3.40282346639E+38 /end TYPEDEF_MEASUREMENT
/begin TYPEDEF_MEASUREMENT uint64_t_0x80000000000 "" A_UINT64 NO_COMPU_METHOD 0 0 0 1 BIT_MASK 0x80000000000 /end TYPEDEF_MEASUREMENT
/begin TYPEDEF_MEASUREMENT uint64_t_0x1000000000 "" A_UINT64 NO_COMPU_METHOD 0 0 0 1 BIT_MASK 0x1000000000 /end TYPEDEF_MEASUREMENT
/begin TYPEDEF_MEASUREMENT uint64_t_0x80000000 "" A_UINT64 NO_COMPU_METHOD 0 0 0 1 BIT_MASK 0x80000000 /end TYPEDEF_MEASUREMENT
/begin TYPEDEF_MEASUREMENT uint64_t_0x10000 "" A_UINT64 NO_COMPU_METHOD 0 0 0 1 BIT_MASK 0x10000 /end TYPEDEF_MEASUREMENT
/begin TYPEDEF_MEASUREMENT uint64_t_0x40000000000000 "" A_UINT64 NO_COMPU_METHOD 0 0 0 1 BIT_MASK 0x40000000000000 /end TYPEDEF_MEASUREMENT
/begin TYPEDEF_MEASUREMENT tRadianPerSecond "" FLOAT32_IEEE tRadianPerSecond 0 0 -1000 1000 /end TYPEDEF_MEASUREMENT
/begin TYPEDEF_MEASUREMENT tPercent_S8 "" SBYTE tPercent_S8 0 0 0 100 /end TYPEDEF_MEASUREMENT
/begin TYPEDEF_MEASUREMENT tDegree_10_S16 "" SWORD tDegree_10_S16 0 0 -720.0 720.0 /end TYPEDEF_MEASUREMENT
/begin TYPEDEF_MEASUREMENT uint64_t_0x2000000000 "" A_UINT64 NO_COMPU_METHOD 0 0 0 1 BIT_MASK 0x2000000000 /end TYPEDEF_MEASUREMENT
/begin TYPEDEF_MEASUREMENT tLiftCalibState "" ULONG tLiftCalibState 0 0 0 5 /end TYPEDEF_MEASUREMENT
/begin TYPEDEF_MEASUREMENT tFrictionBrakeTorqueArbitrationMode "" ULONG tFrictionBrakeTorqueArbitrationMode 0 0 0 5 /end TYPEDEF_MEASUREMENT
/begin TYPEDEF_MEASUREMENT uint32_t_0x400 "" ULONG NO_COMPU_METHOD 0 0 0 1 BIT_MASK 0x400 /end TYPEDEF_MEASUREMENT
/begin TYPEDEF_MEASUREMENT uint32_t_0x80000000 "" ULONG NO_COMPU_METHOD 0 0 0 1 BIT_MASK 0x80000000 /end TYPEDEF_MEASUREMENT
/begin TYPEDEF_MEASUREMENT uint32_t_0x8000000 "" ULONG NO_COMPU_METHOD 0 0 0 1 BIT_MASK 0x8000000 /end TYPEDEF_MEASUREMENT
/begin TYPEDEF_MEASUREMENT tMillimetre_10_S16 "" SWORD tMillimetre_10_S16 0 0 -1000.0 1000.0 /end TYPEDEF_MEASUREMENT
/begin TYPEDEF_MEASUREMENT uint64_t_0x1 "" A_UINT64 NO_COMPU_METHOD 0 0 0 1 BIT_MASK 0x1 /end TYPEDEF_MEASUREMENT
/begin TYPEDEF_MEASUREMENT uint64_t_0x100000000000000 "" A_UINT64 NO_COMPU_METHOD 0 0 0 1 BIT_MASK 0x100000000000000 /end TYPEDEF_MEASUREMENT
/begin TYPEDEF_MEASUREMENT uint64_t_0x4000000000000 "" A_UINT64 NO_COMPU_METHOD 0 0 0 1 BIT_MASK 0x4000000000000 /end TYPEDEF_MEASUREMENT
/begin TYPEDEF_MEASUREMENT uint64_t_0x400000000 "" A_UINT64 NO_COMPU_METHOD 0 0 0 1 BIT_MASK 0x400000000 /end TYPEDEF_MEASUREMENT
/begin TYPEDEF_MEASUREMENT tPropulsionMode "" ULONG tPropulsionMode 0 0 0 4 /end TYPEDEF_MEASUREMENT
/begin TYPEDEF_MEASUREMENT uint32_t_0xFFFFFFE0 "" ULONG NO_COMPU_METHOD 0 0 0 134217727 BIT_MASK 0xFFFFFFE0 /end TYPEDEF_MEASUREMENT
/begin TYPEDEF_MEASUREMENT tNewtonMetre "" FLOAT32_IEEE tNewtonMetre 0 0 -100000 100000 /end TYPEDEF_MEASUREMENT
/begin TYPEDEF_MEASUREMENT tPropshaftDrivingCrankState "" ULONG tPropshaftDrivingCrankState 0 0 0 3 /end TYPEDEF_MEASUREMENT
/begin TYPEDEF_MEASUREMENT uint32_t_0x10000 "" ULONG NO_COMPU_METHOD 0 0 0 1 BIT_MASK 0x10000 /end TYPEDEF_MEASUREMENT
/begin TYPEDEF_MEASUREMENT tDiagnos "" ULONG tDiagnos 0 0 0 2 /end TYPEDEF_MEASUREMENT
/begin TYPEDEF_MEASUREMENT uint64_t_0x40000 "" A_UINT64 NO_COMPU_METHOD 0 0 0 1 BIT_MASK 0x40000 /end TYPEDEF_MEASUREMENT
/begin TYPEDEF_MEASUREMENT tBar "" FLOAT32_IEEE tBar 0 0 -1 1000 /end TYPEDEF_MEASUREMENT
/begin TYPEDEF_MEASUREMENT tSign "" SLONG tSign 0 0 -1 1 /end TYPEDEF_MEASUREMENT
/begin TYPEDEF_MEASUREMENT uint64_t_0x100 "" A_UINT64 NO_COMPU_METHOD 0 0 0 1 BIT_MASK 0x100 /end TYPEDEF_MEASUREMENT
/begin TYPEDEF_MEASUREMENT uint64_t_0x8000000000000 "" A_UINT64 NO_COMPU_METHOD 0 0 0 1 BIT_MASK 0x8000000000000 /end TYPEDEF_MEASUREMENT
/begin TYPEDEF_MEASUREMENT uint32_t_0x1000000 "" ULONG NO_COMPU_METHOD 0 0 0 1 BIT_MASK 0x1000000 /end TYPEDEF_MEASUREMENT
/begin TYPEDEF_MEASUREMENT uint64_t_0x200000000 "" A_UINT64 NO_COMPU_METHOD 0 0 0 1 BIT_MASK 0x200000000 /end TYPEDEF_MEASUREMENT
/begin TYPEDEF_MEASUREMENT tDegree "" FLOAT32_IEEE tDegree 0 0 -720 720 /end TYPEDEF_MEASUREMENT
/begin TYPEDEF_MEASUREMENT tCluCtrlType "" ULONG tCluCtrlType 0 0 0 1 /end TYPEDEF_MEASUREMENT
/begin TYPEDEF_MEASUREMENT tHertz "" FLOAT32_IEEE tHertz 0 0 0 30000 /end TYPEDEF_MEASUREMENT
/begin TYPEDEF_MEASUREMENT tLiftMovement "" ULONG tLiftMovement 0 0 0 2 /end TYPEDEF_MEASUREMENT
/begin TYPEDEF_MEASUREMENT uint64_t_0x400 "" A_UINT64 NO_COMPU_METHOD 0 0 0 1 BIT_MASK 0x400 /end TYPEDEF_MEASUREMENT
/begin TYPEDEF_MEASUREMENT uint16_t_0x4 "" UWORD NO_COMPU_METHOD 0 0 0 1 BIT_MASK 0x4 /end TYPEDEF_MEASUREMENT
/begin TYPEDEF_MEASUREMENT size_t "" ULONG NO_COMPU_METHOD 0 0 0 4294967295 /end TYPEDEF_MEASUREMENT
/begin TYPEDEF_MEASUREMENT tThermalUnitFailReason "" ULONG tThermalUnitFailReason 0 0 0 3 /end TYPEDEF_MEASUREMENT
/begin TYPEDEF_MEASUREMENT tPrelCluReqSt "" ULONG tPrelCluReqSt 0 0 0 6 /end TYPEDEF_MEASUREMENT
/begin TYPEDEF_MEASUREMENT uint64_t_0x4000000000 "" A_UINT64 NO_COMPU_METHOD 0 0 0 1 BIT_MASK 0x4000000000 /end TYPEDEF_MEASUREMENT
/begin TYPEDEF_MEASUREMENT tSecond "" FLOAT32_IEEE tSecond 0 0 0 3600 /end TYPEDEF_MEASUREMENT
/begin TYPEDEF_MEASUREMENT uint64_t_0x1000 "" A_UINT64 NO_COMPU_METHOD 0 0 0 1 BIT_MASK 0x1000 /end TYPEDEF_MEASUREMENT
/begin TYPEDEF_MEASUREMENT tHybSmState "" ULONG tHybSmState 0 0 0 6 /end TYPEDEF_MEASUREMENT
/begin TYPEDEF_MEASUREMENT uint16_t_0x8 "" UWORD NO_COMPU_METHOD 0 0 0 1 BIT_MASK 0x8 /end TYPEDEF_MEASUREMENT
/begin TYPEDEF_MEASUREMENT tQualifier "" ULONG tQualifier 0 0 0 3 /end TYPEDEF_MEASUREMENT
/begin TYPEDEF_MEASUREMENT tFraction "" FLOAT32_IEEE tFraction 0 0 0 1 /end TYPEDEF_MEASUREMENT
/begin TYPEDEF_MEASUREMENT tRideHeightMode "" ULONG tRideHeightMode 0 0 0 8 /end TYPEDEF_MEASUREMENT
/begin TYPEDEF_MEASUREMENT uint32_t "" ULONG NO_COMPU_METHOD 0 0 0 4294967295 /end TYPEDEF_MEASUREMENT
/begin TYPEDEF_MEASUREMENT uint32_t_0x40000000 "" ULONG NO_COMPU_METHOD 0 0 0 1 BIT_MASK 0x40000000 /end TYPEDEF_MEASUREMENT
/begin TYPEDEF_MEASUREMENT uint64_t_0x4000 "" A_UINT64 NO_COMPU_METHOD 0 0 0 1 BIT_MASK 0x4000 /end TYPEDEF_MEASUREMENT
/begin TYPEDEF_MEASUREMENT tBar_100_S16 "" SWORD tBar_100_S16 0 0 -1.0 1000.0 /end TYPEDEF_MEASUREMENT
/begin TYPEDEF_MEASUREMENT uint64_t_0x1000000000000 "" A_UINT64 NO_COMPU_METHOD 0 0 0 1 BIT_MASK 0x1000000000000 /end TYPEDEF_MEASUREMENT
/begin TYPEDEF_MEASUREMENT uint32_t_0x8000 "" ULONG NO_COMPU_METHOD 0 0 0 1 BIT_MASK 0x8000 /end TYPEDEF_MEASUREMENT
/begin TYPEDEF_MEASUREMENT uint64_t_0x40000000 "" A_UINT64 NO_COMPU_METHOD 0 0 0 1 BIT_MASK 0x40000000 /end TYPEDEF_MEASUREMENT
/begin TYPEDEF_MEASUREMENT tPropshaftChargeState "" ULONG tPropshaftChargeState 0 0 0 2 /end TYPEDEF_MEASUREMENT
/begin TYPEDEF_MEASUREMENT uint64_t_0x100000 "" A_UINT64 NO_COMPU_METHOD 0 0 0 1 BIT_MASK 0x100000 /end TYPEDEF_MEASUREMENT
/begin TYPEDEF_MEASUREMENT tCombustionEngineControlState "" ULONG tCombustionEngineControlState 0 0 0 6 /end TYPEDEF_MEASUREMENT
/begin TYPEDEF_MEASUREMENT uint64_t_0x8000000000 "" A_UINT64 NO_COMPU_METHOD 0 0 0 1 BIT_MASK 0x8000000000 /end TYPEDEF_MEASUREMENT
/begin TYPEDEF_MEASUREMENT uint32_t_0x8 "" ULONG NO_COMPU_METHOD 0 0 0 1 BIT_MASK 0x8 /end TYPEDEF_MEASUREMENT
/begin TYPEDEF_MEASUREMENT int16_t "" SWORD NO_COMPU_METHOD 0 0 -32768 32767 /end TYPEDEF_MEASUREMENT
/begin TYPEDEF_MEASUREMENT uint16_t_0x80 "" UWORD NO_COMPU_METHOD 0 0 0 1 BIT_MASK 0x80 /end TYPEDEF_MEASUREMENT
/begin TYPEDEF_MEASUREMENT tTakeoffState "" ULONG tTakeoffState 0 0 0 4 /end TYPEDEF_MEASUREMENT
/begin TYPEDEF_MEASUREMENT uint32_t_0x10 "" ULONG NO_COMPU_METHOD 0 0 0 1 BIT_MASK 0x10 /end TYPEDEF_MEASUREMENT
/begin TYPEDEF_MEASUREMENT uint64_t_0x4000000 "" A_UINT64 NO_COMPU_METHOD 0 0 0 1 BIT_MASK 0x4000000 /end TYPEDEF_MEASUREMENT
/begin TYPEDEF_MEASUREMENT tRateControllerGainSet "" ULONG tRateControllerGainSet 0 0 0 2 /end TYPEDEF_MEASUREMENT
/begin TYPEDEF_MEASUREMENT tTorqueSystemState "" ULONG tTorqueSystemState 0 0 0 5 /end TYPEDEF_MEASUREMENT
/begin TYPEDEF_MEASUREMENT tJoule "" FLOAT32_IEEE tJoule 0 0 -3.40282346639E+38 3.40282346639E+38 /end TYPEDEF_MEASUREMENT
/begin TYPEDEF_MEASUREMENT uint64_t_0x800 "" A_UINT64 NO_COMPU_METHOD 0 0 0 1 BIT_MASK 0x800 /end TYPEDEF_MEASUREMENT
/begin TYPEDEF_MEASUREMENT tRampState "" ULONG tRampState 0 0 0 2 /end TYPEDEF_MEASUREMENT
/begin TYPEDEF_MEASUREMENT uint32_t_0x4000 "" ULONG NO_COMPU_METHOD 0 0 0 1 BIT_MASK 0x4000 /end TYPEDEF_MEASUREMENT
/begin TYPEDEF_MEASUREMENT tPerformanceModeRHC "" ULONG tPerformanceModeRHC 0 0 0 3 /end TYPEDEF_MEASUREMENT
/begin TYPEDEF_MEASUREMENT uint64_t_0x200000000000 "" A_UINT64 NO_COMPU_METHOD 0 0 0 1 BIT_MASK 0x200000000000 /end TYPEDEF_MEASUREMENT
/begin TYPEDEF_MEASUREMENT uint64_t_0x800000000000000 "" A_UINT64 NO_COMPU_METHOD 0 0 0 1 BIT_MASK 0x800000000000000 /end TYPEDEF_MEASUREMENT
/begin TYPEDEF_MEASUREMENT tFactor_1000_S16 "" SWORD tFactor_1000_S16 0 0 -32.768 32.767 /end TYPEDEF_MEASUREMENT
/begin TYPEDEF_MEASUREMENT tInvSmStatus "" ULONG tInvSmStatus 0 0 0 5 /end TYPEDEF_MEASUREMENT
/begin TYPEDEF_MEASUREMENT tAcknowledgementStatus "" ULONG tAcknowledgementStatus 0 0 0 2 /end TYPEDEF_MEASUREMENT
/begin TYPEDEF_MEASUREMENT uint16_t_0x40 "" UWORD NO_COMPU_METHOD 0 0 0 1 BIT_MASK 0x40 /end TYPEDEF_MEASUREMENT
/begin TYPEDEF_MEASUREMENT tInvCtrlMode "" ULONG tInvCtrlMode 0 0 0 3 /end TYPEDEF_MEASUREMENT
/begin TYPEDEF_MEASUREMENT uint64_t_0x20000000000000 "" A_UINT64 NO_COMPU_METHOD 0 0 0 1 BIT_MASK 0x20000000000000 /end TYPEDEF_MEASUREMENT
/begin TYPEDEF_MEASUREMENT uint64_t_0x200 "" A_UINT64 NO_COMPU_METHOD 0 0 0 1 BIT_MASK 0x200 /end TYPEDEF_MEASUREMENT
/begin TYPEDEF_MEASUREMENT uint64_t_0xFFFFFFFFFFFFC000 "" A_UINT64 NO_COMPU_METHOD 0 0 0 1125899906842623 BIT_MASK 0xFFFFFFFFFFFFC000 /end TYPEDEF_MEASUREMENT
/begin TYPEDEF_MEASUREMENT uint64_t_0xFFFFFFFFF "" A_UINT64 NO_COMPU_METHOD 0 0 0 68719476735 BIT_MASK 0xFFFFFFFFF /end TYPEDEF_MEASUREMENT
/begin TYPEDEF_MEASUREMENT tPumpModel "" ULONG tPumpModel 0 0 0 3 /end TYPEDEF_MEASUREMENT
/begin TYPEDEF_MEASUREMENT uint32_t_0x20 "" ULONG NO_COMPU_METHOD 0 0 0 1 BIT_MASK 0x20 /end TYPEDEF_MEASUREMENT
/begin TYPEDEF_MEASUREMENT uint64_t_0x8000000000000000 "" A_UINT64 NO_COMPU_METHOD 0 0 0 1 BIT_MASK 0x8000000000000000 /end TYPEDEF_MEASUREMENT
/begin TYPEDEF_MEASUREMENT tRideHeightControlStrategy "" ULONG tRideHeightControlStrategy 0 0 0 1 /end TYPEDEF_MEASUREMENT
/begin TYPEDEF_MEASUREMENT unsigned_int "" ULONG NO_COMPU_METHOD 0 0 0 4294967295 /end TYPEDEF_MEASUREMENT
/begin TYPEDEF_MEASUREMENT tNmRequest "" ULONG tNmRequest 0 0 0 4 /end TYPEDEF_MEASUREMENT
/begin TYPEDEF_MEASUREMENT int32_t "" SLONG NO_COMPU_METHOD 0 0 -2147483648 2147483647 /end TYPEDEF_MEASUREMENT
/begin TYPEDEF_MEASUREMENT tPowerState "" ULONG tPowerState 0 0 0 15 /end TYPEDEF_MEASUREMENT
/begin TYPEDEF_MEASUREMENT uint64_t_0x8000000 "" A_UINT64 NO_COMPU_METHOD 0 0 0 1 BIT_MASK 0x8000000 /end TYPEDEF_MEASUREMENT
/begin TYPEDEF_MEASUREMENT uint32_t_0x20000000 "" ULONG NO_COMPU_METHOD 0 0 0 1 BIT_MASK 0x20000000 /end TYPEDEF_MEASUREMENT
/begin TYPEDEF_MEASUREMENT tLiftState "" ULONG tLiftState 0 0 0 6 /end TYPEDEF_MEASUREMENT
/begin TYPEDEF_MEASUREMENT uint64_t_0x8000 "" A_UINT64 NO_COMPU_METHOD 0 0 0 1 BIT_MASK 0x8000 /end TYPEDEF_MEASUREMENT
/begin TYPEDEF_MEASUREMENT _float "" FLOAT32_IEEE NO_COMPU_METHOD 0 0 -3.40282346639E+38 3.40282346639E+38 /end TYPEDEF_MEASUREMENT
/begin TYPEDEF_MEASUREMENT uint16_t_0xFC00 "" UWORD NO_COMPU_METHOD 0 0 0 63 BIT_MASK 0xFC00 /end TYPEDEF_MEASUREMENT
/begin TYPEDEF_MEASUREMENT uint64_t_0x400000 "" A_UINT64 NO_COMPU_METHOD 0 0 0 1 BIT_MASK 0x400000 /end TYPEDEF_MEASUREMENT
/begin TYPEDEF_MEASUREMENT uint64_t_0x40 "" A_UINT64 NO_COMPU_METHOD 0 0 0 1 BIT_MASK 0x40 /end TYPEDEF_MEASUREMENT
/begin TYPEDEF_MEASUREMENT tThermalDiagStatus "" ULONG tThermalDiagStatus 0 0 0 4 /end TYPEDEF_MEASUREMENT
/begin TYPEDEF_MEASUREMENT uint64_t_0x1000000000000000 "" A_UINT64 NO_COMPU_METHOD 0 0 0 1 BIT_MASK 0x1000000000000000 /end TYPEDEF_MEASUREMENT
/begin TYPEDEF_MEASUREMENT uint8_t "" UBYTE NO_COMPU_METHOD 0 0 0 255 /end TYPEDEF_MEASUREMENT
/begin TYPEDEF_MEASUREMENT tKilometrePerHour "" FLOAT32_IEEE tKilometrePerHour 0 0 -600 600 /end TYPEDEF_MEASUREMENT
/begin TYPEDEF_MEASUREMENT tRadian "" FLOAT32_IEEE tRadian 0 0 -20 20 /end TYPEDEF_MEASUREMENT
/begin TYPEDEF_MEASUREMENT uint64_t_0x200000000000000 "" A_UINT64 NO_COMPU_METHOD 0 0 0 1 BIT_MASK 0x200000000000000 /end TYPEDEF_MEASUREMENT
/begin TYPEDEF_MEASUREMENT uint64_t_0x4000000000000000 "" A_UINT64 NO_COMPU_METHOD 0 0 0 1 BIT_MASK 0x4000000000000000 /end TYPEDEF_MEASUREMENT
/begin TYPEDEF_MEASUREMENT tEnableHold "" ULONG tEnableHold 0 0 0 2 /end TYPEDEF_MEASUREMENT
/begin TYPEDEF_MEASUREMENT tAmpere "" FLOAT32_IEEE tAmpere 0 0 0 10000 /end TYPEDEF_MEASUREMENT
/begin TYPEDEF_MEASUREMENT tClutchState "" ULONG tClutchState 0 0 0 7 /end TYPEDEF_MEASUREMENT
/begin TYPEDEF_MEASUREMENT uint64_t_0x10 "" A_UINT64 NO_COMPU_METHOD 0 0 0 1 BIT_MASK 0x10 /end TYPEDEF_MEASUREMENT
/begin TYPEDEF_MEASUREMENT uint64_t_0x40000000000 "" A_UINT64 NO_COMPU_METHOD 0 0 0 1 BIT_MASK 0x40000000000 /end TYPEDEF_MEASUREMENT
/begin TYPEDEF_MEASUREMENT tSupportingMode "" ULONG tSupportingMode 0 0 0 6 /end TYPEDEF_MEASUREMENT
/begin TYPEDEF_MEASUREMENT tFunctionStatus "" ULONG tFunctionStatus 0 0 0 3 /end TYPEDEF_MEASUREMENT
/begin TYPEDEF_MEASUREMENT uint16_t_0x1 "" UWORD NO_COMPU_METHOD 0 0 0 1 BIT_MASK 0x1 /end TYPEDEF_MEASUREMENT
/begin TYPEDEF_MEASUREMENT tPerformanceMode "" ULONG tPerformanceMode 0 0 0 7 /end TYPEDEF_MEASUREMENT
/begin TYPEDEF_MEASUREMENT uint64_t_0x100000000 "" A_UINT64 NO_COMPU_METHOD 0 0 0 1 BIT_MASK 0x100000000 /end TYPEDEF_MEASUREMENT
/begin TYPEDEF_MEASUREMENT tNewtonMetrePerBar "" FLOAT32_IEEE tNewtonMetrePerBar 0 0 0 150 /end TYPEDEF_MEASUREMENT
/begin TYPEDEF_MEASUREMENT tPressureReqRsn "" ULONG tPressureReqRsn 0 0 0 5 /end TYPEDEF_MEASUREMENT
/begin TYPEDEF_MEASUREMENT uint64_t_0x10000000000 "" A_UINT64 NO_COMPU_METHOD 0 0 0 1 BIT_MASK 0x10000000000 /end TYPEDEF_MEASUREMENT
/begin TYPEDEF_MEASUREMENT tRevolutionPerMinute_S16 "" SWORD tRevolutionPerMinute_S16 0 0 -32768 32767 /end TYPEDEF_MEASUREMENT
/begin TYPEDEF_MEASUREMENT uint32_t_0x10000000 "" ULONG NO_COMPU_METHOD 0 0 0 1 BIT_MASK 0x10000000 /end TYPEDEF_MEASUREMENT
/begin TYPEDEF_MEASUREMENT tIntegratorState "" ULONG tIntegratorState 0 0 0 4 /end TYPEDEF_MEASUREMENT
/begin TYPEDEF_MEASUREMENT tMillisecond "" FLOAT32_IEEE tMillisecond 0 0 0 3600000 /end TYPEDEF_MEASUREMENT
/begin TYPEDEF_MEASUREMENT tInvState "" ULONG tInvState 0 0 0 6 /end TYPEDEF_MEASUREMENT
/begin TYPEDEF_MEASUREMENT tMetrePerSquareSecond "" FLOAT32_IEEE tMetrePerSquareSecond 0 0 -50 50 /end TYPEDEF_MEASUREMENT
/begin TYPEDEF_MEASUREMENT uint16_t_0x10 "" UWORD NO_COMPU_METHOD 0 0 0 1 BIT_MASK 0x10 /end TYPEDEF_MEASUREMENT
/begin TYPEDEF_MEASUREMENT uint32_t_0x40 "" ULONG NO_COMPU_METHOD 0 0 0 1 BIT_MASK 0x40 /end TYPEDEF_MEASUREMENT
/begin TYPEDEF_MEASUREMENT uint64_t_0x20000000000 "" A_UINT64 NO_COMPU_METHOD 0 0 0 1 BIT_MASK 0x20000000000 /end TYPEDEF_MEASUREMENT
/begin TYPEDEF_MEASUREMENT tKilowatt "" FLOAT32_IEEE tKilowatt 0 0 -10000 10000 /end TYPEDEF_MEASUREMENT
/begin TYPEDEF_MEASUREMENT uint64_t_0x2 "" A_UINT64 NO_COMPU_METHOD 0 0 0 1 BIT_MASK 0x2 /end TYPEDEF_MEASUREMENT
/begin TYPEDEF_MEASUREMENT tHex_U16 "" UWORD tHex_U16 0 0 0 65535 /end TYPEDEF_MEASUREMENT
/begin TYPEDEF_MEASUREMENT uint64_t_0x200000 "" A_UINT64 NO_COMPU_METHOD 0 0 0 1 BIT_MASK 0x200000 /end TYPEDEF_MEASUREMENT
/begin TYPEDEF_MEASUREMENT uint32_t_0x2000 "" ULONG NO_COMPU_METHOD 0 0 0 1 BIT_MASK 0x2000 /end TYPEDEF_MEASUREMENT
/begin TYPEDEF_MEASUREMENT uint32_t_0xFFFE0000 "" ULONG NO_COMPU_METHOD 0 0 0 32767 BIT_MASK 0xFFFE0000 /end TYPEDEF_MEASUREMENT
/begin TYPEDEF_MEASUREMENT uint64_t_0x80000 "" A_UINT64 NO_COMPU_METHOD 0 0 0 1 BIT_MASK 0x80000 /end TYPEDEF_MEASUREMENT
/begin TYPEDEF_MEASUREMENT uint64_t_0x1000000 "" A_UINT64 NO_COMPU_METHOD 0 0 0 1 BIT_MASK 0x1000000 /end TYPEDEF_MEASUREMENT
/begin TYPEDEF_MEASUREMENT tMillisecond_U32 "" ULONG tMillisecond_U32 0 0 0 3600000 /end TYPEDEF_MEASUREMENT
/begin TYPEDEF_MEASUREMENT uint16_t_0x20 "" UWORD NO_COMPU_METHOD 0 0 0 1 BIT_MASK 0x20 /end TYPEDEF_MEASUREMENT
/begin TYPEDEF_MEASUREMENT tInvSpdCtrlGainSet "" ULONG tInvSpdCtrlGainSet 0 0 0 7 /end TYPEDEF_MEASUREMENT
/begin TYPEDEF_MEASUREMENT uint32_t_0x800 "" ULONG NO_COMPU_METHOD 0 0 0 1 BIT_MASK 0x800 /end TYPEDEF_MEASUREMENT
/begin TYPEDEF_MEASUREMENT uint64_t_0x100000000000 "" A_UINT64 NO_COMPU_METHOD 0 0 0 1 BIT_MASK 0x100000000000 /end TYPEDEF_MEASUREMENT
/begin TYPEDEF_MEASUREMENT tRadianPerSquareSecond "" FLOAT32_IEEE tRadianPerSquareSecond 0 0 -100000 100000 /end TYPEDEF_MEASUREMENT
/begin TYPEDEF_MEASUREMENT uint64_t_0x8 "" A_UINT64 NO_COMPU_METHOD 0 0 0 1 BIT_MASK 0x8 /end TYPEDEF_MEASUREMENT
/begin TYPEDEF_MEASUREMENT tHertz_10_S16 "" SWORD tHertz_10_S16 0 0 0.0 30000.0 /end TYPEDEF_MEASUREMENT
/begin TYPEDEF_MEASUREMENT tIdleState "" ULONG tIdleState 0 0 0 4 /end TYPEDEF_MEASUREMENT
/begin TYPEDEF_MEASUREMENT tFanModel "" ULONG tFanModel 0 0 0 3 /end TYPEDEF_MEASUREMENT
/begin TYPEDEF_MEASUREMENT tKilometrePerHour_10_S16 "" SWORD tKilometrePerHour_10_S16 0 0 -600.0 600.0 /end TYPEDEF_MEASUREMENT
/begin TYPEDEF_MEASUREMENT uint64_t_0x80000000000000 "" A_UINT64 NO_COMPU_METHOD 0 0 0 1 BIT_MASK 0x80000000000000 /end TYPEDEF_MEASUREMENT
/begin TYPEDEF_MEASUREMENT tSlaveErrorStatus "" ULONG tSlaveErrorStatus 0 0 0 2 /end TYPEDEF_MEASUREMENT
/begin TYPEDEF_MEASUREMENT uint64_t_0x80 "" A_UINT64 NO_COMPU_METHOD 0 0 0 1 BIT_MASK 0x80 /end TYPEDEF_MEASUREMENT
/begin TYPEDEF_MEASUREMENT uint16_t_0x200 "" UWORD NO_COMPU_METHOD 0 0 0 1 BIT_MASK 0x200 /end TYPEDEF_MEASUREMENT
/begin TYPEDEF_MEASUREMENT uint32_t_0x2 "" ULONG NO_COMPU_METHOD 0 0 0 1 BIT_MASK 0x2 /end TYPEDEF_MEASUREMENT
/begin TYPEDEF_MEASUREMENT tPercent_100_S16 "" SWORD tPercent_100_S16 0 0 0.0 100.0 /end TYPEDEF_MEASUREMENT
/begin TYPEDEF_MEASUREMENT uint32_t_0x200 "" ULONG NO_COMPU_METHOD 0 0 0 1 BIT_MASK 0x200 /end TYPEDEF_MEASUREMENT
/begin TYPEDEF_MEASUREMENT tFactor "" FLOAT32_IEEE tFactor 0 0 -3.40282346639E+38 3.40282346639E+38 /end TYPEDEF_MEASUREMENT
/begin TYPEDEF_MEASUREMENT uint64_t_0x800000000000 "" A_UINT64 NO_COMPU_METHOD 0 0 0 1 BIT_MASK 0x800000000000 /end TYPEDEF_MEASUREMENT
/begin TYPEDEF_MEASUREMENT tCelsius_10_S16 "" SWORD tCelsius_10_S16 0 0 -400.0 10000.0 /end TYPEDEF_MEASUREMENT
/begin TYPEDEF_MEASUREMENT uint32_t_0x100 "" ULONG NO_COMPU_METHOD 0 0 0 1 BIT_MASK 0x100 /end TYPEDEF_MEASUREMENT
/begin TYPEDEF_MEASUREMENT uint64_t_0x400000000000 "" A_UINT64 NO_COMPU_METHOD 0 0 0 1 BIT_MASK 0x400000000000 /end TYPEDEF_MEASUREMENT
/begin TYPEDEF_MEASUREMENT uint32_t_0x80 "" ULONG NO_COMPU_METHOD 0 0 0 1 BIT_MASK 0x80 /end TYPEDEF_MEASUREMENT
/begin TYPEDEF_MEASUREMENT uint32_t_0x4000000 "" ULONG NO_COMPU_METHOD 0 0 0 1 BIT_MASK 0x4000000 /end TYPEDEF_MEASUREMENT
/begin TYPEDEF_MEASUREMENT tDriveMode "" ULONG tDriveMode 0 0 0 5 /end TYPEDEF_MEASUREMENT
/begin TYPEDEF_MEASUREMENT tFaultLevel "" ULONG tFaultLevel 0 0 0 6 /end TYPEDEF_MEASUREMENT
/begin TYPEDEF_MEASUREMENT uint32_t_0x1 "" ULONG NO_COMPU_METHOD 0 0 0 1 BIT_MASK 0x1 /end TYPEDEF_MEASUREMENT
/begin TYPEDEF_MEASUREMENT uint64_t_0x1FFFF "" A_UINT64 NO_COMPU_METHOD 0 0 0 131071 BIT_MASK 0x1FFFF /end TYPEDEF_MEASUREMENT
/begin TYPEDEF_MEASUREMENT uint64_t_0x20000000 "" A_UINT64 NO_COMPU_METHOD 0 0 0 1 BIT_MASK 0x20000000 /end TYPEDEF_MEASUREMENT
/begin TYPEDEF_MEASUREMENT uint64_t_0x800000 "" A_UINT64 NO_COMPU_METHOD 0 0 0 1 BIT_MASK 0x800000 /end TYPEDEF_MEASUREMENT
/begin TYPEDEF_MEASUREMENT uint16_t_0x2 "" UWORD NO_COMPU_METHOD 0 0 0 1 BIT_MASK 0x2 /end TYPEDEF_MEASUREMENT
/begin TYPEDEF_MEASUREMENT uint64_t_0x400000000000000 "" A_UINT64 NO_COMPU_METHOD 0 0 0 1 BIT_MASK 0x400000000000000 /end TYPEDEF_MEASUREMENT
/begin TYPEDEF_MEASUREMENT uint64_t "" A_UINT64 NO_COMPU_METHOD 0 0 0 18446744073709551615 /end TYPEDEF_MEASUREMENT
/begin TYPEDEF_MEASUREMENT uint64_t_0x2000000000000 "" A_UINT64 NO_COMPU_METHOD 0 0 0 1 BIT_MASK 0x2000000000000 /end TYPEDEF_MEASUREMENT
/begin TYPEDEF_MEASUREMENT uint64_t_0x20 "" A_UINT64 NO_COMPU_METHOD 0 0 0 1 BIT_MASK 0x20 /end TYPEDEF_MEASUREMENT
/begin TYPEDEF_MEASUREMENT tYawTorqueRequestSaturation "" ULONG tYawTorqueRequestSaturation 0 0 0 3 /end TYPEDEF_MEASUREMENT
/begin TYPEDEF_MEASUREMENT uint64_t_0x2000000000000000 "" A_UINT64 NO_COMPU_METHOD 0 0 0 1 BIT_MASK 0x2000000000000000 /end TYPEDEF_MEASUREMENT
/begin TYPEDEF_MEASUREMENT tRideHeightRollCompensationState "" ULONG tRideHeightRollCompensationState 0 0 0 3 /end TYPEDEF_MEASUREMENT
/begin TYPEDEF_MEASUREMENT uint32_t_0x4 "" ULONG NO_COMPU_METHOD 0 0 0 1 BIT_MASK 0x4 /end TYPEDEF_MEASUREMENT
/begin TYPEDEF_MEASUREMENT uint64_t_0x800000000 "" A_UINT64 NO_COMPU_METHOD 0 0 0 1 BIT_MASK 0x800000000 /end TYPEDEF_MEASUREMENT
/begin TYPEDEF_MEASUREMENT uint32_t_0x1000 "" ULONG NO_COMPU_METHOD 0 0 0 1 BIT_MASK 0x1000 /end TYPEDEF_MEASUREMENT
/begin TYPEDEF_MEASUREMENT tWatt "" FLOAT32_IEEE tWatt 0 0 -3.40282346639E+38 3.40282346639E+38 /end TYPEDEF_MEASUREMENT
/begin TYPEDEF_MEASUREMENT _Bool "" UBYTE NO_COMPU_METHOD 0 0 0 1 /end TYPEDEF_MEASUREMENT
/begin TYPEDEF_MEASUREMENT uint64_t_0x2000000 "" A_UINT64 NO_COMPU_METHOD 0 0 0 1 BIT_MASK 0x2000000 /end TYPEDEF_MEASUREMENT
/begin TYPEDEF_MEASUREMENT uint64_t_0x2000 "" A_UINT64 NO_COMPU_METHOD 0 0 0 1 BIT_MASK 0x2000 /end TYPEDEF_MEASUREMENT
/begin TYPEDEF_MEASUREMENT uint64_t_0x20000 "" A_UINT64 NO_COMPU_METHOD 0 0 0 1 BIT_MASK 0x20000 /end TYPEDEF_MEASUREMENT
/begin TYPEDEF_MEASUREMENT tPropshaftStationaryCrankState "" ULONG tPropshaftStationaryCrankState 0 0 0 5 /end TYPEDEF_MEASUREMENT
/begin TYPEDEF_MEASUREMENT tKilometrePerHour_S16 "" SWORD tKilometrePerHour_S16 0 0 -600 600 /end TYPEDEF_MEASUREMENT
/begin TYPEDEF_MEASUREMENT uint32_t_0x2000000 "" ULONG NO_COMPU_METHOD 0 0 0 1 BIT_MASK 0x2000000 /end TYPEDEF_MEASUREMENT
/begin TYPEDEF_MEASUREMENT tLiftIndication "" ULONG tLiftIndication 0 0 0 5 /end TYPEDEF_MEASUREMENT
/begin TYPEDEF_MEASUREMENT tMegaJoule_U32 "" ULONG tMegaJoule_U32 0 0 0 4294967295 /end TYPEDEF_MEASUREMENT
/begin TYPEDEF_MEASUREMENT uint32_t_0xFFFFFFF0 "" ULONG NO_COMPU_METHOD 0 0 0 268435455 BIT_MASK 0xFFFFFFF0 /end TYPEDEF_MEASUREMENT
/begin TYPEDEF_MEASUREMENT tDriveConfiguration "" ULONG tDriveConfiguration 0 0 0 3 /end TYPEDEF_MEASUREMENT
/begin TYPEDEF_MEASUREMENT tRollingState "" ULONG tRollingState 0 0 0 4 /end TYPEDEF_MEASUREMENT
/begin TYPEDEF_MEASUREMENT uint64_t_0x4 "" A_UINT64 NO_COMPU_METHOD 0 0 0 1 BIT_MASK 0x4 /end TYPEDEF_MEASUREMENT
/begin TYPEDEF_MEASUREMENT uint64_t_0x10000000000000 "" A_UINT64 NO_COMPU_METHOD 0 0 0 1 BIT_MASK 0x10000000000000 /end TYPEDEF_MEASUREMENT
/begin TYPEDEF_MEASUREMENT tPowerSupply "" ULONG tPowerSupply 0 0 0 2 /end TYPEDEF_MEASUREMENT
/begin TYPEDEF_MEASUREMENT tTqMacSt "" ULONG tTqMacSt 0 0 0 20 /end TYPEDEF_MEASUREMENT
/begin TYPEDEF_MEASUREMENT uint16_t "" UWORD NO_COMPU_METHOD 0 0 0 65535 /end TYPEDEF_MEASUREMENT
/begin TYPEDEF_MEASUREMENT uint64_t_0x10000000 "" A_UINT64 NO_COMPU_METHOD 0 0 0 1 BIT_MASK 0x10000000 /end TYPEDEF_MEASUREMENT
/begin TYPEDEF_MEASUREMENT tNmSlaveStatus "" ULONG tNmSlaveStatus 0 0 0 12 /end TYPEDEF_MEASUREMENT
/begin TYPEDEF_MEASUREMENT tMillivolt_S16 "" SWORD tMillivolt_S16 0 0 0 10000 /end TYPEDEF_MEASUREMENT
/begin TYPEDEF_MEASUREMENT tCluCtrlState "" ULONG tCluCtrlState 0 0 0 6 /end TYPEDEF_MEASUREMENT
/begin TYPEDEF_MEASUREMENT tRevolutionPerMinute "" FLOAT32_IEEE tRevolutionPerMinute 0 0 -10000 10000 /end TYPEDEF_MEASUREMENT
/begin TYPEDEF_MEASUREMENT tAxleSystemState "" ULONG tAxleSystemState 0 0 0 3 /end TYPEDEF_MEASUREMENT
/begin TYPEDEF_MEASUREMENT uint16_t_0x100 "" UWORD NO_COMPU_METHOD 0 0 0 1 BIT_MASK 0x100 /end TYPEDEF_MEASUREMENT
/begin TYPEDEF_MEASUREMENT tCluIdx "" ULONG tCluIdx 0 0 0 4 /end TYPEDEF_MEASUREMENT
/begin TYPEDEF_STRUCTURE TaskWhlCluCtrl1ms "" 0x430 SYMBOL_TYPE_LINK "TaskWhlCluCtrl1ms"
 /begin STRUCTURE_COMPONENT libWhlCluCtrl1Ms LibWhlCluCtrl1ms 0 SYMBOL_TYPE_LINK "libWhlCluCtrl1Ms" /end STRUCTURE_COMPONENT
/end TYPEDEF_STRUCTURE
/begin TYPEDEF_STRUCTURE TaskTqStruct "" 0x430 SYMBOL_TYPE_LINK "TaskTqStruct"
 /begin STRUCTURE_COMPONENT tqStructLocals TqStructLocals 0 SYMBOL_TYPE_LINK "tqStructLocals" /end STRUCTURE_COMPONENT
 /begin STRUCTURE_COMPONENT stepSize tSecond 1060 SYMBOL_TYPE_LINK "stepSize" /end STRUCTURE_COMPONENT
/end TYPEDEF_STRUCTURE
/begin TYPEDEF_STRUCTURE TaskThermalManager "" 0x2EC SYMBOL_TYPE_LINK "TaskThermalManager"
 /begin STRUCTURE_COMPONENT libThermalManager LibThermalManager 0 SYMBOL_TYPE_LINK "libThermalManager" /end STRUCTURE_COMPONENT
/end TYPEDEF_STRUCTURE
/begin TYPEDEF_STRUCTURE tTaskNvmTrigger "" 0x10 SYMBOL_TYPE_LINK "tTaskNvmTrigger" /begin STRUCTURE_COMPONENT nvmSaveCnt uint32_t 0 SYMBOL_TYPE_LINK "nvmSaveCnt" /end STRUCTURE_COMPONENT
 /begin STRUCTURE_COMPONENT lastNvmSaveTime tMillisecond_U32 4 SYMBOL_TYPE_LINK "lastNvmSaveTime" /end STRUCTURE_COMPONENT
/end TYPEDEF_STRUCTURE
/begin TYPEDEF_STRUCTURE LibThermalManager "" 0x2E8 SYMBOL_TYPE_LINK "LibThermalManager" /begin STRUCTURE_COMPONENT hvBatFanReq tPercent_S8 0 SYMBOL_TYPE_LINK "hvBatFanReq" /end STRUCTURE_COMPONENT /begin STRUCTURE_COMPONENT veqRiFanReq tPercent_S8 1 SYMBOL_TYPE_LINK "veqRiFanReq" /end STRUCTURE_COMPONENT
 /begin STRUCTURE_COMPONENT centRiIceFanReq tPercent_S8 2 SYMBOL_TYPE_LINK "centRiIceFanReq" /end STRUCTURE_COMPONENT
 /begin STRUCTURE_COMPONENT centRiIceFanReqQ tQualifier 4 SYMBOL_TYPE_LINK "centRiIceFanReqQ" /end STRUCTURE_COMPONENT
 /begin STRUCTURE_COMPONENT centRiHvacFanReq tPercent_S8 8 SYMBOL_TYPE_LINK "centRiHvacFanReq" /end STRUCTURE_COMPONENT
 /begin STRUCTURE_COMPONENT centRiHvacFanReqQ tQualifier 12 SYMBOL_TYPE_LINK "centRiHvacFanReqQ" /end STRUCTURE_COMPONENT
 /begin STRUCTURE_COMPONENT dcdcFanReq tPercent_S8 16 SYMBOL_TYPE_LINK "dcdcFanReq" /end STRUCTURE_COMPONENT
 /begin STRUCTURE_COMPONENT centLeIceFanReq tPercent_S8 17 SYMBOL_TYPE_LINK "centLeIceFanReq" /end STRUCTURE_COMPONENT
 /begin STRUCTURE_COMPONENT centLeIceFanReqQ tQualifier 20 SYMBOL_TYPE_LINK "centLeIceFanReqQ" /end STRUCTURE_COMPONENT
 /begin STRUCTURE_COMPONENT centLeHvacFanReq tPercent_S8 24 SYMBOL_TYPE_LINK "centLeHvacFanReq" /end STRUCTURE_COMPONENT
 /begin STRUCTURE_COMPONENT centLeHvacFanReqQ tQualifier 28 SYMBOL_TYPE_LINK "centLeHvacFanReqQ" /end STRUCTURE_COMPONENT
 /begin STRUCTURE_COMPONENT invFanReq tPercent_S8 32 SYMBOL_TYPE_LINK "invFanReq" /end STRUCTURE_COMPONENT
 /begin STRUCTURE_COMPONENT motFanReq tPercent_S8 33 SYMBOL_TYPE_LINK "motFanReq" /end STRUCTURE_COMPONENT
 /begin STRUCTURE_COMPONENT veqLeFanReq tPercent_S8 34 SYMBOL_TYPE_LINK "veqLeFanReq" /end STRUCTURE_COMPONENT
 /begin STRUCTURE_COMPONENT hvBatPump1Req tPercent_S8 35 SYMBOL_TYPE_LINK "hvBatPump1Req" /end STRUCTURE_COMPONENT
 /begin STRUCTURE_COMPONENT hvBatPump2Req tPercent_S8 36 SYMBOL_TYPE_LINK "hvBatPump2Req" /end STRUCTURE_COMPONENT
 /begin STRUCTURE_COMPONENT motPumpReq tPercent_S8 37 SYMBOL_TYPE_LINK "motPumpReq" /end STRUCTURE_COMPONENT
 /begin STRUCTURE_COMPONENT invPumpReq tPercent_S8 38 SYMBOL_TYPE_LINK "invPumpReq" /end STRUCTURE_COMPONENT
 /begin STRUCTURE_COMPONENT dcdcPumpReq tPercent_S8 39 SYMBOL_TYPE_LINK "dcdcPumpReq" /end STRUCTURE_COMPONENT
 /begin STRUCTURE_COMPONENT avasFanFrntReqPerc tPercent_S8 40 SYMBOL_TYPE_LINK "avasFanFrntReqPerc" /end STRUCTURE_COMPONENT
 /begin STRUCTURE_COMPONENT midLsttFanReq tPercent_S8 41 SYMBOL_TYPE_LINK "midLsttFanReq" /end STRUCTURE_COMPONENT
 /begin STRUCTURE_COMPONENT midLsttFanReqQ tQualifier 44 SYMBOL_TYPE_LINK "midLsttFanReqQ" /end STRUCTURE_COMPONENT
 /begin STRUCTURE_COMPONENT reRiIcFanReq tPercent_S8 48 SYMBOL_TYPE_LINK "reRiIcFanReq" /end STRUCTURE_COMPONENT
 /begin STRUCTURE_COMPONENT reRiIcFanReqQ tQualifier 52 SYMBOL_TYPE_LINK "reRiIcFanReqQ" /end STRUCTURE_COMPONENT
 /begin STRUCTURE_COMPONENT reLeIcFanReq tPercent_S8 56 SYMBOL_TYPE_LINK "reLeIcFanReq" /end STRUCTURE_COMPONENT
 /begin STRUCTURE_COMPONENT reLeIcFanReqQ tQualifier 60 SYMBOL_TYPE_LINK "reLeIcFanReqQ" /end STRUCTURE_COMPONENT
 /begin STRUCTURE_COMPONENT obcFanReq tPercent_S8 64 SYMBOL_TYPE_LINK "obcFanReq" /end STRUCTURE_COMPONENT
 /begin STRUCTURE_COMPONENT icRiPumpReq tPercent_S8 65 SYMBOL_TYPE_LINK "icRiPumpReq" /end STRUCTURE_COMPONENT
 /begin STRUCTURE_COMPONENT icRiPumpReqQ tQualifier 68 SYMBOL_TYPE_LINK "icRiPumpReqQ" /end STRUCTURE_COMPONENT
 /begin STRUCTURE_COMPONENT icLePumpReq tPercent_S8 72 SYMBOL_TYPE_LINK "icLePumpReq" /end STRUCTURE_COMPONENT
 /begin STRUCTURE_COMPONENT icLePumpReqQ tQualifier 76 SYMBOL_TYPE_LINK "icLePumpReqQ" /end STRUCTURE_COMPONENT
 /begin STRUCTURE_COMPONENT obcPumpReq tPercent_S8 80 SYMBOL_TYPE_LINK "obcPumpReq" /end STRUCTURE_COMPONENT
 /begin STRUCTURE_COMPONENT isEngineRunning _Bool 81 SYMBOL_TYPE_LINK "isEngineRunning" /end STRUCTURE_COMPONENT
 /begin STRUCTURE_COMPONENT upperEngineBayFanCmd _Bool 82 SYMBOL_TYPE_LINK "upperEngineBayFanCmd" /end STRUCTURE_COMPONENT
 /begin STRUCTURE_COMPONENT lowerEngineBayFanCmd _Bool 83 SYMBOL_TYPE_LINK "lowerEngineBayFanCmd" /end STRUCTURE_COMPONENT
 /begin STRUCTURE_COMPONENT ecmThermalReqTimeout _Bool 84 SYMBOL_TYPE_LINK "ecmThermalReqTimeout" /end STRUCTURE_COMPONENT
 /begin STRUCTURE_COMPONENT lsttThermalReqTimeout _Bool 85 SYMBOL_TYPE_LINK "lsttThermalReqTimeout" /end STRUCTURE_COMPONENT
 /begin STRUCTURE_COMPONENT avasFanReReqPerc tPercent_S8 86 SYMBOL_TYPE_LINK "avasFanReReqPerc" /end STRUCTURE_COMPONENT
 /begin STRUCTURE_COMPONENT vehSpeed tKilometrePerHour 88 SYMBOL_TYPE_LINK "vehSpeed" /end STRUCTURE_COMPONENT
 /begin STRUCTURE_COMPONENT coolingFan CoolingFan 92 MATRIX_DIM 8 SYMBOL_TYPE_LINK "coolingFan" /end STRUCTURE_COMPONENT
 /begin STRUCTURE_COMPONENT coolingPump CoolingPump 284 MATRIX_DIM 7 SYMBOL_TYPE_LINK "coolingPump" /end STRUCTURE_COMPONENT
 /begin STRUCTURE_COMPONENT hybCoolFaultSetLimp _Bool 452 SYMBOL_TYPE_LINK "hybCoolFaultSetLimp" /end STRUCTURE_COMPONENT
 /begin STRUCTURE_COMPONENT invPumpFault _Bool 453 SYMBOL_TYPE_LINK "invPumpFault" /end STRUCTURE_COMPONENT
 /begin STRUCTURE_COMPONENT emotPumpFault _Bool 454 SYMBOL_TYPE_LINK "emotPumpFault" /end STRUCTURE_COMPONENT
 /begin STRUCTURE_COMPONENT powerConsumption48v tKilowatt 456 SYMBOL_TYPE_LINK "powerConsumption48v" /end STRUCTURE_COMPONENT
 /begin STRUCTURE_COMPONENT powerConsumption12v tKilowatt 460 SYMBOL_TYPE_LINK "powerConsumption12v" /end STRUCTURE_COMPONENT
 /begin STRUCTURE_COMPONENT powerConsumptionActual48v tKilowatt 464 SYMBOL_TYPE_LINK "powerConsumptionActual48v" /end STRUCTURE_COMPONENT
 /begin STRUCTURE_COMPONENT powerConsumptionActual12v tKilowatt 468 SYMBOL_TYPE_LINK "powerConsumptionActual12v" /end STRUCTURE_COMPONENT
 /begin STRUCTURE_COMPONENT dcdc48vPowerOutput tKilowatt 472 SYMBOL_TYPE_LINK "dcdc48vPowerOutput" /end STRUCTURE_COMPONENT
 /begin STRUCTURE_COMPONENT dcdc48vRemainingThermalPower tKilowatt 476 SYMBOL_TYPE_LINK "dcdc48vRemainingThermalPower" /end STRUCTURE_COMPONENT
 /begin STRUCTURE_COMPONENT dcdc48vAvailablePower tKilowatt 480 SYMBOL_TYPE_LINK "dcdc48vAvailablePower" /end STRUCTURE_COMPONENT
 /begin STRUCTURE_COMPONENT hydraulicPump48VPower tKilowatt 484 SYMBOL_TYPE_LINK "hydraulicPump48VPower" /end STRUCTURE_COMPONENT
 /begin STRUCTURE_COMPONENT isOverBudget _Bool 488 SYMBOL_TYPE_LINK "isOverBudget" /end STRUCTURE_COMPONENT
 /begin STRUCTURE_COMPONENT isUnderBudget _Bool 489 SYMBOL_TYPE_LINK "isUnderBudget" /end STRUCTURE_COMPONENT
 /begin STRUCTURE_COMPONENT restoreRequests _Bool 490 SYMBOL_TYPE_LINK "restoreRequests" /end STRUCTURE_COMPONENT
 /begin STRUCTURE_COMPONENT deratingActive _Bool 491 SYMBOL_TYPE_LINK "deratingActive" /end STRUCTURE_COMPONENT
 /begin STRUCTURE_COMPONENT deratingLevel uint8_t 492 SYMBOL_TYPE_LINK "deratingLevel" /end STRUCTURE_COMPONENT
 /begin STRUCTURE_COMPONENT maxAllowedFanCmd tPercent_S8 493 SYMBOL_TYPE_LINK "maxAllowedFanCmd" /end STRUCTURE_COMPONENT
 /begin STRUCTURE_COMPONENT enterDeratingCounter tMillisecond_U32 496 SYMBOL_TYPE_LINK "enterDeratingCounter" /end STRUCTURE_COMPONENT
 /begin STRUCTURE_COMPONENT exitDeratingCounter tMillisecond_U32 500 SYMBOL_TYPE_LINK "exitDeratingCounter" /end STRUCTURE_COMPONENT
 /begin STRUCTURE_COMPONENT stepUpCounter tMillisecond_U32 504 SYMBOL_TYPE_LINK "stepUpCounter" /end STRUCTURE_COMPONENT
 /begin STRUCTURE_COMPONENT stepDownCounter tMillisecond_U32 508 SYMBOL_TYPE_LINK "stepDownCounter" /end STRUCTURE_COMPONENT
 /begin STRUCTURE_COMPONENT restoreRequestCounter tMillisecond_U32 512 SYMBOL_TYPE_LINK "restoreRequestCounter" /end STRUCTURE_COMPONENT
 /begin STRUCTURE_COMPONENT thermalDiag tThermalDiag 516 SYMBOL_TYPE_LINK "thermalDiag" /end STRUCTURE_COMPONENT
 /begin STRUCTURE_COMPONENT hybState tHybSmState 732 SYMBOL_TYPE_LINK "hybState" /end STRUCTURE_COMPONENT
 /begin STRUCTURE_COMPONENT hybStatePrev tHybSmState 736 SYMBOL_TYPE_LINK "hybStatePrev" /end STRUCTURE_COMPONENT
 /begin STRUCTURE_COMPONENT factoryTestEnblPrev _Bool 740 SYMBOL_TYPE_LINK "factoryTestEnblPrev" /end STRUCTURE_COMPONENT
/end TYPEDEF_STRUCTURE
/begin TYPEDEF_STRUCTURE TaskInverterHandler "" 0x50 SYMBOL_TYPE_LINK "TaskInverterHandler"
 /begin STRUCTURE_COMPONENT libInverterHandler LibInverterHandler 0 SYMBOL_TYPE_LINK "libInverterHandler" /end STRUCTURE_COMPONENT
/end TYPEDEF_STRUCTURE
/begin TYPEDEF_STRUCTURE TaskTqMgr "" 0x7E4 SYMBOL_TYPE_LINK "TaskTqMgr"
 /begin STRUCTURE_COMPONENT tqMgrLocals TorqueManagerLocals 0 SYMBOL_TYPE_LINK "tqMgrLocals" /end STRUCTURE_COMPONENT
 /begin STRUCTURE_COMPONENT stepSize tSecond 2016 SYMBOL_TYPE_LINK "stepSize" /end STRUCTURE_COMPONENT
/end TYPEDEF_STRUCTURE
/begin TYPEDEF_STRUCTURE CoolingPump "" 0x18 SYMBOL_TYPE_LINK "CoolingPump" /begin STRUCTURE_COMPONENT powerSupply tPowerSupply 0 SYMBOL_TYPE_LINK "powerSupply" /end STRUCTURE_COMPONENT /begin STRUCTURE_COMPONENT request tPercent_S8 4 SYMBOL_TYPE_LINK "request" /end STRUCTURE_COMPONENT /begin STRUCTURE_COMPONENT command tPercent_S8 5 SYMBOL_TYPE_LINK "command" /end STRUCTURE_COMPONENT /begin STRUCTURE_COMPONENT pumpModel tPumpModel 8 SYMBOL_TYPE_LINK "pumpModel" /end STRUCTURE_COMPONENT
 /begin STRUCTURE_COMPONENT powerEstimation tKilowatt 12 SYMBOL_TYPE_LINK "powerEstimation" /end STRUCTURE_COMPONENT
 /begin STRUCTURE_COMPONENT speed tRevolutionPerMinute 16 SYMBOL_TYPE_LINK "speed" /end STRUCTURE_COMPONENT
 /begin STRUCTURE_COMPONENT power tWatt 20 SYMBOL_TYPE_LINK "power" /end STRUCTURE_COMPONENT
/end TYPEDEF_STRUCTURE
/begin TYPEDEF_STRUCTURE TaskRideHeight "" 0x4D8 SYMBOL_TYPE_LINK "TaskRideHeight" /begin STRUCTURE_COMPONENT stepSize tSecond 4 SYMBOL_TYPE_LINK "stepSize" /end STRUCTURE_COMPONENT
 /begin STRUCTURE_COMPONENT rideHeightLocals RideLocals 8 SYMBOL_TYPE_LINK "rideHeightLocals" /end STRUCTURE_COMPONENT
/end TYPEDEF_STRUCTURE
/begin TYPEDEF_STRUCTURE TaskNetworkManagement "" 0x68 SYMBOL_TYPE_LINK "TaskNetworkManagement"
 /begin STRUCTURE_COMPONENT networkHandler NetworkHandler 0 SYMBOL_TYPE_LINK "networkHandler" /end STRUCTURE_COMPONENT
/end TYPEDEF_STRUCTURE
/begin TYPEDEF_STRUCTURE LibWhlCluCtrl1ms "" 0x42C SYMBOL_TYPE_LINK "LibWhlCluCtrl1ms"
 /begin STRUCTURE_COMPONENT taskCycleMs tMillisecond_U32 4 SYMBOL_TYPE_LINK "taskCycleMs" /end STRUCTURE_COMPONENT
 /begin STRUCTURE_COMPONENT cluPressCtrlLocals CluPressCtrlLocals 8 SYMBOL_TYPE_LINK "cluPressCtrlLocals" /end STRUCTURE_COMPONENT
 /begin STRUCTURE_COMPONENT cluSMLocals CluSMLocals 476 SYMBOL_TYPE_LINK "cluSMLocals" /end STRUCTURE_COMPONENT
 /begin STRUCTURE_COMPONENT cluTEstimnLocals WhlCluTEstimnLocals 956 SYMBOL_TYPE_LINK "cluTEstimnLocals" /end STRUCTURE_COMPONENT
 /begin STRUCTURE_COMPONENT whlCluWearLocals WhlCluWearLocals 1012 SYMBOL_TYPE_LINK "whlCluWearLocals" /end STRUCTURE_COMPONENT
 /begin STRUCTURE_COMPONENT whlCluTestsLocals WhlCluTestsLocals 1060 SYMBOL_TYPE_LINK "whlCluTestsLocals" /end STRUCTURE_COMPONENT
/end TYPEDEF_STRUCTURE
/begin TYPEDEF_STRUCTURE TqStructLocals "" 0x420 SYMBOL_TYPE_LINK "TqStructLocals"
 /begin STRUCTURE_COMPONENT propshTqArbnLocals PropshaftTqArbnLocals 0 SYMBOL_TYPE_LINK "propshTqArbnLocals" /end STRUCTURE_COMPONENT
 /begin STRUCTURE_COMPONENT cluTqHdlLocals CluTqHdlLocals 192 SYMBOL_TYPE_LINK "cluTqHdlLocals" /end STRUCTURE_COMPONENT
 /begin STRUCTURE_COMPONENT whlTqArbnLocals WhlTqArbnLocals 920 SYMBOL_TYPE_LINK "whlTqArbnLocals" /end STRUCTURE_COMPONENT
 /begin STRUCTURE_COMPONENT prelCluReqLocals PrelCluReqLocals 1020 SYMBOL_TYPE_LINK "prelCluReqLocals" /end STRUCTURE_COMPONENT
/end TYPEDEF_STRUCTURE
/begin TYPEDEF_STRUCTURE TaskInverterCtrl "" 0x78 SYMBOL_TYPE_LINK "TaskInverterCtrl"
 /begin STRUCTURE_COMPONENT libInverterCtrl LibInverterCtrl 0 SYMBOL_TYPE_LINK "libInverterCtrl" /end STRUCTURE_COMPONENT
/end TYPEDEF_STRUCTURE
/begin TYPEDEF_STRUCTURE tThermalDiag "" 0xD8 SYMBOL_TYPE_LINK "tThermalDiag" /begin STRUCTURE_COMPONENT factoryTestDone _Bool 0 SYMBOL_TYPE_LINK "factoryTestDone" /end STRUCTURE_COMPONENT
 /begin STRUCTURE_COMPONENT factoryTestPassed _Bool 1 SYMBOL_TYPE_LINK "factoryTestPassed" /end STRUCTURE_COMPONENT
 /begin STRUCTURE_COMPONENT state tThermalDiagStatus 4 SYMBOL_TYPE_LINK "state" /end STRUCTURE_COMPONENT
 /begin STRUCTURE_COMPONENT timer tMillisecond_U32 8 SYMBOL_TYPE_LINK "timer" /end STRUCTURE_COMPONENT
 /begin STRUCTURE_COMPONENT fanFaultCode FaultCode 12 MATRIX_DIM 8 SYMBOL_TYPE_LINK "fanFaultCode" /end STRUCTURE_COMPONENT
 /begin STRUCTURE_COMPONENT fanFaultSts tThermalUnitFailReason 44 MATRIX_DIM 8 SYMBOL_TYPE_LINK "fanFaultSts" /end STRUCTURE_COMPONENT
 /begin STRUCTURE_COMPONENT fanFeedbackTimeout _Bool 76 MATRIX_DIM 8 SYMBOL_TYPE_LINK "fanFeedbackTimeout" /end STRUCTURE_COMPONENT
 /begin STRUCTURE_COMPONENT fanFaultTimer tMillisecond_U32 84 MATRIX_DIM 8 SYMBOL_TYPE_LINK "fanFaultTimer" /end STRUCTURE_COMPONENT
 /begin STRUCTURE_COMPONENT pumpFaultCode FaultCode 116 MATRIX_DIM 7 SYMBOL_TYPE_LINK "pumpFaultCode" /end STRUCTURE_COMPONENT
 /begin STRUCTURE_COMPONENT pumpFaultSts tThermalUnitFailReason 144 MATRIX_DIM 7 SYMBOL_TYPE_LINK "pumpFaultSts" /end STRUCTURE_COMPONENT
 /begin STRUCTURE_COMPONENT pumpFeedbackTimeout _Bool 172 MATRIX_DIM 7 SYMBOL_TYPE_LINK "pumpFeedbackTimeout" /end STRUCTURE_COMPONENT
 /begin STRUCTURE_COMPONENT pumpFaultTimer tMillisecond_U32 180 MATRIX_DIM 7 SYMBOL_TYPE_LINK "pumpFaultTimer" /end STRUCTURE_COMPONENT
 /begin STRUCTURE_COMPONENT fanFailMask uint32_t 208 SYMBOL_TYPE_LINK "fanFailMask" /end STRUCTURE_COMPONENT
 /begin STRUCTURE_COMPONENT pumpFailMask uint32_t 212 SYMBOL_TYPE_LINK "pumpFailMask" /end STRUCTURE_COMPONENT
/end TYPEDEF_STRUCTURE
/begin TYPEDEF_STRUCTURE WhlCluTestsLocals "" 0x8 SYMBOL_TYPE_LINK "WhlCluTestsLocals"
 /begin STRUCTURE_COMPONENT testActive _Bool 0 MATRIX_DIM 4 SYMBOL_TYPE_LINK "testActive" /end STRUCTURE_COMPONENT
 /begin STRUCTURE_COMPONENT testEndTime tMillisecond_U32 4 SYMBOL_TYPE_LINK "testEndTime" /end STRUCTURE_COMPONENT
/end TYPEDEF_STRUCTURE
/begin TYPEDEF_STRUCTURE CluSMLocals "" 0x1E0 SYMBOL_TYPE_LINK "CluSMLocals"
 /begin STRUCTURE_COMPONENT slipRateErrDerivFiltStr TdfdVar 0 MATRIX_DIM 4 SYMBOL_TYPE_LINK "slipRateErrDerivFiltStr" /end STRUCTURE_COMPONENT
 /begin STRUCTURE_COMPONENT cluKissPress tBar_100_S16 144 MATRIX_DIM 4 SYMBOL_TYPE_LINK "cluKissPress" /end STRUCTURE_COMPONENT
 /begin STRUCTURE_COMPONENT cluPressDmd tBar_100_S16 152 MATRIX_DIM 4 SYMBOL_TYPE_LINK "cluPressDmd" /end STRUCTURE_COMPONENT
 /begin STRUCTURE_COMPONENT cluStLocal tClutchState 160 MATRIX_DIM 4 SYMBOL_TYPE_LINK "cluStLocal" /end STRUCTURE_COMPONENT
 /begin STRUCTURE_COMPONENT cluSftyFac tFactor 176 MATRIX_DIM 4 SYMBOL_TYPE_LINK "cluSftyFac" /end STRUCTURE_COMPONENT
 /begin STRUCTURE_COMPONENT cluSlipSignFilt tFactor 192 MATRIX_DIM 4 SYMBOL_TYPE_LINK "cluSlipSignFilt" /end STRUCTURE_COMPONENT
 /begin STRUCTURE_COMPONENT nmPerBarTFac tFactor 208 MATRIX_DIM 4 SYMBOL_TYPE_LINK "nmPerBarTFac" /end STRUCTURE_COMPONENT
 /begin STRUCTURE_COMPONENT slipCtrlLstRun tMillisecond 224 MATRIX_DIM 4 SYMBOL_TYPE_LINK "slipCtrlLstRun" /end STRUCTURE_COMPONENT
 /begin STRUCTURE_COMPONENT slipCtrlrDt tMillisecond 240 MATRIX_DIM 4 SYMBOL_TYPE_LINK "slipCtrlrDt" /end STRUCTURE_COMPONENT
 /begin STRUCTURE_COMPONENT cluSlipSignZeroTimerMs tMillisecond_U32 256 MATRIX_DIM 4 SYMBOL_TYPE_LINK "cluSlipSignZeroTimerMs" /end STRUCTURE_COMPONENT
 /begin STRUCTURE_COMPONENT softDisengageTmr tMillisecond_U32 272 MATRIX_DIM 4 SYMBOL_TYPE_LINK "softDisengageTmr" /end STRUCTURE_COMPONENT
 /begin STRUCTURE_COMPONENT taskMs tMillisecond_U32 288 SYMBOL_TYPE_LINK "taskMs" /end STRUCTURE_COMPONENT
 /begin STRUCTURE_COMPONENT cluTqActLocal tNewtonMetre 292 MATRIX_DIM 4 SYMBOL_TYPE_LINK "cluTqActLocal" /end STRUCTURE_COMPONENT
 /begin STRUCTURE_COMPONENT cluTqReqLocal tNewtonMetre 308 MATRIX_DIM 4 SYMBOL_TYPE_LINK "cluTqReqLocal" /end STRUCTURE_COMPONENT
 /begin STRUCTURE_COMPONENT cluTqSlipCtrlReq tNewtonMetre 324 MATRIX_DIM 4 SYMBOL_TYPE_LINK "cluTqSlipCtrlReq" /end STRUCTURE_COMPONENT
 /begin STRUCTURE_COMPONENT slipCtrlrIntegrator tNewtonMetre 340 MATRIX_DIM 4 SYMBOL_TYPE_LINK "slipCtrlrIntegrator" /end STRUCTURE_COMPONENT
 /begin STRUCTURE_COMPONENT whlCluTqEstimd tNewtonMetre 356 MATRIX_DIM 4 SYMBOL_TYPE_LINK "whlCluTqEstimd" /end STRUCTURE_COMPONENT
 /begin STRUCTURE_COMPONENT cluTqReqLstRun tNewtonMetre 372 MATRIX_DIM 4 SYMBOL_TYPE_LINK "cluTqReqLstRun" /end STRUCTURE_COMPONENT
 /begin STRUCTURE_COMPONENT estimdNmPerBar tNewtonMetrePerBar 388 MATRIX_DIM 4 SYMBOL_TYPE_LINK "estimdNmPerBar" /end STRUCTURE_COMPONENT
 /begin STRUCTURE_COMPONENT cluDftlRate tRadianPerSecond 404 MATRIX_DIM 4 SYMBOL_TYPE_LINK "cluDftlRate" /end STRUCTURE_COMPONENT
 /begin STRUCTURE_COMPONENT slipCtrlrErrDeriv tRadianPerSecond 420 MATRIX_DIM 4 SYMBOL_TYPE_LINK "slipCtrlrErrDeriv" /end STRUCTURE_COMPONENT
 /begin STRUCTURE_COMPONENT slipCtrlrError tRadianPerSecond 436 MATRIX_DIM 4 SYMBOL_TYPE_LINK "slipCtrlrError" /end STRUCTURE_COMPONENT
 /begin STRUCTURE_COMPONENT cluDftlRpmAbs tRevolutionPerMinute_S16 452 MATRIX_DIM 4 SYMBOL_TYPE_LINK "cluDftlRpmAbs" /end STRUCTURE_COMPONENT
 /begin STRUCTURE_COMPONENT cluSlipSign tSign 460 MATRIX_DIM 4 SYMBOL_TYPE_LINK "cluSlipSign" /end STRUCTURE_COMPONENT
 /begin STRUCTURE_COMPONENT cluRateOuterCnt uint8_t 476 MATRIX_DIM 4 SYMBOL_TYPE_LINK "cluRateOuterCnt" /end STRUCTURE_COMPONENT
/end TYPEDEF_STRUCTURE
/begin TYPEDEF_STRUCTURE TorqueManagerLocals "" 0x7DC SYMBOL_TYPE_LINK "TorqueManagerLocals"
 /begin STRUCTURE_COMPONENT tqStMacLocals TqStMacLocals 0 SYMBOL_TYPE_LINK "tqStMacLocals" /end STRUCTURE_COMPONENT
 /begin STRUCTURE_COMPONENT tracCtrlLocals TracCtrlLocals 172 SYMBOL_TYPE_LINK "tracCtrlLocals" /end STRUCTURE_COMPONENT
 /begin STRUCTURE_COMPONENT tqLimLocals TqLimLocals 312 SYMBOL_TYPE_LINK "tqLimLocals" /end STRUCTURE_COMPONENT
 /begin STRUCTURE_COMPONENT yawTqReqLocals YawTqReqLocals 572 SYMBOL_TYPE_LINK "yawTqReqLocals" /end STRUCTURE_COMPONENT
/end TYPEDEF_STRUCTURE
/begin TYPEDEF_STRUCTURE WhlCluWearLocals "" 0x30 SYMBOL_TYPE_LINK "WhlCluWearLocals"
 /begin STRUCTURE_COMPONENT cluWearEgy tMegaJoule 0 MATRIX_DIM 4 SYMBOL_TYPE_LINK "cluWearEgy" /end STRUCTURE_COMPONENT
 /begin STRUCTURE_COMPONENT cluWearEgyStorg tMegaJoule_U32 16 MATRIX_DIM 4 SYMBOL_TYPE_LINK "cluWearEgyStorg" /end STRUCTURE_COMPONENT
 /begin STRUCTURE_COMPONENT cluPwrPrev tWatt 32 MATRIX_DIM 4 SYMBOL_TYPE_LINK "cluPwrPrev" /end STRUCTURE_COMPONENT
/end TYPEDEF_STRUCTURE
/begin TYPEDEF_STRUCTURE YawTqReqLocals "" 0x5A0 SYMBOL_TYPE_LINK "YawTqReqLocals"
 /begin STRUCTURE_COMPONENT drvrWhlTqReqRawSign _Bool 0 SYMBOL_TYPE_LINK "drvrWhlTqReqRawSign" /end STRUCTURE_COMPONENT
 /begin STRUCTURE_COMPONENT initDone _Bool 1 SYMBOL_TYPE_LINK "initDone" /end STRUCTURE_COMPONENT
 /begin STRUCTURE_COMPONENT whlTqSplLong tFactor 4 SYMBOL_TYPE_LINK "whlTqSplLong" /end STRUCTURE_COMPONENT
 /begin STRUCTURE_COMPONENT whlTqSplLongAct tFactor 8 SYMBOL_TYPE_LINK "whlTqSplLongAct" /end STRUCTURE_COMPONENT
 /begin STRUCTURE_COMPONENT frntYawTqReq tNewtonMetre 12 SYMBOL_TYPE_LINK "frntYawTqReq" /end STRUCTURE_COMPONENT
 /begin STRUCTURE_COMPONENT reYawTqReq tNewtonMetre 16 SYMBOL_TYPE_LINK "reYawTqReq" /end STRUCTURE_COMPONENT
 /begin STRUCTURE_COMPONENT whlTqHalfDifLatReqFrnt tNewtonMetre 20 SYMBOL_TYPE_LINK "whlTqHalfDifLatReqFrnt" /end STRUCTURE_COMPONENT
 /begin STRUCTURE_COMPONENT whlTqHalfDifLatReqRe tNewtonMetre 24 SYMBOL_TYPE_LINK "whlTqHalfDifLatReqRe" /end STRUCTURE_COMPONENT
 /begin STRUCTURE_COMPONENT whlTqLongReqFrnt tNewtonMetre 28 SYMBOL_TYPE_LINK "whlTqLongReqFrnt" /end STRUCTURE_COMPONENT
 /begin STRUCTURE_COMPONENT whlTqLongReqFrntRaw tNewtonMetre 32 SYMBOL_TYPE_LINK "whlTqLongReqFrntRaw" /end STRUCTURE_COMPONENT
 /begin STRUCTURE_COMPONENT whlTqLongReqRe tNewtonMetre 36 SYMBOL_TYPE_LINK "whlTqLongReqRe" /end STRUCTURE_COMPONENT
 /begin STRUCTURE_COMPONENT whlTqLongReqReRaw tNewtonMetre 40 SYMBOL_TYPE_LINK "whlTqLongReqReRaw" /end STRUCTURE_COMPONENT
 /begin STRUCTURE_COMPONENT whlTqReqRaw tNewtonMetre 44 MATRIX_DIM 4 SYMBOL_TYPE_LINK "whlTqReqRaw" /end STRUCTURE_COMPONENT
 /begin STRUCTURE_COMPONENT yawTqFrntMax tNewtonMetre 60 SYMBOL_TYPE_LINK "yawTqFrntMax" /end STRUCTURE_COMPONENT
 /begin STRUCTURE_COMPONENT yawTqFrntMin tNewtonMetre 64 SYMBOL_TYPE_LINK "yawTqFrntMin" /end STRUCTURE_COMPONENT
 /begin STRUCTURE_COMPONENT yawTqReMax tNewtonMetre 68 SYMBOL_TYPE_LINK "yawTqReMax" /end STRUCTURE_COMPONENT
 /begin STRUCTURE_COMPONENT yawTqReMin tNewtonMetre 72 SYMBOL_TYPE_LINK "yawTqReMin" /end STRUCTURE_COMPONENT
 /begin STRUCTURE_COMPONENT yawTqReqRaw tNewtonMetre 76 SYMBOL_TYPE_LINK "yawTqReqRaw" /end STRUCTURE_COMPONENT
 /begin STRUCTURE_COMPONENT refGenSideslip tRadian 80 SYMBOL_TYPE_LINK "refGenSideslip" /end STRUCTURE_COMPONENT
 /begin STRUCTURE_COMPONENT refGenYawRate tRadianPerSecond 84 SYMBOL_TYPE_LINK "refGenYawRate" /end STRUCTURE_COMPONENT
 /begin STRUCTURE_COMPONENT referenceGenCals ReferenceGenCals 88 SYMBOL_TYPE_LINK "referenceGenCals" /end STRUCTURE_COMPONENT
 /begin STRUCTURE_COMPONENT referenceGenCtx ReferenceGenCtx 136 SYMBOL_TYPE_LINK "referenceGenCtx" /end STRUCTURE_COMPONENT
 /begin STRUCTURE_COMPONENT referenceGenIn ReferenceGenIn 224 SYMBOL_TYPE_LINK "referenceGenIn" /end STRUCTURE_COMPONENT
 /begin STRUCTURE_COMPONENT TVTireParams TVTireParams 820 SYMBOL_TYPE_LINK "TVTireParams" /end STRUCTURE_COMPONENT
 /begin STRUCTURE_COMPONENT TVVehicleParams TVVehicleParams 1392 SYMBOL_TYPE_LINK "TVVehicleParams" /end STRUCTURE_COMPONENT
 /begin STRUCTURE_COMPONENT ytrSatSt tYawTorqueRequestSaturation 1436 SYMBOL_TYPE_LINK "ytrSatSt" /end STRUCTURE_COMPONENT
/end TYPEDEF_STRUCTURE
/begin TYPEDEF_STRUCTURE NetworkHandler "" 0x64 SYMBOL_TYPE_LINK "NetworkHandler" /begin STRUCTURE_COMPONENT powerState tPowerState 0 SYMBOL_TYPE_LINK "powerState" /end STRUCTURE_COMPONENT /begin STRUCTURE_COMPONENT driveMode tDriveMode 4 SYMBOL_TYPE_LINK "driveMode" /end STRUCTURE_COMPONENT
 /begin STRUCTURE_COMPONENT rollingState tRollingState 8 SYMBOL_TYPE_LINK "rollingState" /end STRUCTURE_COMPONENT
 /begin STRUCTURE_COMPONENT bus NetworkBus 12 MATRIX_DIM 2 SYMBOL_TYPE_LINK "bus" /end STRUCTURE_COMPONENT
/end TYPEDEF_STRUCTURE
/begin TYPEDEF_STRUCTURE LibInverterCtrl "" 0x74 SYMBOL_TYPE_LINK "LibInverterCtrl"
 /begin STRUCTURE_COMPONENT invCtrlModeCmd tInvCtrlMode 0 SYMBOL_TYPE_LINK "invCtrlModeCmd" /end STRUCTURE_COMPONENT
 /begin STRUCTURE_COMPONENT invCtrlModeReq tInvCtrlMode 4 SYMBOL_TYPE_LINK "invCtrlModeReq" /end STRUCTURE_COMPONENT
 /begin STRUCTURE_COMPONENT invCtrlModeFeedback tInvCtrlMode 8 SYMBOL_TYPE_LINK "invCtrlModeFeedback" /end STRUCTURE_COMPONENT
 /begin STRUCTURE_COMPONENT lastTrqCmdStamp uint32_t 12 SYMBOL_TYPE_LINK "lastTrqCmdStamp" /end STRUCTURE_COMPONENT
 /begin STRUCTURE_COMPONENT torqueRequest tNewtonMetre 16 SYMBOL_TYPE_LINK "torqueRequest" /end STRUCTURE_COMPONENT
 /begin STRUCTURE_COMPONENT torqueOutput tNewtonMetre 20 SYMBOL_TYPE_LINK "torqueOutput" /end STRUCTURE_COMPONENT
 /begin STRUCTURE_COMPONENT maxTorque tNewtonMetre 24 SYMBOL_TYPE_LINK "maxTorque" /end STRUCTURE_COMPONENT
 /begin STRUCTURE_COMPONENT minTorque tNewtonMetre 28 SYMBOL_TYPE_LINK "minTorque" /end STRUCTURE_COMPONENT
 /begin STRUCTURE_COMPONENT torqueMaxPosCmd tNewtonMetre 32 SYMBOL_TYPE_LINK "torqueMaxPosCmd" /end STRUCTURE_COMPONENT
 /begin STRUCTURE_COMPONENT torqueMaxNegCmd tNewtonMetre 36 SYMBOL_TYPE_LINK "torqueMaxNegCmd" /end STRUCTURE_COMPONENT
 /begin STRUCTURE_COMPONENT motorSpeed tRevolutionPerMinute_S16 40 SYMBOL_TYPE_LINK "motorSpeed" /end STRUCTURE_COMPONENT
 /begin STRUCTURE_COMPONENT motorSpeedReq tRevolutionPerMinute_S16 42 SYMBOL_TYPE_LINK "motorSpeedReq" /end STRUCTURE_COMPONENT
 /begin STRUCTURE_COMPONENT motorSpeedCmd tRevolutionPerMinute_S16 44 SYMBOL_TYPE_LINK "motorSpeedCmd" /end STRUCTURE_COMPONENT
 /begin STRUCTURE_COMPONENT hybState tHybSmState 48 SYMBOL_TYPE_LINK "hybState" /end STRUCTURE_COMPONENT
 /begin STRUCTURE_COMPONENT invEnableCmd _Bool 52 SYMBOL_TYPE_LINK "invEnableCmd" /end STRUCTURE_COMPONENT
 /begin STRUCTURE_COMPONENT motorEnableCmd _Bool 53 SYMBOL_TYPE_LINK "motorEnableCmd" /end STRUCTURE_COMPONENT
 /begin STRUCTURE_COMPONENT invTempMsgTimeout _Bool 54 SYMBOL_TYPE_LINK "invTempMsgTimeout" /end STRUCTURE_COMPONENT
 /begin STRUCTURE_COMPONENT invFanReq tPercent_S8 55 SYMBOL_TYPE_LINK "invFanReq" /end STRUCTURE_COMPONENT
 /begin STRUCTURE_COMPONENT invPumpReq tPercent_S8 56 SYMBOL_TYPE_LINK "invPumpReq" /end STRUCTURE_COMPONENT
 /begin STRUCTURE_COMPONENT invTemp tDegree 60 MATRIX_DIM 6 SYMBOL_TYPE_LINK "invTemp" /end STRUCTURE_COMPONENT
 /begin STRUCTURE_COMPONENT invTempMax tDegree 84 SYMBOL_TYPE_LINK "invTempMax" /end STRUCTURE_COMPONENT
 /begin STRUCTURE_COMPONENT motTempMsgTimeout _Bool 88 SYMBOL_TYPE_LINK "motTempMsgTimeout" /end STRUCTURE_COMPONENT
 /begin STRUCTURE_COMPONENT motFanReq tPercent_S8 89 SYMBOL_TYPE_LINK "motFanReq" /end STRUCTURE_COMPONENT
 /begin STRUCTURE_COMPONENT motPumpReq tPercent_S8 90 SYMBOL_TYPE_LINK "motPumpReq" /end STRUCTURE_COMPONENT
 /begin STRUCTURE_COMPONENT motTemp tDegree 92 MATRIX_DIM 4 SYMBOL_TYPE_LINK "motTemp" /end STRUCTURE_COMPONENT
 /begin STRUCTURE_COMPONENT motTempMax tDegree 108 SYMBOL_TYPE_LINK "motTempMax" /end STRUCTURE_COMPONENT
 /begin STRUCTURE_COMPONENT perfMod tPerformanceMode 112 SYMBOL_TYPE_LINK "perfMod" /end STRUCTURE_COMPONENT
/end TYPEDEF_STRUCTURE
/begin TYPEDEF_STRUCTURE ReferenceGenIn "" 0x254 SYMBOL_TYPE_LINK "ReferenceGenIn" /begin STRUCTURE_COMPONENT deltaF _float 0 SYMBOL_TYPE_LINK "deltaF" /end STRUCTURE_COMPONENT /begin STRUCTURE_COMPONENT ax _float 4 SYMBOL_TYPE_LINK "ax" /end STRUCTURE_COMPONENT /begin STRUCTURE_COMPONENT vx _float 8 SYMBOL_TYPE_LINK "vx" /end STRUCTURE_COMPONENT /begin STRUCTURE_COMPONENT m _float 12 SYMBOL_TYPE_LINK "m" /end STRUCTURE_COMPONENT
 /begin STRUCTURE_COMPONENT coastDownDragForce _float 16 SYMBOL_TYPE_LINK "coastDownDragForce" /end STRUCTURE_COMPONENT
 /begin STRUCTURE_COMPONENT coastDownRollResistForce _float 20 SYMBOL_TYPE_LINK "coastDownRollResistForce" /end STRUCTURE_COMPONENT
 /begin STRUCTURE_COMPONENT tireParams TVTireParams 24 SYMBOL_TYPE_LINK "tireParams" /end STRUCTURE_COMPONENT
/end TYPEDEF_STRUCTURE
/begin TYPEDEF_STRUCTURE WhlTqArbnLocals "" 0x64 SYMBOL_TYPE_LINK "WhlTqArbnLocals" /begin STRUCTURE_COMPONENT bInitDone _Bool 0 SYMBOL_TYPE_LINK "bInitDone" /end STRUCTURE_COMPONENT
 /begin STRUCTURE_COMPONENT bPropshTqReqAnyNeg _Bool 1 SYMBOL_TYPE_LINK "bPropshTqReqAnyNeg" /end STRUCTURE_COMPONENT
 /begin STRUCTURE_COMPONENT bPropshTqReqAnyPos _Bool 2 SYMBOL_TYPE_LINK "bPropshTqReqAnyPos" /end STRUCTURE_COMPONENT
 /begin STRUCTURE_COMPONENT bPropshTqReqNeg _Bool 3 MATRIX_DIM 4 SYMBOL_TYPE_LINK "bPropshTqReqNeg" /end STRUCTURE_COMPONENT
 /begin STRUCTURE_COMPONENT bPropshTqReqPos _Bool 7 MATRIX_DIM 4 SYMBOL_TYPE_LINK "bPropshTqReqPos" /end STRUCTURE_COMPONENT
 /begin STRUCTURE_COMPONENT propshTqRednFactor tFraction 12 SYMBOL_TYPE_LINK "propshTqRednFactor" /end STRUCTURE_COMPONENT
 /begin STRUCTURE_COMPONENT propshTqReqRawTot tNewtonMetre 16 SYMBOL_TYPE_LINK "propshTqReqRawTot" /end STRUCTURE_COMPONENT
 /begin STRUCTURE_COMPONENT propshTqReqRaw tNewtonMetre 20 MATRIX_DIM 4 SYMBOL_TYPE_LINK "propshTqReqRaw" /end STRUCTURE_COMPONENT
 /begin STRUCTURE_COMPONENT propshTqReqDtTot tNewtonMetre 36 SYMBOL_TYPE_LINK "propshTqReqDtTot" /end STRUCTURE_COMPONENT
 /begin STRUCTURE_COMPONENT propshTqReqFricBrkTot tNewtonMetre 40 SYMBOL_TYPE_LINK "propshTqReqFricBrkTot" /end STRUCTURE_COMPONENT
 /begin STRUCTURE_COMPONENT propshTqReqDt tNewtonMetre 44 MATRIX_DIM 4 SYMBOL_TYPE_LINK "propshTqReqDt" /end STRUCTURE_COMPONENT
 /begin STRUCTURE_COMPONENT propshTqReqFricBrk tNewtonMetre 60 MATRIX_DIM 4 SYMBOL_TYPE_LINK "propshTqReqFricBrk" /end STRUCTURE_COMPONENT
 /begin STRUCTURE_COMPONENT pReqRsn tPressureReqRsn 76 SYMBOL_TYPE_LINK "pReqRsn" /end STRUCTURE_COMPONENT
 /begin STRUCTURE_COMPONENT propshTqReqSlow tNewtonMetre 80 SYMBOL_TYPE_LINK "propshTqReqSlow" /end STRUCTURE_COMPONENT
 /begin STRUCTURE_COMPONENT propshTqFricBrkMin tNewtonMetre 84 MATRIX_DIM 4 SYMBOL_TYPE_LINK "propshTqFricBrkMin" /end STRUCTURE_COMPONENT
/end TYPEDEF_STRUCTURE
/begin TYPEDEF_STRUCTURE TqLimLocals "" 0x104 SYMBOL_TYPE_LINK "TqLimLocals"
 /begin STRUCTURE_COMPONENT tqRatioPropshToWhls _float 0 SYMBOL_TYPE_LINK "tqRatioPropshToWhls" /end STRUCTURE_COMPONENT
 /begin STRUCTURE_COMPONENT propshTqForInvSpdCtrlFiltCtx O1Butter 4 SYMBOL_TYPE_LINK "propshTqForInvSpdCtrlFiltCtx" /end STRUCTURE_COMPONENT
 /begin STRUCTURE_COMPONENT cenCluTqEstimd tNewtonMetre 28 SYMBOL_TYPE_LINK "cenCluTqEstimd" /end STRUCTURE_COMPONENT
 /begin STRUCTURE_COMPONENT drvrWhlTqBrkPedlDtAvl tNewtonMetre 32 SYMBOL_TYPE_LINK "drvrWhlTqBrkPedlDtAvl" /end STRUCTURE_COMPONENT
 /begin STRUCTURE_COMPONENT drvrWhlTqReqActr tNewtonMetre 36 SYMBOL_TYPE_LINK "drvrWhlTqReqActr" /end STRUCTURE_COMPONENT
 /begin STRUCTURE_COMPONENT drvrWhlTqReqCpt tNewtonMetre 40 SYMBOL_TYPE_LINK "drvrWhlTqReqCpt" /end STRUCTURE_COMPONENT
 /begin STRUCTURE_COMPONENT drvrWhlTqReqDt tNewtonMetre 44 SYMBOL_TYPE_LINK "drvrWhlTqReqDt" /end STRUCTURE_COMPONENT
 /begin STRUCTURE_COMPONENT drvrWhlTqReqSlow tNewtonMetre 48 SYMBOL_TYPE_LINK "drvrWhlTqReqSlow" /end STRUCTURE_COMPONENT
 /begin STRUCTURE_COMPONENT drvrWhlTqReqTire tNewtonMetre 52 SYMBOL_TYPE_LINK "drvrWhlTqReqTire" /end STRUCTURE_COMPONENT
 /begin STRUCTURE_COMPONENT elecMotTqMax tNewtonMetre 56 SYMBOL_TYPE_LINK "elecMotTqMax" /end STRUCTURE_COMPONENT
 /begin STRUCTURE_COMPONENT elecMotTqMaxAtWhl tNewtonMetre 60 SYMBOL_TYPE_LINK "elecMotTqMaxAtWhl" /end STRUCTURE_COMPONENT
 /begin STRUCTURE_COMPONENT elecMotTqMaxFb tNewtonMetre 64 SYMBOL_TYPE_LINK "elecMotTqMaxFb" /end STRUCTURE_COMPONENT
 /begin STRUCTURE_COMPONENT elecMotTqMin tNewtonMetre 68 SYMBOL_TYPE_LINK "elecMotTqMin" /end STRUCTURE_COMPONENT
 /begin STRUCTURE_COMPONENT elecMotTqMinAtWhl tNewtonMetre 72 SYMBOL_TYPE_LINK "elecMotTqMinAtWhl" /end STRUCTURE_COMPONENT
 /begin STRUCTURE_COMPONENT elecMotTqMinFb tNewtonMetre 76 SYMBOL_TYPE_LINK "elecMotTqMinFb" /end STRUCTURE_COMPONENT
 /begin STRUCTURE_COMPONENT iceTqMax tNewtonMetre 80 SYMBOL_TYPE_LINK "iceTqMax" /end STRUCTURE_COMPONENT
 /begin STRUCTURE_COMPONENT iceTqMaxAtWhl tNewtonMetre 84 SYMBOL_TYPE_LINK "iceTqMaxAtWhl" /end STRUCTURE_COMPONENT
 /begin STRUCTURE_COMPONENT iceTqMin tNewtonMetre 88 SYMBOL_TYPE_LINK "iceTqMin" /end STRUCTURE_COMPONENT
 /begin STRUCTURE_COMPONENT iceTqMinAtWhl tNewtonMetre 92 SYMBOL_TYPE_LINK "iceTqMinAtWhl" /end STRUCTURE_COMPONENT
 /begin STRUCTURE_COMPONENT iceTqReqFastInvSpdRedn tNewtonMetre 96 SYMBOL_TYPE_LINK "iceTqReqFastInvSpdRedn" /end STRUCTURE_COMPONENT
 /begin STRUCTURE_COMPONENT propshTqForInvSpdCtrl tNewtonMetre 100 SYMBOL_TYPE_LINK "propshTqForInvSpdCtrl" /end STRUCTURE_COMPONENT
 /begin STRUCTURE_COMPONENT propshTqForInvSpdCtrlFild tNewtonMetre 104 SYMBOL_TYPE_LINK "propshTqForInvSpdCtrlFild" /end STRUCTURE_COMPONENT
 /begin STRUCTURE_COMPONENT whlTqActrLimLowr tNewtonMetre 108 MATRIX_DIM 4 SYMBOL_TYPE_LINK "whlTqActrLimLowr" /end STRUCTURE_COMPONENT
 /begin STRUCTURE_COMPONENT whlTqActrLimUppr tNewtonMetre 124 MATRIX_DIM 4 SYMBOL_TYPE_LINK "whlTqActrLimUppr" /end STRUCTURE_COMPONENT
 /begin STRUCTURE_COMPONENT whlTqActrTotLimLowr tNewtonMetre 140 SYMBOL_TYPE_LINK "whlTqActrTotLimLowr" /end STRUCTURE_COMPONENT
 /begin STRUCTURE_COMPONENT whlTqActrTotLimUppr tNewtonMetre 144 SYMBOL_TYPE_LINK "whlTqActrTotLimUppr" /end STRUCTURE_COMPONENT
 /begin STRUCTURE_COMPONENT whlTqDtLimLowr tNewtonMetre 148 MATRIX_DIM 4 SYMBOL_TYPE_LINK "whlTqDtLimLowr" /end STRUCTURE_COMPONENT
 /begin STRUCTURE_COMPONENT whlTqDtLimUppr tNewtonMetre 164 MATRIX_DIM 4 SYMBOL_TYPE_LINK "whlTqDtLimUppr" /end STRUCTURE_COMPONENT
 /begin STRUCTURE_COMPONENT whlTqDtTotLimLowr tNewtonMetre 180 SYMBOL_TYPE_LINK "whlTqDtTotLimLowr" /end STRUCTURE_COMPONENT
 /begin STRUCTURE_COMPONENT whlTqDtTotLimUppr tNewtonMetre 184 SYMBOL_TYPE_LINK "whlTqDtTotLimUppr" /end STRUCTURE_COMPONENT
 /begin STRUCTURE_COMPONENT whlTqForInvSpdCtrl tNewtonMetre 188 SYMBOL_TYPE_LINK "whlTqForInvSpdCtrl" /end STRUCTURE_COMPONENT
 /begin STRUCTURE_COMPONENT whlTqForInvSpdCtrlExcessNeg tNewtonMetre 192 SYMBOL_TYPE_LINK "whlTqForInvSpdCtrlExcessNeg" /end STRUCTURE_COMPONENT
 /begin STRUCTURE_COMPONENT whlTqForInvSpdCtrlExcessPos tNewtonMetre 196 SYMBOL_TYPE_LINK "whlTqForInvSpdCtrlExcessPos" /end STRUCTURE_COMPONENT
 /begin STRUCTURE_COMPONENT whlTqTireLimLowr tNewtonMetre 200 MATRIX_DIM 4 SYMBOL_TYPE_LINK "whlTqTireLimLowr" /end STRUCTURE_COMPONENT
 /begin STRUCTURE_COMPONENT whlTqTireLimUppr tNewtonMetre 216 MATRIX_DIM 4 SYMBOL_TYPE_LINK "whlTqTireLimUppr" /end STRUCTURE_COMPONENT
 /begin STRUCTURE_COMPONENT whlTqTireTotLimLowr tNewtonMetre 232 SYMBOL_TYPE_LINK "whlTqTireTotLimLowr" /end STRUCTURE_COMPONENT
 /begin STRUCTURE_COMPONENT whlTqTireTotLimUppr tNewtonMetre 236 SYMBOL_TYPE_LINK "whlTqTireTotLimUppr" /end STRUCTURE_COMPONENT
 /begin STRUCTURE_COMPONENT whlTqTotCptLimLowr tNewtonMetre 240 SYMBOL_TYPE_LINK "whlTqTotCptLimLowr" /end STRUCTURE_COMPONENT
 /begin STRUCTURE_COMPONENT whlTqTotCptLimUppr tNewtonMetre 244 SYMBOL_TYPE_LINK "whlTqTotCptLimUppr" /end STRUCTURE_COMPONENT
 /begin STRUCTURE_COMPONENT drvrWhlTqBrkPedlDtAvlQ tQualifier 248 SYMBOL_TYPE_LINK "drvrWhlTqBrkPedlDtAvlQ" /end STRUCTURE_COMPONENT
 /begin STRUCTURE_COMPONENT dtTqSignReq tSign 252 SYMBOL_TYPE_LINK "dtTqSignReq" /end STRUCTURE_COMPONENT
 /begin STRUCTURE_COMPONENT tqLimReason TorqueLimitReason 256 SYMBOL_TYPE_LINK "tqLimReason" /end STRUCTURE_COMPONENT
/end TYPEDEF_STRUCTURE
/begin TYPEDEF_STRUCTURE TVTireParams "" 0x23C SYMBOL_TYPE_LINK "TVTireParams" /begin STRUCTURE_COMPONENT aAlphaF _float 0 SYMBOL_TYPE_LINK "aAlphaF" /end STRUCTURE_COMPONENT /begin STRUCTURE_COMPONENT bAlphaF _float 4 SYMBOL_TYPE_LINK "bAlphaF" /end STRUCTURE_COMPONENT /begin STRUCTURE_COMPONENT cAlphaF _float 8 SYMBOL_TYPE_LINK "cAlphaF" /end STRUCTURE_COMPONENT /begin STRUCTURE_COMPONENT aAlphaR _float 12 SYMBOL_TYPE_LINK "aAlphaR" /end STRUCTURE_COMPONENT /begin STRUCTURE_COMPONENT bAlphaR _float 16 SYMBOL_TYPE_LINK "bAlphaR" /end STRUCTURE_COMPONENT /begin STRUCTURE_COMPONENT cAlphaR _float 20 SYMBOL_TYPE_LINK "cAlphaR" /end STRUCTURE_COMPONENT /begin STRUCTURE_COMPONENT aLambdaF _float 24 SYMBOL_TYPE_LINK "aLambdaF" /end STRUCTURE_COMPONENT /begin STRUCTURE_COMPONENT bLambdaF _float 28 SYMBOL_TYPE_LINK "bLambdaF" /end STRUCTURE_COMPONENT /begin STRUCTURE_COMPONENT cLambdaF _float 32 SYMBOL_TYPE_LINK "cLambdaF" /end STRUCTURE_COMPONENT /begin STRUCTURE_COMPONENT aLambdaR _float 36 SYMBOL_TYPE_LINK "aLambdaR" /end STRUCTURE_COMPONENT /begin STRUCTURE_COMPONENT bLambdaR _float 40 SYMBOL_TYPE_LINK "bLambdaR" /end STRUCTURE_COMPONENT /begin STRUCTURE_COMPONENT cLambdaR _float 44 SYMBOL_TYPE_LINK "cLambdaR" /end STRUCTURE_COMPONENT
 /begin STRUCTURE_COMPONENT phiFzF_LUT_normFz _float 48 MATRIX_DIM 30 SYMBOL_TYPE_LINK "phiFzF_LUT_normFz" /end STRUCTURE_COMPONENT
 /begin STRUCTURE_COMPONENT phiFzF_LUT_phiFz _float 168 MATRIX_DIM 30 SYMBOL_TYPE_LINK "phiFzF_LUT_phiFz" /end STRUCTURE_COMPONENT
 /begin STRUCTURE_COMPONENT phiFzR_LUT_normFz _float 288 MATRIX_DIM 30 SYMBOL_TYPE_LINK "phiFzR_LUT_normFz" /end STRUCTURE_COMPONENT
 /begin STRUCTURE_COMPONENT phiFzR_LUT_phiFz _float 408 MATRIX_DIM 30 SYMBOL_TYPE_LINK "phiFzR_LUT_phiFz" /end STRUCTURE_COMPONENT
 /begin STRUCTURE_COMPONENT rbY1F _float 528 SYMBOL_TYPE_LINK "rbY1F" /end STRUCTURE_COMPONENT
 /begin STRUCTURE_COMPONENT rbY2F _float 532 SYMBOL_TYPE_LINK "rbY2F" /end STRUCTURE_COMPONENT
 /begin STRUCTURE_COMPONENT rbY1R _float 536 SYMBOL_TYPE_LINK "rbY1R" /end STRUCTURE_COMPONENT
 /begin STRUCTURE_COMPONENT rbY2R _float 540 SYMBOL_TYPE_LINK "rbY2R" /end STRUCTURE_COMPONENT
 /begin STRUCTURE_COMPONENT cAlphaFnomVertLoad _float 544 SYMBOL_TYPE_LINK "cAlphaFnomVertLoad" /end STRUCTURE_COMPONENT
 /begin STRUCTURE_COMPONENT cAlphaRnomVertLoad _float 548 SYMBOL_TYPE_LINK "cAlphaRnomVertLoad" /end STRUCTURE_COMPONENT
 /begin STRUCTURE_COMPONENT latForceFPeakNoFz _float 552 SYMBOL_TYPE_LINK "latForceFPeakNoFz" /end STRUCTURE_COMPONENT
 /begin STRUCTURE_COMPONENT latForceRPeakNoFz _float 556 SYMBOL_TYPE_LINK "latForceRPeakNoFz" /end STRUCTURE_COMPONENT
 /begin STRUCTURE_COMPONENT longForceFPeakNoFz _float 560 SYMBOL_TYPE_LINK "longForceFPeakNoFz" /end STRUCTURE_COMPONENT
 /begin STRUCTURE_COMPONENT longForceRPeakNoFz _float 564 SYMBOL_TYPE_LINK "longForceRPeakNoFz" /end STRUCTURE_COMPONENT
 /begin STRUCTURE_COMPONENT slipAngleRPeak _float 568 SYMBOL_TYPE_LINK "slipAngleRPeak" /end STRUCTURE_COMPONENT
/end TYPEDEF_STRUCTURE
/begin TYPEDEF_STRUCTURE RampLimitCtx "" 0x8 SYMBOL_TYPE_LINK "RampLimitCtx" /begin STRUCTURE_COMPONENT Value _float 0 SYMBOL_TYPE_LINK "Value" /end STRUCTURE_COMPONENT /begin STRUCTURE_COMPONENT Gradient _float 4 SYMBOL_TYPE_LINK "Gradient" /end STRUCTURE_COMPONENT /end TYPEDEF_STRUCTURE
/begin TYPEDEF_STRUCTURE ReferenceGenCtx "" 0x58 SYMBOL_TYPE_LINK "ReferenceGenCtx" /begin STRUCTURE_COMPONENT deltaF1 _float 0 SYMBOL_TYPE_LINK "deltaF1" /end STRUCTURE_COMPONENT /begin STRUCTURE_COMPONENT deltaF2 _float 4 SYMBOL_TYPE_LINK "deltaF2" /end STRUCTURE_COMPONENT /begin STRUCTURE_COMPONENT psidotRef1 _float 8 SYMBOL_TYPE_LINK "psidotRef1" /end STRUCTURE_COMPONENT /begin STRUCTURE_COMPONENT psidotRef2 _float 12 SYMBOL_TYPE_LINK "psidotRef2" /end STRUCTURE_COMPONENT /begin STRUCTURE_COMPONENT betaRef1 _float 16 SYMBOL_TYPE_LINK "betaRef1" /end STRUCTURE_COMPONENT /begin STRUCTURE_COMPONENT psidotRefDyn _float 20 SYMBOL_TYPE_LINK "psidotRefDyn" /end STRUCTURE_COMPONENT /begin STRUCTURE_COMPONENT psidotRefKin _float 24 SYMBOL_TYPE_LINK "psidotRefKin" /end STRUCTURE_COMPONENT /begin STRUCTURE_COMPONENT psidotRefUnsat _float 28 SYMBOL_TYPE_LINK "psidotRefUnsat" /end STRUCTURE_COMPONENT /begin STRUCTURE_COMPONENT psidotRefSat _float 32 SYMBOL_TYPE_LINK "psidotRefSat" /end STRUCTURE_COMPONENT /begin STRUCTURE_COMPONENT betaRef _float 36 SYMBOL_TYPE_LINK "betaRef" /end STRUCTURE_COMPONENT /begin STRUCTURE_COMPONENT k_blend _float 40 SYMBOL_TYPE_LINK "k_blend" /end STRUCTURE_COMPONENT /begin STRUCTURE_COMPONENT ayMaxPureLat _float 44 SYMBOL_TYPE_LINK "ayMaxPureLat" /end STRUCTURE_COMPONENT /begin STRUCTURE_COMPONENT axMaxPureLgt _float 48 SYMBOL_TYPE_LINK "axMaxPureLgt" /end STRUCTURE_COMPONENT /begin STRUCTURE_COMPONENT ayMax _float 52 SYMBOL_TYPE_LINK "ayMax" /end STRUCTURE_COMPONENT /begin STRUCTURE_COMPONENT psidotRefLb _float 56 SYMBOL_TYPE_LINK "psidotRefLb" /end STRUCTURE_COMPONENT /begin STRUCTURE_COMPONENT psidotRefUb _float 60 SYMBOL_TYPE_LINK "psidotRefUb" /end STRUCTURE_COMPONENT
 /begin STRUCTURE_COMPONENT psidotRefMaxKin _float 64 SYMBOL_TYPE_LINK "psidotRefMaxKin" /end STRUCTURE_COMPONENT
 /begin STRUCTURE_COMPONENT psidotRefMax _float 68 SYMBOL_TYPE_LINK "psidotRefMax" /end STRUCTURE_COMPONENT
 /begin STRUCTURE_COMPONENT psidotRefLbStar _float 72 SYMBOL_TYPE_LINK "psidotRefLbStar" /end STRUCTURE_COMPONENT
 /begin STRUCTURE_COMPONENT psidotRefUbStar _float 76 SYMBOL_TYPE_LINK "psidotRefUbStar" /end STRUCTURE_COMPONENT
 /begin STRUCTURE_COMPONENT nIterSecantAY _float 80 SYMBOL_TYPE_LINK "nIterSecantAY" /end STRUCTURE_COMPONENT
 /begin STRUCTURE_COMPONENT nIterSecantAX _float 84 SYMBOL_TYPE_LINK "nIterSecantAX" /end STRUCTURE_COMPONENT
/end TYPEDEF_STRUCTURE
/begin TYPEDEF_STRUCTURE FaultCode "" 0x4 SYMBOL_TYPE_LINK "FaultCode" /begin STRUCTURE_COMPONENT flags FaultCodeFlags 0 SYMBOL_TYPE_LINK "flags" /end STRUCTURE_COMPONENT /begin STRUCTURE_COMPONENT raw uint8_t 0 SYMBOL_TYPE_LINK "raw" /end STRUCTURE_COMPONENT /end TYPEDEF_STRUCTURE
/begin TYPEDEF_STRUCTURE CluPressCtrlLocals "" 0x1D4 SYMBOL_TYPE_LINK "CluPressCtrlLocals"
 /begin STRUCTURE_COMPONENT bRuntimeCalibration _Bool 0 SYMBOL_TYPE_LINK "bRuntimeCalibration" /end STRUCTURE_COMPONENT
 /begin STRUCTURE_COMPONENT controlType tCluCtrlType 4 SYMBOL_TYPE_LINK "controlType" /end STRUCTURE_COMPONENT
 /begin STRUCTURE_COMPONENT cluCMD tPercent_100_S16 8 MATRIX_DIM 4 SYMBOL_TYPE_LINK "cluCMD" /end STRUCTURE_COMPONENT
 /begin STRUCTURE_COMPONENT cluDitherAmpl tAmpere 16 MATRIX_DIM 4 SYMBOL_TYPE_LINK "cluDitherAmpl" /end STRUCTURE_COMPONENT
 /begin STRUCTURE_COMPONENT cluDitherFreq tHertz 32 MATRIX_DIM 4 SYMBOL_TYPE_LINK "cluDitherFreq" /end STRUCTURE_COMPONENT
 /begin STRUCTURE_COMPONENT cluFastFillTimeAdaption_Map tPercent_100_S16 48 MATRIX_DIM 56 SYMBOL_TYPE_LINK "cluFastFillTimeAdaption_Map" /end STRUCTURE_COMPONENT
 /begin STRUCTURE_COMPONENT cluKissPress tBar_100_S16 160 MATRIX_DIM 4 SYMBOL_TYPE_LINK "cluKissPress" /end STRUCTURE_COMPONENT
 /begin STRUCTURE_COMPONENT cluPressOscnFreq tHertz_10_S16 168 MATRIX_DIM 4 SYMBOL_TYPE_LINK "cluPressOscnFreq" /end STRUCTURE_COMPONENT
 /begin STRUCTURE_COMPONENT cluPressOscnAmpl tBar_100_S16 176 MATRIX_DIM 4 SYMBOL_TYPE_LINK "cluPressOscnAmpl" /end STRUCTURE_COMPONENT
 /begin STRUCTURE_COMPONENT pressOscilStatus OscillationStatus 184 MATRIX_DIM 4 SYMBOL_TYPE_LINK "pressOscilStatus" /end STRUCTURE_COMPONENT
 /begin STRUCTURE_COMPONENT cluCtrlState tCluCtrlState 264 MATRIX_DIM 4 SYMBOL_TYPE_LINK "cluCtrlState" /end STRUCTURE_COMPONENT
 /begin STRUCTURE_COMPONENT fastFillCorrection tMillisecond_U32 280 MATRIX_DIM 4 SYMBOL_TYPE_LINK "fastFillCorrection" /end STRUCTURE_COMPONENT
 /begin STRUCTURE_COMPONENT fastfillDuration tMillisecond_U32 296 MATRIX_DIM 4 SYMBOL_TYPE_LINK "fastfillDuration" /end STRUCTURE_COMPONENT
 /begin STRUCTURE_COMPONENT fastfillErrorIntegralPos int32_t 312 MATRIX_DIM 4 SYMBOL_TYPE_LINK "fastfillErrorIntegralPos" /end STRUCTURE_COMPONENT
 /begin STRUCTURE_COMPONENT fastfillErrorIntegralNeg int32_t 328 MATRIX_DIM 4 SYMBOL_TYPE_LINK "fastfillErrorIntegralNeg" /end STRUCTURE_COMPONENT
 /begin STRUCTURE_COMPONENT fastfillErrorSquaredIntegral uint32_t 344 MATRIX_DIM 4 SYMBOL_TYPE_LINK "fastfillErrorSquaredIntegral" /end STRUCTURE_COMPONENT
 /begin STRUCTURE_COMPONENT fastfillEndTime tMillisecond_U32 360 MATRIX_DIM 4 SYMBOL_TYPE_LINK "fastfillEndTime" /end STRUCTURE_COMPONENT
 /begin STRUCTURE_COMPONENT fastfillPeakPressure tBar_100_S16 376 MATRIX_DIM 4 SYMBOL_TYPE_LINK "fastfillPeakPressure" /end STRUCTURE_COMPONENT
 /begin STRUCTURE_COMPONENT PIDAccumulators int32_t 384 MATRIX_DIM 4 SYMBOL_TYPE_LINK "PIDAccumulators" /end STRUCTURE_COMPONENT
 /begin STRUCTURE_COMPONENT pressOscilParams OscillationParams 400 SYMBOL_TYPE_LINK "pressOscilParams" /end STRUCTURE_COMPONENT
 /begin STRUCTURE_COMPONENT rampedDemand tBar_100_S16 420 MATRIX_DIM 4 SYMBOL_TYPE_LINK "rampedDemand" /end STRUCTURE_COMPONENT
 /begin STRUCTURE_COMPONENT runCalVoteAddBase uint8_t 428 MATRIX_DIM 4 SYMBOL_TYPE_LINK "runCalVoteAddBase" /end STRUCTURE_COMPONENT
 /begin STRUCTURE_COMPONENT runCalVoteRemBase uint8_t 432 MATRIX_DIM 4 SYMBOL_TYPE_LINK "runCalVoteRemBase" /end STRUCTURE_COMPONENT
 /begin STRUCTURE_COMPONENT runCalVoteAddTop uint8_t 436 MATRIX_DIM 4 SYMBOL_TYPE_LINK "runCalVoteAddTop" /end STRUCTURE_COMPONENT
 /begin STRUCTURE_COMPONENT runCalVoteRemTop uint8_t 440 MATRIX_DIM 4 SYMBOL_TYPE_LINK "runCalVoteRemTop" /end STRUCTURE_COMPONENT
 /begin STRUCTURE_COMPONENT underFillUpkickRequest _Bool 444 MATRIX_DIM 4 SYMBOL_TYPE_LINK "underFillUpkickRequest" /end STRUCTURE_COMPONENT
 /begin STRUCTURE_COMPONENT valveCMD_Map tPercent_100_S16 448 MATRIX_DIM 8 SYMBOL_TYPE_LINK "valveCMD_Map" /end STRUCTURE_COMPONENT
 /begin STRUCTURE_COMPONENT fastFillStartTime tMillisecond_U32 464 SYMBOL_TYPE_LINK "fastFillStartTime" /end STRUCTURE_COMPONENT
/end TYPEDEF_STRUCTURE
/begin TYPEDEF_STRUCTURE CluTqHdlLocals "" 0x2D8 SYMBOL_TYPE_LINK "CluTqHdlLocals" /begin STRUCTURE_COMPONENT bInitDone _Bool 0 SYMBOL_TYPE_LINK "bInitDone" /end STRUCTURE_COMPONENT /begin STRUCTURE_COMPONENT bCenCluSync _Bool 1 SYMBOL_TYPE_LINK "bCenCluSync" /end STRUCTURE_COMPONENT
 /begin STRUCTURE_COMPONENT bHybDrvTakeoffRdy _Bool 2 SYMBOL_TYPE_LINK "bHybDrvTakeoffRdy" /end STRUCTURE_COMPONENT
 /begin STRUCTURE_COMPONENT bIceRunngDetd _Bool 3 SYMBOL_TYPE_LINK "bIceRunngDetd" /end STRUCTURE_COMPONENT
 /begin STRUCTURE_COMPONENT bPropshRateSyncCrk _Bool 4 SYMBOL_TYPE_LINK "bPropshRateSyncCrk" /end STRUCTURE_COMPONENT
 /begin STRUCTURE_COMPONENT bPropshRateSyncIntgtr _Bool 5 SYMBOL_TYPE_LINK "bPropshRateSyncIntgtr" /end STRUCTURE_COMPONENT
 /begin STRUCTURE_COMPONENT bPropshStaty _Bool 6 SYMBOL_TYPE_LINK "bPropshStaty" /end STRUCTURE_COMPONENT
 /begin STRUCTURE_COMPONENT bPropshStatyCrkFinished _Bool 7 SYMBOL_TYPE_LINK "bPropshStatyCrkFinished" /end STRUCTURE_COMPONENT
 /begin STRUCTURE_COMPONENT bPropshStatyCrkStCoupleTimeout _Bool 8 SYMBOL_TYPE_LINK "bPropshStatyCrkStCoupleTimeout" /end STRUCTURE_COMPONENT
 /begin STRUCTURE_COMPONENT bPropshStatyCrkStInitTimeout _Bool 9 SYMBOL_TYPE_LINK "bPropshStatyCrkStInitTimeout" /end STRUCTURE_COMPONENT
 /begin STRUCTURE_COMPONENT bPropshStatyCrkStRunngTimeout _Bool 10 SYMBOL_TYPE_LINK "bPropshStatyCrkStRunngTimeout" /end STRUCTURE_COMPONENT
 /begin STRUCTURE_COMPONENT bPropshStatyCrkStStartTimeout _Bool 11 SYMBOL_TYPE_LINK "bPropshStatyCrkStStartTimeout" /end STRUCTURE_COMPONENT
 /begin STRUCTURE_COMPONENT bPropshStatyCrkStSyncTimeout _Bool 12 SYMBOL_TYPE_LINK "bPropshStatyCrkStSyncTimeout" /end STRUCTURE_COMPONENT
 /begin STRUCTURE_COMPONENT bTqStInit _Bool 13 SYMBOL_TYPE_LINK "bTqStInit" /end STRUCTURE_COMPONENT
 /begin STRUCTURE_COMPONENT gearRatPropshToIce _float 16 SYMBOL_TYPE_LINK "gearRatPropshToIce" /end STRUCTURE_COMPONENT
 /begin STRUCTURE_COMPONENT propshRateCtrlGainDeriv _float 20 SYMBOL_TYPE_LINK "propshRateCtrlGainDeriv" /end STRUCTURE_COMPONENT
 /begin STRUCTURE_COMPONENT propshRateCtrlGainIntgl _float 24 SYMBOL_TYPE_LINK "propshRateCtrlGainIntgl" /end STRUCTURE_COMPONENT
 /begin STRUCTURE_COMPONENT propshRateCtrlGainProp _float 28 SYMBOL_TYPE_LINK "propshRateCtrlGainProp" /end STRUCTURE_COMPONENT
 /begin STRUCTURE_COMPONENT tarGearRatPropshToIce _float 32 SYMBOL_TYPE_LINK "tarGearRatPropshToIce" /end STRUCTURE_COMPONENT
 /begin STRUCTURE_COMPONENT propshRateErrDerivFiltStr Dfd 36 SYMBOL_TYPE_LINK "propshRateErrDerivFiltStr" /end STRUCTURE_COMPONENT
 /begin STRUCTURE_COMPONENT propshFrntSpdFilStruct O2Butter 80 SYMBOL_TYPE_LINK "propshFrntSpdFilStruct" /end STRUCTURE_COMPONENT
 /begin STRUCTURE_COMPONENT propshRearSpdFilStruct O2Butter 116 SYMBOL_TYPE_LINK "propshRearSpdFilStruct" /end STRUCTURE_COMPONENT
 /begin STRUCTURE_COMPONENT brkPReq tBar 152 MATRIX_DIM 4 SYMBOL_TYPE_LINK "brkPReq" /end STRUCTURE_COMPONENT
 /begin STRUCTURE_COMPONENT cenCluStReq tClutchState 168 SYMBOL_TYPE_LINK "cenCluStReq" /end STRUCTURE_COMPONENT
 /begin STRUCTURE_COMPONENT whlCluStReq tClutchState 172 MATRIX_DIM 4 SYMBOL_TYPE_LINK "whlCluStReq" /end STRUCTURE_COMPONENT
 /begin STRUCTURE_COMPONENT latchedGear tGear 188 SYMBOL_TYPE_LINK "latchedGear" /end STRUCTURE_COMPONENT
 /begin STRUCTURE_COMPONENT idleSt tIdleState 192 SYMBOL_TYPE_LINK "idleSt" /end STRUCTURE_COMPONENT
 /begin STRUCTURE_COMPONENT propshRateCtrlrIntgtrSt tIntegratorState 196 SYMBOL_TYPE_LINK "propshRateCtrlrIntgtrSt" /end STRUCTURE_COMPONENT
 /begin STRUCTURE_COMPONENT vehVelLimDt tKilometrePerHour_10_S16 200 SYMBOL_TYPE_LINK "vehVelLimDt" /end STRUCTURE_COMPONENT
 /begin STRUCTURE_COMPONENT cenCluSyncStTmr tMillisecond_U32 204 SYMBOL_TYPE_LINK "cenCluSyncStTmr" /end STRUCTURE_COMPONENT
 /begin STRUCTURE_COMPONENT propshRateSyncIntgtrStTmr tMillisecond_U32 208 SYMBOL_TYPE_LINK "propshRateSyncIntgtrStTmr" /end STRUCTURE_COMPONENT
 /begin STRUCTURE_COMPONENT propshStatyCrkStTmr tMillisecond_U32 212 SYMBOL_TYPE_LINK "propshStatyCrkStTmr" /end STRUCTURE_COMPONENT
 /begin STRUCTURE_COMPONENT cenCluTqReqAbslt tNewtonMetre 216 SYMBOL_TYPE_LINK "cenCluTqReqAbslt" /end STRUCTURE_COMPONENT
 /begin STRUCTURE_COMPONENT drvrWhlTqBrkPedlDtAct tNewtonMetre 220 SYMBOL_TYPE_LINK "drvrWhlTqBrkPedlDtAct" /end STRUCTURE_COMPONENT
 /begin STRUCTURE_COMPONENT propshRateCtrlTqReq tNewtonMetre 224 SYMBOL_TYPE_LINK "propshRateCtrlTqReq" /end STRUCTURE_COMPONENT
 /begin STRUCTURE_COMPONENT propshRateCtrlTqReqAtSync tNewtonMetre 228 SYMBOL_TYPE_LINK "propshRateCtrlTqReqAtSync" /end STRUCTURE_COMPONENT
 /begin STRUCTURE_COMPONENT propshRateCtrlTqReqDeriv tNewtonMetre 232 SYMBOL_TYPE_LINK "propshRateCtrlTqReqDeriv" /end STRUCTURE_COMPONENT
 /begin STRUCTURE_COMPONENT propshRateCtrlTqReqFf tNewtonMetre 236 SYMBOL_TYPE_LINK "propshRateCtrlTqReqFf" /end STRUCTURE_COMPONENT
 /begin STRUCTURE_COMPONENT propshRateCtrlTqReqIceRunngDetnThd tNewtonMetre 240 SYMBOL_TYPE_LINK "propshRateCtrlTqReqIceRunngDetnThd" /end STRUCTURE_COMPONENT
 /begin STRUCTURE_COMPONENT propshRateCtrlTqReqIntgl tNewtonMetre 244 SYMBOL_TYPE_LINK "propshRateCtrlTqReqIntgl" /end STRUCTURE_COMPONENT
 /begin STRUCTURE_COMPONENT propshRateCtrlTqReqProp tNewtonMetre 248 SYMBOL_TYPE_LINK "propshRateCtrlTqReqProp" /end STRUCTURE_COMPONENT
 /begin STRUCTURE_COMPONENT propshTqReqDtTot tNewtonMetre 252 SYMBOL_TYPE_LINK "propshTqReqDtTot" /end STRUCTURE_COMPONENT
 /begin STRUCTURE_COMPONENT propshTqReqTot tNewtonMetre 256 SYMBOL_TYPE_LINK "propshTqReqTot" /end STRUCTURE_COMPONENT
 /begin STRUCTURE_COMPONENT propshTqSync tNewtonMetre 260 SYMBOL_TYPE_LINK "propshTqSync" /end STRUCTURE_COMPONENT
 /begin STRUCTURE_COMPONENT propshTqSyncRaw tNewtonMetre 264 SYMBOL_TYPE_LINK "propshTqSyncRaw" /end STRUCTURE_COMPONENT
 /begin STRUCTURE_COMPONENT propshTqSyncSum tNewtonMetre 268 SYMBOL_TYPE_LINK "propshTqSyncSum" /end STRUCTURE_COMPONENT
 /begin STRUCTURE_COMPONENT propshTqTotFromWhlCluEstim tNewtonMetre 272 SYMBOL_TYPE_LINK "propshTqTotFromWhlCluEstim" /end STRUCTURE_COMPONENT
 /begin STRUCTURE_COMPONENT whlCluTqReqAbslt tNewtonMetre 276 MATRIX_DIM 4 SYMBOL_TYPE_LINK "whlCluTqReqAbslt" /end STRUCTURE_COMPONENT
 /begin STRUCTURE_COMPONENT whlCluTqReqRaw tNewtonMetre 292 MATRIX_DIM 4 SYMBOL_TYPE_LINK "whlCluTqReqRaw" /end STRUCTURE_COMPONENT
 /begin STRUCTURE_COMPONENT whlTqReqDt tNewtonMetre 308 MATRIX_DIM 4 SYMBOL_TYPE_LINK "whlTqReqDt" /end STRUCTURE_COMPONENT
 /begin STRUCTURE_COMPONENT whlTqReqFricBrk tNewtonMetre 324 MATRIX_DIM 4 SYMBOL_TYPE_LINK "whlTqReqFricBrk" /end STRUCTURE_COMPONENT
 /begin STRUCTURE_COMPONENT pReqRsn tPressureReqRsn 340 SYMBOL_TYPE_LINK "pReqRsn" /end STRUCTURE_COMPONENT
 /begin STRUCTURE_COMPONENT propshDrvgCrkSt tPropshaftDrivingCrankState 344 SYMBOL_TYPE_LINK "propshDrvgCrkSt" /end STRUCTURE_COMPONENT
 /begin STRUCTURE_COMPONENT propshDrvgCrkStFlt PropshaftDrivingCrankStateFault 352 SYMBOL_TYPE_LINK "propshDrvgCrkStFlt" /end STRUCTURE_COMPONENT
 /begin STRUCTURE_COMPONENT propshStatyCrkSt tPropshaftStationaryCrankState 360 SYMBOL_TYPE_LINK "propshStatyCrkSt" /end STRUCTURE_COMPONENT
 /begin STRUCTURE_COMPONENT propshStatyCrkStPrev tPropshaftStationaryCrankState 364 SYMBOL_TYPE_LINK "propshStatyCrkStPrev" /end STRUCTURE_COMPONENT
 /begin STRUCTURE_COMPONENT propshStatyCrkStFlt PropshaftStationaryCrankStateFault 368 SYMBOL_TYPE_LINK "propshStatyCrkStFlt" /end STRUCTURE_COMPONENT
 /begin STRUCTURE_COMPONENT brkPReqQ tQualifier 376 MATRIX_DIM 4 SYMBOL_TYPE_LINK "brkPReqQ" /end STRUCTURE_COMPONENT
 /begin STRUCTURE_COMPONENT cenCluSpdSlipQ tQualifier 392 SYMBOL_TYPE_LINK "cenCluSpdSlipQ" /end STRUCTURE_COMPONENT
 /begin STRUCTURE_COMPONENT drvrWhlTqBrkPedlDtActQ tQualifier 396 SYMBOL_TYPE_LINK "drvrWhlTqBrkPedlDtActQ" /end STRUCTURE_COMPONENT
 /begin STRUCTURE_COMPONENT cluRateTarOutp tRadianPerSecond 400 MATRIX_DIM 4 SYMBOL_TYPE_LINK "cluRateTarOutp" /end STRUCTURE_COMPONENT
 /begin STRUCTURE_COMPONENT outerCluRateMaxRaw tRadianPerSecond 416 MATRIX_DIM 4 SYMBOL_TYPE_LINK "outerCluRateMaxRaw" /end STRUCTURE_COMPONENT
 /begin STRUCTURE_COMPONENT outerCluRateMinSlipValue tRadianPerSecond 432 MATRIX_DIM 4 SYMBOL_TYPE_LINK "outerCluRateMinSlipValue" /end STRUCTURE_COMPONENT
 /begin STRUCTURE_COMPONENT propshRateDrvgTar tRadianPerSecond 448 SYMBOL_TYPE_LINK "propshRateDrvgTar" /end STRUCTURE_COMPONENT
 /begin STRUCTURE_COMPONENT propshRateDrvgTarPos tRadianPerSecond 452 SYMBOL_TYPE_LINK "propshRateDrvgTarPos" /end STRUCTURE_COMPONENT
 /begin STRUCTURE_COMPONENT propshRateDrvgTarNeg tRadianPerSecond 456 SYMBOL_TYPE_LINK "propshRateDrvgTarNeg" /end STRUCTURE_COMPONENT
 /begin STRUCTURE_COMPONENT propshRateTarPos tRadianPerSecond 460 MATRIX_DIM 4 SYMBOL_TYPE_LINK "propshRateTarPos" /end STRUCTURE_COMPONENT
 /begin STRUCTURE_COMPONENT propshRateTarNeg tRadianPerSecond 476 MATRIX_DIM 4 SYMBOL_TYPE_LINK "propshRateTarNeg" /end STRUCTURE_COMPONENT
 /begin STRUCTURE_COMPONENT propshRateErr tRadianPerSecond 492 SYMBOL_TYPE_LINK "propshRateErr" /end STRUCTURE_COMPONENT
 /begin STRUCTURE_COMPONENT propshRateIdleTar tRadianPerSecond 496 SYMBOL_TYPE_LINK "propshRateIdleTar" /end STRUCTURE_COMPONENT
 /begin STRUCTURE_COMPONENT propshRateSlipTarPos tRadianPerSecond 500 SYMBOL_TYPE_LINK "propshRateSlipTarPos" /end STRUCTURE_COMPONENT
 /begin STRUCTURE_COMPONENT propshRateSlipTarNeg tRadianPerSecond 504 SYMBOL_TYPE_LINK "propshRateSlipTarNeg" /end STRUCTURE_COMPONENT
 /begin STRUCTURE_COMPONENT propshRateTakeoffPreDwnshftBuf tRadianPerSecond 508 SYMBOL_TYPE_LINK "propshRateTakeoffPreDwnshftBuf" /end STRUCTURE_COMPONENT
 /begin STRUCTURE_COMPONENT propshRateTar tRadianPerSecond 512 SYMBOL_TYPE_LINK "propshRateTar" /end STRUCTURE_COMPONENT
 /begin STRUCTURE_COMPONENT propshRateTarRaw tRadianPerSecond 516 SYMBOL_TYPE_LINK "propshRateTarRaw" /end STRUCTURE_COMPONENT
 /begin STRUCTURE_COMPONENT propshRateWhlTarPos tRadianPerSecond 520 SYMBOL_TYPE_LINK "propshRateWhlTarPos" /end STRUCTURE_COMPONENT
 /begin STRUCTURE_COMPONENT propshRateWhlTarNeg tRadianPerSecond 524 SYMBOL_TYPE_LINK "propshRateWhlTarNeg" /end STRUCTURE_COMPONENT
 /begin STRUCTURE_COMPONENT syncCluRateSlipTar tRadianPerSecond 528 MATRIX_DIM 4 SYMBOL_TYPE_LINK "syncCluRateSlipTar" /end STRUCTURE_COMPONENT
 /begin STRUCTURE_COMPONENT whlCluRateMinSlipTar tRadianPerSecond 544 MATRIX_DIM 4 SYMBOL_TYPE_LINK "whlCluRateMinSlipTar" /end STRUCTURE_COMPONENT
 /begin STRUCTURE_COMPONENT whlCluRateOuterMax tRadianPerSecond 560 MATRIX_DIM 4 SYMBOL_TYPE_LINK "whlCluRateOuterMax" /end STRUCTURE_COMPONENT
 /begin STRUCTURE_COMPONENT whlRateLim tRadianPerSecond 576 MATRIX_DIM 4 SYMBOL_TYPE_LINK "whlRateLim" /end STRUCTURE_COMPONENT
 /begin STRUCTURE_COMPONENT propshRateErrFiltDeriv tRadianPerSquareSecond 592 SYMBOL_TYPE_LINK "propshRateErrFiltDeriv" /end STRUCTURE_COMPONENT
 /begin STRUCTURE_COMPONENT cluTqRampStr RampLimitCtx 596 MATRIX_DIM 4 SYMBOL_TYPE_LINK "cluTqRampStr" /end STRUCTURE_COMPONENT
 /begin STRUCTURE_COMPONENT propshRateCtrlTqReqIntglLimitRampedStr RampLimitCtx 628 SYMBOL_TYPE_LINK "propshRateCtrlTqReqIntglLimitRampedStr" /end STRUCTURE_COMPONENT
 /begin STRUCTURE_COMPONENT propshRateTarRampStr RampLimitCtx 636 SYMBOL_TYPE_LINK "propshRateTarRampStr" /end STRUCTURE_COMPONENT
 /begin STRUCTURE_COMPONENT cluTqRampSt tRampState 644 MATRIX_DIM 4 SYMBOL_TYPE_LINK "cluTqRampSt" /end STRUCTURE_COMPONENT
 /begin STRUCTURE_COMPONENT propshRateCtrlrGainSet tRateControllerGainSet 660 SYMBOL_TYPE_LINK "propshRateCtrlrGainSet" /end STRUCTURE_COMPONENT
 /begin STRUCTURE_COMPONENT cenCluSpdSlipAbs tRevolutionPerMinute 664 SYMBOL_TYPE_LINK "cenCluSpdSlipAbs" /end STRUCTURE_COMPONENT
 /begin STRUCTURE_COMPONENT propshFrntSpdFild tRevolutionPerMinute 668 SYMBOL_TYPE_LINK "propshFrntSpdFild" /end STRUCTURE_COMPONENT
 /begin STRUCTURE_COMPONENT propshRearSpdFild tRevolutionPerMinute 672 SYMBOL_TYPE_LINK "propshRearSpdFild" /end STRUCTURE_COMPONENT
 /begin STRUCTURE_COMPONENT hybDriveIceSpd tRevolutionPerMinute_S16 676 SYMBOL_TYPE_LINK "hybDriveIceSpd" /end STRUCTURE_COMPONENT
 /begin STRUCTURE_COMPONENT hybDrivePropshIdleSpd tRevolutionPerMinute_S16 678 SYMBOL_TYPE_LINK "hybDrivePropshIdleSpd" /end STRUCTURE_COMPONENT
 /begin STRUCTURE_COMPONENT hybIdleIceSpd tRevolutionPerMinute_S16 680 SYMBOL_TYPE_LINK "hybIdleIceSpd" /end STRUCTURE_COMPONENT
 /begin STRUCTURE_COMPONENT hybIdlePropshIdleSpd tRevolutionPerMinute_S16 682 SYMBOL_TYPE_LINK "hybIdlePropshIdleSpd" /end STRUCTURE_COMPONENT
 /begin STRUCTURE_COMPONENT hybIdleRevPropshIdleSpd tRevolutionPerMinute_S16 684 SYMBOL_TYPE_LINK "hybIdleRevPropshIdleSpd" /end STRUCTURE_COMPONENT
 /begin STRUCTURE_COMPONENT icePropshIdleSpd tRevolutionPerMinute_S16 686 SYMBOL_TYPE_LINK "icePropshIdleSpd" /end STRUCTURE_COMPONENT
 /begin STRUCTURE_COMPONENT iceSpdReq tRevolutionPerMinute_S16 688 SYMBOL_TYPE_LINK "iceSpdReq" /end STRUCTURE_COMPONENT
 /begin STRUCTURE_COMPONENT iceSpdReqMin tRevolutionPerMinute_S16 690 SYMBOL_TYPE_LINK "iceSpdReqMin" /end STRUCTURE_COMPONENT
 /begin STRUCTURE_COMPONENT iceSpdTar tRevolutionPerMinute_S16 692 SYMBOL_TYPE_LINK "iceSpdTar" /end STRUCTURE_COMPONENT
 /begin STRUCTURE_COMPONENT propshCrkRunngSpdErrThres tRevolutionPerMinute_S16 694 SYMBOL_TYPE_LINK "propshCrkRunngSpdErrThres" /end STRUCTURE_COMPONENT
 /begin STRUCTURE_COMPONENT statyCrkPropshSpd tRevolutionPerMinute_S16 696 SYMBOL_TYPE_LINK "statyCrkPropshSpd" /end STRUCTURE_COMPONENT
 /begin STRUCTURE_COMPONENT statyCrkPropshSpdLatched tRevolutionPerMinute_S16 698 SYMBOL_TYPE_LINK "statyCrkPropshSpdLatched" /end STRUCTURE_COMPONENT
 /begin STRUCTURE_COMPONENT statyCrkPropshSpdOffs tRevolutionPerMinute_S16 700 SYMBOL_TYPE_LINK "statyCrkPropshSpdOffs" /end STRUCTURE_COMPONENT
 /begin STRUCTURE_COMPONENT dtTqSign tSign 704 SYMBOL_TYPE_LINK "dtTqSign" /end STRUCTURE_COMPONENT
 /begin STRUCTURE_COMPONENT takeoffSt tTakeoffState 708 SYMBOL_TYPE_LINK "takeoffSt" /end STRUCTURE_COMPONENT
 /begin STRUCTURE_COMPONENT tqStatePrev tTqMacSt 712 SYMBOL_TYPE_LINK "tqStatePrev" /end STRUCTURE_COMPONENT
 /begin STRUCTURE_COMPONENT propshCrkRunngStCnt uint32_t 716 SYMBOL_TYPE_LINK "propshCrkRunngStCnt" /end STRUCTURE_COMPONENT
 /begin STRUCTURE_COMPONENT propshTqSyncCounter uint32_t 720 SYMBOL_TYPE_LINK "propshTqSyncCounter" /end STRUCTURE_COMPONENT
 /begin STRUCTURE_COMPONENT ixSyncCluRateOutpPos uint8_t 724 SYMBOL_TYPE_LINK "ixSyncCluRateOutpPos" /end STRUCTURE_COMPONENT
 /begin STRUCTURE_COMPONENT ixSyncCluRateOutpNeg uint8_t 725 SYMBOL_TYPE_LINK "ixSyncCluRateOutpNeg" /end STRUCTURE_COMPONENT
/end TYPEDEF_STRUCTURE
/begin TYPEDEF_STRUCTURE RideLocals "" 0x4D0 SYMBOL_TYPE_LINK "RideLocals" /begin STRUCTURE_COMPONENT initDone _Bool 0 SYMBOL_TYPE_LINK "initDone" /end STRUCTURE_COMPONENT /begin STRUCTURE_COMPONENT liftCmd LiftCmd 4 SYMBOL_TYPE_LINK "liftCmd" /end STRUCTURE_COMPONENT /begin STRUCTURE_COMPONENT liftSt tLiftState 20 SYMBOL_TYPE_LINK "liftSt" /end STRUCTURE_COMPONENT
 /begin STRUCTURE_COMPONENT sensorLocals RideSensorLocals 24 SYMBOL_TYPE_LINK "sensorLocals" /end STRUCTURE_COMPONENT
 /begin STRUCTURE_COMPONENT ctrlLocals RideHeightCtrlrLocals 900 SYMBOL_TYPE_LINK "ctrlLocals" /end STRUCTURE_COMPONENT
 /begin STRUCTURE_COMPONENT cycleState RhsCycleState 1072 SYMBOL_TYPE_LINK "cycleState" /end STRUCTURE_COMPONENT
 /begin STRUCTURE_COMPONENT stratWorkspace RhcStrategyWorkspace 1080 SYMBOL_TYPE_LINK "stratWorkspace" /end STRUCTURE_COMPONENT
 /begin STRUCTURE_COMPONENT activeState RhsActiveState 1144 SYMBOL_TYPE_LINK "activeState" /end STRUCTURE_COMPONENT
 /begin STRUCTURE_COMPONENT calibState RhsCalibState 1160 SYMBOL_TYPE_LINK "calibState" /end STRUCTURE_COMPONENT
 /begin STRUCTURE_COMPONENT prevIgnSt tPowerState 1212 SYMBOL_TYPE_LINK "prevIgnSt" /end STRUCTURE_COMPONENT
 /begin STRUCTURE_COMPONENT bLiftTimeoutWarningRequest _Bool 1216 SYMBOL_TYPE_LINK "bLiftTimeoutWarningRequest" /end STRUCTURE_COMPONENT
 /begin STRUCTURE_COMPONENT bVehicleSpeedTooHighForLiftUp _Bool 1217 SYMBOL_TYPE_LINK "bVehicleSpeedTooHighForLiftUp" /end STRUCTURE_COMPONENT
 /begin STRUCTURE_COMPONENT rideHeightmasterMode tRideHeightMode 1220 SYMBOL_TYPE_LINK "rideHeightmasterMode" /end STRUCTURE_COMPONENT
 /begin STRUCTURE_COMPONENT perfModPrev tPerformanceModeRHC 1224 SYMBOL_TYPE_LINK "perfModPrev" /end STRUCTURE_COMPONENT
 /begin STRUCTURE_COMPONENT liftBtnPsdCntPrev uint8_t 1228 SYMBOL_TYPE_LINK "liftBtnPsdCntPrev" /end STRUCTURE_COMPONENT
/end TYPEDEF_STRUCTURE
/begin TYPEDEF_STRUCTURE LibInverterHandler "" 0x48 SYMBOL_TYPE_LINK "LibInverterHandler"
 /begin STRUCTURE_COMPONENT invStatusFeedbackMsgTimeout _Bool 0 SYMBOL_TYPE_LINK "invStatusFeedbackMsgTimeout" /end STRUCTURE_COMPONENT
 /begin STRUCTURE_COMPONENT invFault1MsgTimeout _Bool 1 SYMBOL_TYPE_LINK "invFault1MsgTimeout" /end STRUCTURE_COMPONENT
 /begin STRUCTURE_COMPONENT invFault2MsgTimeout _Bool 2 SYMBOL_TYPE_LINK "invFault2MsgTimeout" /end STRUCTURE_COMPONENT
 /begin STRUCTURE_COMPONENT stateMachine InvSmCtx 8 SYMBOL_TYPE_LINK "stateMachine" /end STRUCTURE_COMPONENT
 /begin STRUCTURE_COMPONENT faultLevel tFaultLevel 48 SYMBOL_TYPE_LINK "faultLevel" /end STRUCTURE_COMPONENT
 /begin STRUCTURE_COMPONENT faultFlags1 InverterFault1 56 SYMBOL_TYPE_LINK "faultFlags1" /end STRUCTURE_COMPONENT
 /begin STRUCTURE_COMPONENT faultFlags2 inverterFault2 64 SYMBOL_TYPE_LINK "faultFlags2" /end STRUCTURE_COMPONENT
/end TYPEDEF_STRUCTURE
/begin TYPEDEF_STRUCTURE CoolingFan "" 0x18 SYMBOL_TYPE_LINK "CoolingFan" /begin STRUCTURE_COMPONENT powerSupply tPowerSupply 0 SYMBOL_TYPE_LINK "powerSupply" /end STRUCTURE_COMPONENT /begin STRUCTURE_COMPONENT request tPercent_S8 4 SYMBOL_TYPE_LINK "request" /end STRUCTURE_COMPONENT /begin STRUCTURE_COMPONENT command tPercent_S8 5 SYMBOL_TYPE_LINK "command" /end STRUCTURE_COMPONENT /begin STRUCTURE_COMPONENT fanModel tFanModel 8 SYMBOL_TYPE_LINK "fanModel" /end STRUCTURE_COMPONENT
 /begin STRUCTURE_COMPONENT powerEstimation tKilowatt 12 SYMBOL_TYPE_LINK "powerEstimation" /end STRUCTURE_COMPONENT
 /begin STRUCTURE_COMPONENT speed tRevolutionPerMinute 16 SYMBOL_TYPE_LINK "speed" /end STRUCTURE_COMPONENT
 /begin STRUCTURE_COMPONENT power tWatt 20 SYMBOL_TYPE_LINK "power" /end STRUCTURE_COMPONENT
/end TYPEDEF_STRUCTURE
/begin TYPEDEF_STRUCTURE PropshaftTqArbnLocals "" 0xC0 SYMBOL_TYPE_LINK "PropshaftTqArbnLocals"
 /begin STRUCTURE_COMPONENT bCptTqReqLimLowerActv _Bool 0 SYMBOL_TYPE_LINK "bCptTqReqLimLowerActv" /end STRUCTURE_COMPONENT
 /begin STRUCTURE_COMPONENT bCptTqReqLimUpperActv _Bool 1 SYMBOL_TYPE_LINK "bCptTqReqLimUpperActv" /end STRUCTURE_COMPONENT
 /begin STRUCTURE_COMPONENT bElecChrgTqAllwd _Bool 2 SYMBOL_TYPE_LINK "bElecChrgTqAllwd" /end STRUCTURE_COMPONENT
 /begin STRUCTURE_COMPONENT bElecMotCptTqReqLimLowrActv _Bool 3 SYMBOL_TYPE_LINK "bElecMotCptTqReqLimLowrActv" /end STRUCTURE_COMPONENT
 /begin STRUCTURE_COMPONENT bElecMotCptTqReqLimUpprActv _Bool 4 SYMBOL_TYPE_LINK "bElecMotCptTqReqLimUpprActv" /end STRUCTURE_COMPONENT
 /begin STRUCTURE_COMPONENT bForcedChrgActv _Bool 5 SYMBOL_TYPE_LINK "bForcedChrgActv" /end STRUCTURE_COMPONENT
 /begin STRUCTURE_COMPONENT bIceIdle _Bool 6 SYMBOL_TYPE_LINK "bIceIdle" /end STRUCTURE_COMPONENT
 /begin STRUCTURE_COMPONENT bInvCtrlStPlaus _Bool 7 SYMBOL_TYPE_LINK "bInvCtrlStPlaus" /end STRUCTURE_COMPONENT
 /begin STRUCTURE_COMPONENT bPropshPumpCtrlFlt _Bool 8 SYMBOL_TYPE_LINK "bPropshPumpCtrlFlt" /end STRUCTURE_COMPONENT
 /begin STRUCTURE_COMPONENT bPropshPumpCtrlIntgtrResetCond _Bool 9 SYMBOL_TYPE_LINK "bPropshPumpCtrlIntgtrResetCond" /end STRUCTURE_COMPONENT
 /begin STRUCTURE_COMPONENT bPropshPumpCtrlRun _Bool 10 SYMBOL_TYPE_LINK "bPropshPumpCtrlRun" /end STRUCTURE_COMPONENT
 /begin STRUCTURE_COMPONENT iceSpdReqV _Bool 11 SYMBOL_TYPE_LINK "iceSpdReqV" /end STRUCTURE_COMPONENT
 /begin STRUCTURE_COMPONENT iceCtrlStReq tCombustionEngineControlState 12 SYMBOL_TYPE_LINK "iceCtrlStReq" /end STRUCTURE_COMPONENT
 /begin STRUCTURE_COMPONENT propshPumpCtrlIntgtrSt tIntegratorState 16 SYMBOL_TYPE_LINK "propshPumpCtrlIntgtrSt" /end STRUCTURE_COMPONENT
 /begin STRUCTURE_COMPONENT invCtrlStReq tInvCtrlMode 20 SYMBOL_TYPE_LINK "invCtrlStReq" /end STRUCTURE_COMPONENT
 /begin STRUCTURE_COMPONENT invSpdCtrlGainSet tInvSpdCtrlGainSet 24 SYMBOL_TYPE_LINK "invSpdCtrlGainSet" /end STRUCTURE_COMPONENT
 /begin STRUCTURE_COMPONENT invSpdCtrlGainSetPrev tInvSpdCtrlGainSet 28 SYMBOL_TYPE_LINK "invSpdCtrlGainSetPrev" /end STRUCTURE_COMPONENT
 /begin STRUCTURE_COMPONENT idleStTimer tMillisecond_U32 32 SYMBOL_TYPE_LINK "idleStTimer" /end STRUCTURE_COMPONENT
 /begin STRUCTURE_COMPONENT invCtrlStPlausTimestamp tMillisecond_U32 36 SYMBOL_TYPE_LINK "invCtrlStPlausTimestamp" /end STRUCTURE_COMPONENT
 /begin STRUCTURE_COMPONENT propshPumpCtrlRunTmr tMillisecond_U32 40 SYMBOL_TYPE_LINK "propshPumpCtrlRunTmr" /end STRUCTURE_COMPONENT
 /begin STRUCTURE_COMPONENT elecMotTqReq tNewtonMetre 44 SYMBOL_TYPE_LINK "elecMotTqReq" /end STRUCTURE_COMPONENT
 /begin STRUCTURE_COMPONENT elecMotTqReqRaw tNewtonMetre 48 SYMBOL_TYPE_LINK "elecMotTqReqRaw" /end STRUCTURE_COMPONENT
 /begin STRUCTURE_COMPONENT iceTqMinSlow tNewtonMetre 52 SYMBOL_TYPE_LINK "iceTqMinSlow" /end STRUCTURE_COMPONENT
 /begin STRUCTURE_COMPONENT iceTqReqFast tNewtonMetre 56 SYMBOL_TYPE_LINK "iceTqReqFast" /end STRUCTURE_COMPONENT
 /begin STRUCTURE_COMPONENT iceTqReqFastRaw tNewtonMetre 60 SYMBOL_TYPE_LINK "iceTqReqFastRaw" /end STRUCTURE_COMPONENT
 /begin STRUCTURE_COMPONENT iceTqReqSlow tNewtonMetre 64 SYMBOL_TYPE_LINK "iceTqReqSlow" /end STRUCTURE_COMPONENT
 /begin STRUCTURE_COMPONENT iceTqReqSlowRaw tNewtonMetre 68 SYMBOL_TYPE_LINK "iceTqReqSlowRaw" /end STRUCTURE_COMPONENT
 /begin STRUCTURE_COMPONENT propshBalTq tNewtonMetre 72 SYMBOL_TYPE_LINK "propshBalTq" /end STRUCTURE_COMPONENT
 /begin STRUCTURE_COMPONENT propshElecMotRegenTq tNewtonMetre 76 SYMBOL_TYPE_LINK "propshElecMotRegenTq" /end STRUCTURE_COMPONENT
 /begin STRUCTURE_COMPONENT propshIceOffThrottleTq tNewtonMetre 80 SYMBOL_TYPE_LINK "propshIceOffThrottleTq" /end STRUCTURE_COMPONENT
 /begin STRUCTURE_COMPONENT propshPumpCtrlTqIntgl tNewtonMetre 84 SYMBOL_TYPE_LINK "propshPumpCtrlTqIntgl" /end STRUCTURE_COMPONENT
 /begin STRUCTURE_COMPONENT propshPumpCtrlTqReq tNewtonMetre 88 SYMBOL_TYPE_LINK "propshPumpCtrlTqReq" /end STRUCTURE_COMPONENT
 /begin STRUCTURE_COMPONENT propshPumpCtrlTqReqLimd tNewtonMetre 92 SYMBOL_TYPE_LINK "propshPumpCtrlTqReqLimd" /end STRUCTURE_COMPONENT
 /begin STRUCTURE_COMPONENT propshRqrdTq tNewtonMetre 96 SYMBOL_TYPE_LINK "propshRqrdTq" /end STRUCTURE_COMPONENT
 /begin STRUCTURE_COMPONENT propshTqAvlFromElecMotMax tNewtonMetre 100 SYMBOL_TYPE_LINK "propshTqAvlFromElecMotMax" /end STRUCTURE_COMPONENT
 /begin STRUCTURE_COMPONENT propshTqAvlFromElecMotMin tNewtonMetre 104 SYMBOL_TYPE_LINK "propshTqAvlFromElecMotMin" /end STRUCTURE_COMPONENT
 /begin STRUCTURE_COMPONENT propshTqDmdChrg tNewtonMetre 108 SYMBOL_TYPE_LINK "propshTqDmdChrg" /end STRUCTURE_COMPONENT
 /begin STRUCTURE_COMPONENT propshTqDmdChrgMaxRampd tNewtonMetre 112 SYMBOL_TYPE_LINK "propshTqDmdChrgMaxRampd" /end STRUCTURE_COMPONENT
 /begin STRUCTURE_COMPONENT propshTqDmdChrgMinRampd tNewtonMetre 116 SYMBOL_TYPE_LINK "propshTqDmdChrgMinRampd" /end STRUCTURE_COMPONENT
 /begin STRUCTURE_COMPONENT propshTqDmdChrgRaw tNewtonMetre 120 SYMBOL_TYPE_LINK "propshTqDmdChrgRaw" /end STRUCTURE_COMPONENT
 /begin STRUCTURE_COMPONENT propshTqDmdForIce tNewtonMetre 124 SYMBOL_TYPE_LINK "propshTqDmdForIce" /end STRUCTURE_COMPONENT
 /begin STRUCTURE_COMPONENT propshTqReqFromElecMotLimd tNewtonMetre 128 SYMBOL_TYPE_LINK "propshTqReqFromElecMotLimd" /end STRUCTURE_COMPONENT
 /begin STRUCTURE_COMPONENT propshTqReqFromElecMotRaw tNewtonMetre 132 SYMBOL_TYPE_LINK "propshTqReqFromElecMotRaw" /end STRUCTURE_COMPONENT
 /begin STRUCTURE_COMPONENT propshTqReqFromIceBase tNewtonMetre 136 SYMBOL_TYPE_LINK "propshTqReqFromIceBase" /end STRUCTURE_COMPONENT
 /begin STRUCTURE_COMPONENT propshTqReqFromIceBaseItp tNewtonMetre 140 SYMBOL_TYPE_LINK "propshTqReqFromIceBaseItp" /end STRUCTURE_COMPONENT
 /begin STRUCTURE_COMPONENT chrgSt tPropshaftChargeState 144 SYMBOL_TYPE_LINK "chrgSt" /end STRUCTURE_COMPONENT
 /begin STRUCTURE_COMPONENT chrgStPrev tPropshaftChargeState 148 SYMBOL_TYPE_LINK "chrgStPrev" /end STRUCTURE_COMPONENT
 /begin STRUCTURE_COMPONENT elecMotTqReqRampedStr RampLimitCtx 152 SYMBOL_TYPE_LINK "elecMotTqReqRampedStr" /end STRUCTURE_COMPONENT
 /begin STRUCTURE_COMPONENT iceTqReqRampedStr RampLimitCtx 160 SYMBOL_TYPE_LINK "iceTqReqRampedStr" /end STRUCTURE_COMPONENT
 /begin STRUCTURE_COMPONENT propshTqDmdChrgRampStr RampLimitCtx 168 SYMBOL_TYPE_LINK "propshTqDmdChrgRampStr" /end STRUCTURE_COMPONENT
 /begin STRUCTURE_COMPONENT propshPumpSpdErr tRevolutionPerMinute 176 SYMBOL_TYPE_LINK "propshPumpSpdErr" /end STRUCTURE_COMPONENT
 /begin STRUCTURE_COMPONENT propshPumpSpdTar tRevolutionPerMinute 180 SYMBOL_TYPE_LINK "propshPumpSpdTar" /end STRUCTURE_COMPONENT
 /begin STRUCTURE_COMPONENT elecMotSpdReq tRevolutionPerMinute_S16 184 SYMBOL_TYPE_LINK "elecMotSpdReq" /end STRUCTURE_COMPONENT
 /begin STRUCTURE_COMPONENT iceSpdReq tRevolutionPerMinute_S16 186 SYMBOL_TYPE_LINK "iceSpdReq" /end STRUCTURE_COMPONENT
 /begin STRUCTURE_COMPONENT iceSpdReqRaw tRevolutionPerMinute_S16 188 SYMBOL_TYPE_LINK "iceSpdReqRaw" /end STRUCTURE_COMPONENT
/end TYPEDEF_STRUCTURE
/begin TYPEDEF_STRUCTURE TracCtrlLocals "" 0x8C SYMBOL_TYPE_LINK "TracCtrlLocals" /begin STRUCTURE_COMPONENT initDone _Bool 0 SYMBOL_TYPE_LINK "initDone" /end STRUCTURE_COMPONENT
 /begin STRUCTURE_COMPONENT tireMaxLgtSlip tFactor 4 MATRIX_DIM 4 SYMBOL_TYPE_LINK "tireMaxLgtSlip" /end STRUCTURE_COMPONENT
 /begin STRUCTURE_COMPONENT tireMaxLgtSlipOffsFrnt tFactor 20 SYMBOL_TYPE_LINK "tireMaxLgtSlipOffsFrnt" /end STRUCTURE_COMPONENT
 /begin STRUCTURE_COMPONENT tireMaxLgtSlipOffsFrntAggsv tFactor 24 SYMBOL_TYPE_LINK "tireMaxLgtSlipOffsFrntAggsv" /end STRUCTURE_COMPONENT
 /begin STRUCTURE_COMPONENT tireMaxLgtSlipOffsFrntSafe tFactor 28 SYMBOL_TYPE_LINK "tireMaxLgtSlipOffsFrntSafe" /end STRUCTURE_COMPONENT
 /begin STRUCTURE_COMPONENT tireMaxLgtSlipOffsRe tFactor 32 SYMBOL_TYPE_LINK "tireMaxLgtSlipOffsRe" /end STRUCTURE_COMPONENT
 /begin STRUCTURE_COMPONENT tireMaxLgtSlipOffsReAggsv tFactor 36 SYMBOL_TYPE_LINK "tireMaxLgtSlipOffsReAggsv" /end STRUCTURE_COMPONENT
 /begin STRUCTURE_COMPONENT tireMaxLgtSlipOffsReSafe tFactor 40 SYMBOL_TYPE_LINK "tireMaxLgtSlipOffsReSafe" /end STRUCTURE_COMPONENT
 /begin STRUCTURE_COMPONENT tracCtrlPropn tFactor 44 SYMBOL_TYPE_LINK "tracCtrlPropn" /end STRUCTURE_COMPONENT
 /begin STRUCTURE_COMPONENT tcSts tFunctionStatus 48 SYMBOL_TYPE_LINK "tcSts" /end STRUCTURE_COMPONENT
 /begin STRUCTURE_COMPONENT tracCtrlWhlTqLimSlipDiff tNewtonMetre 52 MATRIX_DIM 4 SYMBOL_TYPE_LINK "tracCtrlWhlTqLimSlipDiff" /end STRUCTURE_COMPONENT
 /begin STRUCTURE_COMPONENT tracCtrlWhlTqLimSlipAggsvDiff tNewtonMetre 68 MATRIX_DIM 4 SYMBOL_TYPE_LINK "tracCtrlWhlTqLimSlipAggsvDiff" /end STRUCTURE_COMPONENT
 /begin STRUCTURE_COMPONENT tracCtrlWhlTqLimSlipSafeDiff tNewtonMetre 84 MATRIX_DIM 4 SYMBOL_TYPE_LINK "tracCtrlWhlTqLimSlipSafeDiff" /end STRUCTURE_COMPONENT
 /begin STRUCTURE_COMPONENT cenCluTqLimAbs tNewtonMetre 100 SYMBOL_TYPE_LINK "cenCluTqLimAbs" /end STRUCTURE_COMPONENT
 /begin STRUCTURE_COMPONENT whlTqLimAbs tNewtonMetre 104 MATRIX_DIM 4 SYMBOL_TYPE_LINK "whlTqLimAbs" /end STRUCTURE_COMPONENT
 /begin STRUCTURE_COMPONENT whlTqLimAbsFast tNewtonMetre 120 MATRIX_DIM 4 SYMBOL_TYPE_LINK "whlTqLimAbsFast" /end STRUCTURE_COMPONENT
 /begin STRUCTURE_COMPONENT whlCluSlipCnt uint8_t 136 MATRIX_DIM 4 SYMBOL_TYPE_LINK "whlCluSlipCnt" /end STRUCTURE_COMPONENT
/end TYPEDEF_STRUCTURE
/begin TYPEDEF_STRUCTURE TqStMacLocals "" 0xAC SYMBOL_TYPE_LINK "TqStMacLocals" /begin STRUCTURE_COMPONENT initDone _Bool 0 SYMBOL_TYPE_LINK "initDone" /end STRUCTURE_COMPONENT
 /begin STRUCTURE_COMPONENT bCrkStFaultInhibit _Bool 1 SYMBOL_TYPE_LINK "bCrkStFaultInhibit" /end STRUCTURE_COMPONENT
 /begin STRUCTURE_COMPONENT bForceTqOff _Bool 2 SYMBOL_TYPE_LINK "bForceTqOff" /end STRUCTURE_COMPONENT
 /begin STRUCTURE_COMPONENT bFrontAxleClosedFault _Bool 3 SYMBOL_TYPE_LINK "bFrontAxleClosedFault" /end STRUCTURE_COMPONENT
 /begin STRUCTURE_COMPONENT bFrontAxleOpenFault _Bool 4 SYMBOL_TYPE_LINK "bFrontAxleOpenFault" /end STRUCTURE_COMPONENT
 /begin STRUCTURE_COMPONENT bFrontAxleOpenFaultPrev _Bool 5 SYMBOL_TYPE_LINK "bFrontAxleOpenFaultPrev" /end STRUCTURE_COMPONENT
 /begin STRUCTURE_COMPONENT bPrelCluTqActive _Bool 6 SYMBOL_TYPE_LINK "bPrelCluTqActive" /end STRUCTURE_COMPONENT
 /begin STRUCTURE_COMPONENT bPrelWhlCluReqElec _Bool 7 SYMBOL_TYPE_LINK "bPrelWhlCluReqElec" /end STRUCTURE_COMPONENT
 /begin STRUCTURE_COMPONENT bPrelWhlCluReqHybrid _Bool 8 SYMBOL_TYPE_LINK "bPrelWhlCluReqHybrid" /end STRUCTURE_COMPONENT
 /begin STRUCTURE_COMPONENT bPropshIdleRateAllowed _Bool 9 SYMBOL_TYPE_LINK "bPropshIdleRateAllowed" /end STRUCTURE_COMPONENT
 /begin STRUCTURE_COMPONENT bRearAxleClosedFault _Bool 10 SYMBOL_TYPE_LINK "bRearAxleClosedFault" /end STRUCTURE_COMPONENT
 /begin STRUCTURE_COMPONENT bRearAxleOpenFault _Bool 11 SYMBOL_TYPE_LINK "bRearAxleOpenFault" /end STRUCTURE_COMPONENT
 /begin STRUCTURE_COMPONENT bRearAxleOpenFaultPrev _Bool 12 SYMBOL_TYPE_LINK "bRearAxleOpenFaultPrev" /end STRUCTURE_COMPONENT
 /begin STRUCTURE_COMPONENT bTempOilCold _Bool 13 SYMBOL_TYPE_LINK "bTempOilCold" /end STRUCTURE_COMPONENT
 /begin STRUCTURE_COMPONENT bTempOilColdDeb _Bool 14 SYMBOL_TYPE_LINK "bTempOilColdDeb" /end STRUCTURE_COMPONENT
 /begin STRUCTURE_COMPONENT bTransitionWatchdog _Bool 15 SYMBOL_TYPE_LINK "bTransitionWatchdog" /end STRUCTURE_COMPONENT
 /begin STRUCTURE_COMPONENT bTrsmTakeoffReq _Bool 16 SYMBOL_TYPE_LINK "bTrsmTakeoffReq" /end STRUCTURE_COMPONENT
 /begin STRUCTURE_COMPONENT bWhlTqReqAllowed _Bool 17 SYMBOL_TYPE_LINK "bWhlTqReqAllowed" /end STRUCTURE_COMPONENT
 /begin STRUCTURE_COMPONENT tempOilColdDebCtx FilDeb_U 20 SYMBOL_TYPE_LINK "tempOilColdDebCtx" /end STRUCTURE_COMPONENT
 /begin STRUCTURE_COMPONENT axleSysSt tAxleSystemState 36 SYMBOL_TYPE_LINK "axleSysSt" /end STRUCTURE_COMPONENT
 /begin STRUCTURE_COMPONENT cenCluStTsm tClutchState 40 SYMBOL_TYPE_LINK "cenCluStTsm" /end STRUCTURE_COMPONENT
 /begin STRUCTURE_COMPONENT whlCluStTsm tClutchState 44 MATRIX_DIM 4 SYMBOL_TYPE_LINK "whlCluStTsm" /end STRUCTURE_COMPONENT
 /begin STRUCTURE_COMPONENT drvCfg tDriveConfiguration 60 SYMBOL_TYPE_LINK "drvCfg" /end STRUCTURE_COMPONENT
 /begin STRUCTURE_COMPONENT forcedDrvCfg tDriveConfiguration 64 SYMBOL_TYPE_LINK "forcedDrvCfg" /end STRUCTURE_COMPONENT
 /begin STRUCTURE_COMPONENT fricBrkTqArbnSt tFrictionBrakeTorqueArbitrationMode 68 SYMBOL_TYPE_LINK "fricBrkTqArbnSt" /end STRUCTURE_COMPONENT
 /begin STRUCTURE_COMPONENT gearReq tGear 72 SYMBOL_TYPE_LINK "gearReq" /end STRUCTURE_COMPONENT
 /begin STRUCTURE_COMPONENT gearStatyCrkReq tGear 76 SYMBOL_TYPE_LINK "gearStatyCrkReq" /end STRUCTURE_COMPONENT
 /begin STRUCTURE_COMPONENT crkStFaultTmr tMillisecond_U32 80 SYMBOL_TYPE_LINK "crkStFaultTmr" /end STRUCTURE_COMPONENT
 /begin STRUCTURE_COMPONENT elecMotChrgTqDmd tNewtonMetre 84 SYMBOL_TYPE_LINK "elecMotChrgTqDmd" /end STRUCTURE_COMPONENT
 /begin STRUCTURE_COMPONENT iceTqMaxFast tNewtonMetre 88 SYMBOL_TYPE_LINK "iceTqMaxFast" /end STRUCTURE_COMPONENT
 /begin STRUCTURE_COMPONENT iceTqMaxSlow tNewtonMetre 92 SYMBOL_TYPE_LINK "iceTqMaxSlow" /end STRUCTURE_COMPONENT
 /begin STRUCTURE_COMPONENT iceTqMin tNewtonMetre 96 SYMBOL_TYPE_LINK "iceTqMin" /end STRUCTURE_COMPONENT
 /begin STRUCTURE_COMPONENT whlTqBrkMaxTsm tNewtonMetre 100 MATRIX_DIM 4 SYMBOL_TYPE_LINK "whlTqBrkMaxTsm" /end STRUCTURE_COMPONENT
 /begin STRUCTURE_COMPONENT whlTqBrkMinTsm tNewtonMetre 116 MATRIX_DIM 4 SYMBOL_TYPE_LINK "whlTqBrkMinTsm" /end STRUCTURE_COMPONENT
 /begin STRUCTURE_COMPONENT prplMod tPropulsionMode 132 SYMBOL_TYPE_LINK "prplMod" /end STRUCTURE_COMPONENT
 /begin STRUCTURE_COMPONENT propshSpdMax tRevolutionPerMinute_S16 136 SYMBOL_TYPE_LINK "propshSpdMax" /end STRUCTURE_COMPONENT
 /begin STRUCTURE_COMPONENT tqSysSt tTorqueSystemState 140 SYMBOL_TYPE_LINK "tqSysSt" /end STRUCTURE_COMPONENT
 /begin STRUCTURE_COMPONENT tqSt tTqMacSt 144 SYMBOL_TYPE_LINK "tqSt" /end STRUCTURE_COMPONENT
 /begin STRUCTURE_COMPONENT tqStatePrevious tTqMacSt 148 SYMBOL_TYPE_LINK "tqStatePrevious" /end STRUCTURE_COMPONENT
 /begin STRUCTURE_COMPONENT elecTurtleMask TsmElecTurtleMask 152 SYMBOL_TYPE_LINK "elecTurtleMask" /end STRUCTURE_COMPONENT
 /begin STRUCTURE_COMPONENT iceTurtleMask TsmIceTurtleMask 156 SYMBOL_TYPE_LINK "iceTurtleMask" /end STRUCTURE_COMPONENT
 /begin STRUCTURE_COMPONENT tsmLimpMask TsmLimpMask 160 SYMBOL_TYPE_LINK "tsmLimpMask" /end STRUCTURE_COMPONENT
 /begin STRUCTURE_COMPONENT ptCriticalFault TsmPtCriticalFault 164 SYMBOL_TYPE_LINK "ptCriticalFault" /end STRUCTURE_COMPONENT
 /begin STRUCTURE_COMPONENT tqOffMask TsmTqOffMask 168 SYMBOL_TYPE_LINK "tqOffMask" /end STRUCTURE_COMPONENT
/end TYPEDEF_STRUCTURE
/begin TYPEDEF_STRUCTURE RhcStrategyWorkspace "" 0x40 SYMBOL_TYPE_LINK "RhcStrategyWorkspace" /begin STRUCTURE_COMPONENT inhibitMovement _Bool 0 SYMBOL_TYPE_LINK "inhibitMovement" /end STRUCTURE_COMPONENT /begin STRUCTURE_COMPONENT liftCommand _Bool 1 SYMBOL_TYPE_LINK "liftCommand" /end STRUCTURE_COMPONENT
 /begin STRUCTURE_COMPONENT timeoutWarningRequest _Bool 2 SYMBOL_TYPE_LINK "timeoutWarningRequest" /end STRUCTURE_COMPONENT
 /begin STRUCTURE_COMPONENT vehicleSpeed tKilometrePerHour_S16 4 SYMBOL_TYPE_LINK "vehicleSpeed" /end STRUCTURE_COMPONENT
 /begin STRUCTURE_COMPONENT userIndication tLiftIndication 8 SYMBOL_TYPE_LINK "userIndication" /end STRUCTURE_COMPONENT
 /begin STRUCTURE_COMPONENT liftStatus LiftStatus 12 SYMBOL_TYPE_LINK "liftStatus" /end STRUCTURE_COMPONENT
 /begin STRUCTURE_COMPONENT imuLatAccFilt tMetrePerSquareSecond 32 SYMBOL_TYPE_LINK "imuLatAccFilt" /end STRUCTURE_COMPONENT
 /begin STRUCTURE_COMPONENT perfMod tPerformanceModeRHC 36 SYMBOL_TYPE_LINK "perfMod" /end STRUCTURE_COMPONENT
 /begin STRUCTURE_COMPONENT rideHeiRollCompSt tRideHeightRollCompensationState 40 SYMBOL_TYPE_LINK "rideHeiRollCompSt" /end STRUCTURE_COMPONENT
 /begin STRUCTURE_COMPONENT suppgMod tSupportingMode 44 SYMBOL_TYPE_LINK "suppgMod" /end STRUCTURE_COMPONENT
 /begin STRUCTURE_COMPONENT deltaRideHeiBaseReq LiftCylinderPositions 48 SYMBOL_TYPE_LINK "deltaRideHeiBaseReq" /end STRUCTURE_COMPONENT
 /begin STRUCTURE_COMPONENT deltaRideHeiRollCompReq LiftCylinderPositions 56 SYMBOL_TYPE_LINK "deltaRideHeiRollCompReq" /end STRUCTURE_COMPONENT
/end TYPEDEF_STRUCTURE
/begin TYPEDEF_STRUCTURE PrelCluReqLocals "" 0x24 SYMBOL_TYPE_LINK "PrelCluReqLocals"
 /begin STRUCTURE_COMPONENT whlCluTqPrelReqAbslt tNewtonMetre 0 MATRIX_DIM 4 SYMBOL_TYPE_LINK "whlCluTqPrelReqAbslt" /end STRUCTURE_COMPONENT
 /begin STRUCTURE_COMPONENT whlCluStPrelReq tClutchState 16 MATRIX_DIM 4 SYMBOL_TYPE_LINK "whlCluStPrelReq" /end STRUCTURE_COMPONENT
 /begin STRUCTURE_COMPONENT prelCluReqSt tPrelCluReqSt 32 SYMBOL_TYPE_LINK "prelCluReqSt" /end STRUCTURE_COMPONENT
/end TYPEDEF_STRUCTURE
/begin TYPEDEF_STRUCTURE TdfdVar "" 0x24 SYMBOL_TYPE_LINK "TdfdVar"
 /begin STRUCTURE_COMPONENT normalizedCutoffFreq _float 0 SYMBOL_TYPE_LINK "normalizedCutoffFreq" /end STRUCTURE_COMPONENT
 /begin STRUCTURE_COMPONENT timestep _float 4 SYMBOL_TYPE_LINK "timestep" /end STRUCTURE_COMPONENT
 /begin STRUCTURE_COMPONENT outerFactor _float 8 SYMBOL_TYPE_LINK "outerFactor" /end STRUCTURE_COMPONENT
 /begin STRUCTURE_COMPONENT outputFactor1 _float 12 SYMBOL_TYPE_LINK "outputFactor1" /end STRUCTURE_COMPONENT
 /begin STRUCTURE_COMPONENT outputFactor2 _float 16 SYMBOL_TYPE_LINK "outputFactor2" /end STRUCTURE_COMPONENT
 /begin STRUCTURE_COMPONENT inputPrevious1 _float 20 SYMBOL_TYPE_LINK "inputPrevious1" /end STRUCTURE_COMPONENT
 /begin STRUCTURE_COMPONENT outputPrevious1 _float 24 SYMBOL_TYPE_LINK "outputPrevious1" /end STRUCTURE_COMPONENT
 /begin STRUCTURE_COMPONENT outputPrevious2 _float 28 SYMBOL_TYPE_LINK "outputPrevious2" /end STRUCTURE_COMPONENT
 /begin STRUCTURE_COMPONENT bInitiated _Bool 32 SYMBOL_TYPE_LINK "bInitiated" /end STRUCTURE_COMPONENT
/end TYPEDEF_STRUCTURE
/begin TYPEDEF_STRUCTURE WhlCluTEstimnLocals "" 0x38 SYMBOL_TYPE_LINK "WhlCluTEstimnLocals"
 /begin STRUCTURE_COMPONENT steelDiscEgy tJoule 0 MATRIX_DIM 4 SYMBOL_TYPE_LINK "steelDiscEgy" /end STRUCTURE_COMPONENT
 /begin STRUCTURE_COMPONENT cluDiscEgy tJoule 16 MATRIX_DIM 4 SYMBOL_TYPE_LINK "cluDiscEgy" /end STRUCTURE_COMPONENT
 /begin STRUCTURE_COMPONENT cluSteelDiscT tCelsius_10_S16 32 MATRIX_DIM 4 SYMBOL_TYPE_LINK "cluSteelDiscT" /end STRUCTURE_COMPONENT
 /begin STRUCTURE_COMPONENT lstRunStamp tMillisecond_U32 40 SYMBOL_TYPE_LINK "lstRunStamp" /end STRUCTURE_COMPONENT
 /begin STRUCTURE_COMPONENT peakStamp tMillisecond_U32 44 SYMBOL_TYPE_LINK "peakStamp" /end STRUCTURE_COMPONENT
 /begin STRUCTURE_COMPONENT hottestClu tCluIdx 48 SYMBOL_TYPE_LINK "hottestClu" /end STRUCTURE_COMPONENT
 /begin STRUCTURE_COMPONENT hottestCluT tCelsius_10_S16 52 SYMBOL_TYPE_LINK "hottestCluT" /end STRUCTURE_COMPONENT
/end TYPEDEF_STRUCTURE
/begin TYPEDEF_STRUCTURE O1Butter "" 0x18 SYMBOL_TYPE_LINK "O1Butter"
 /begin STRUCTURE_COMPONENT normalizedCutoffFreq _float 0 SYMBOL_TYPE_LINK "normalizedCutoffFreq" /end STRUCTURE_COMPONENT
 /begin STRUCTURE_COMPONENT outerFactor _float 4 SYMBOL_TYPE_LINK "outerFactor" /end STRUCTURE_COMPONENT
 /begin STRUCTURE_COMPONENT outputFactor _float 8 SYMBOL_TYPE_LINK "outputFactor" /end STRUCTURE_COMPONENT
 /begin STRUCTURE_COMPONENT inputPrevious _float 12 SYMBOL_TYPE_LINK "inputPrevious" /end STRUCTURE_COMPONENT
 /begin STRUCTURE_COMPONENT outputPrevious _float 16 SYMBOL_TYPE_LINK "outputPrevious" /end STRUCTURE_COMPONENT
 /begin STRUCTURE_COMPONENT bInitiated _Bool 20 SYMBOL_TYPE_LINK "bInitiated" /end STRUCTURE_COMPONENT
/end TYPEDEF_STRUCTURE
/begin TYPEDEF_STRUCTURE RideHeightCtrlrLocals "" 0xAC SYMBOL_TYPE_LINK "RideHeightCtrlrLocals"
 /begin STRUCTURE_COMPONENT liftStrategy tRideHeightControlStrategy 0 SYMBOL_TYPE_LINK "liftStrategy" /end STRUCTURE_COMPONENT
 /begin STRUCTURE_COMPONENT liftCylBaseReq tMillimetre_10_S16 4 MATRIX_DIM 4 SYMBOL_TYPE_LINK "liftCylBaseReq" /end STRUCTURE_COMPONENT
 /begin STRUCTURE_COMPONENT liftCylRollCompReq tMillimetre_10_S16 12 MATRIX_DIM 4 SYMBOL_TYPE_LINK "liftCylRollCompReq" /end STRUCTURE_COMPONENT
 /begin STRUCTURE_COMPONENT mtnRat tFactor 20 MATRIX_DIM 4 SYMBOL_TYPE_LINK "mtnRat" /end STRUCTURE_COMPONENT
 /begin STRUCTURE_COMPONENT liftTargets tMillimetre_10_S16 36 MATRIX_DIM 4 SYMBOL_TYPE_LINK "liftTargets" /end STRUCTURE_COMPONENT
 /begin STRUCTURE_COMPONENT liftCommand tLiftMovement 44 MATRIX_DIM 4 SYMBOL_TYPE_LINK "liftCommand" /end STRUCTURE_COMPONENT
 /begin STRUCTURE_COMPONENT lastHandlerExecution tMillisecond_U32 60 SYMBOL_TYPE_LINK "lastHandlerExecution" /end STRUCTURE_COMPONENT
 /begin STRUCTURE_COMPONENT liftCylinderWorkspaces CylinderMovementWorkspace 64 MATRIX_DIM 4 SYMBOL_TYPE_LINK "liftCylinderWorkspaces" /end STRUCTURE_COMPONENT
 /begin STRUCTURE_COMPONENT liftAtPosn _Bool 160 MATRIX_DIM 4 SYMBOL_TYPE_LINK "liftAtPosn" /end STRUCTURE_COMPONENT
 /begin STRUCTURE_COMPONENT rideCtrlErrStruct RideHeightControlErrorStruct 164 SYMBOL_TYPE_LINK "rideCtrlErrStruct" /end STRUCTURE_COMPONENT
 /begin STRUCTURE_COMPONENT refreshRideCtrl _Bool 166 SYMBOL_TYPE_LINK "refreshRideCtrl" /end STRUCTURE_COMPONENT
/end TYPEDEF_STRUCTURE
/begin TYPEDEF_STRUCTURE PropshaftStationaryCrankStateFault "" 0x8 SYMBOL_TYPE_LINK "PropshaftStationaryCrankStateFault"
 /begin STRUCTURE_COMPONENT statyCrkFltMask uint64_t 0 SYMBOL_TYPE_LINK "statyCrkFltMask" /end STRUCTURE_COMPONENT
 /begin STRUCTURE_COMPONENT statyCrkFltFlg StatyCrkFltFlg 0 SYMBOL_TYPE_LINK "statyCrkFltFlg" /end STRUCTURE_COMPONENT
/end TYPEDEF_STRUCTURE
/begin TYPEDEF_STRUCTURE NetworkBus "" 0x2C SYMBOL_TYPE_LINK "NetworkBus" /begin STRUCTURE_COMPONENT request tNmRequest 0 SYMBOL_TYPE_LINK "request" /end STRUCTURE_COMPONENT
 /begin STRUCTURE_COMPONENT previousRequest tNmRequest 4 SYMBOL_TYPE_LINK "previousRequest" /end STRUCTURE_COMPONENT
 /begin STRUCTURE_COMPONENT numberOfAttempts uint32_t 8 SYMBOL_TYPE_LINK "numberOfAttempts" /end STRUCTURE_COMPONENT
 /begin STRUCTURE_COMPONENT node NetworkNode 12 MATRIX_DIM 2 SYMBOL_TYPE_LINK "node" /end STRUCTURE_COMPONENT
/end TYPEDEF_STRUCTURE
/begin TYPEDEF_STRUCTURE TVVehicleParams "" 0x2C SYMBOL_TYPE_LINK "TVVehicleParams" /begin STRUCTURE_COMPONENT a _float 0 SYMBOL_TYPE_LINK "a" /end STRUCTURE_COMPONENT /begin STRUCTURE_COMPONENT b _float 4 SYMBOL_TYPE_LINK "b" /end STRUCTURE_COMPONENT /begin STRUCTURE_COMPONENT J _float 8 SYMBOL_TYPE_LINK "J" /end STRUCTURE_COMPONENT /begin STRUCTURE_COMPONENT hLoadTransfer _float 12 SYMBOL_TYPE_LINK "hLoadTransfer" /end STRUCTURE_COMPONENT /begin STRUCTURE_COMPONENT trackWidthF _float 16 SYMBOL_TYPE_LINK "trackWidthF" /end STRUCTURE_COMPONENT /begin STRUCTURE_COMPONENT trackWidthR _float 20 SYMBOL_TYPE_LINK "trackWidthR" /end STRUCTURE_COMPONENT
 /begin STRUCTURE_COMPONENT vertLoadDownforceFCoeff _float 24 SYMBOL_TYPE_LINK "vertLoadDownforceFCoeff" /end STRUCTURE_COMPONENT
 /begin STRUCTURE_COMPONENT vertLoadDownforceRCoeff _float 28 SYMBOL_TYPE_LINK "vertLoadDownforceRCoeff" /end STRUCTURE_COMPONENT
 /begin STRUCTURE_COMPONENT nomVertLoadF _float 32 SYMBOL_TYPE_LINK "nomVertLoadF" /end STRUCTURE_COMPONENT
 /begin STRUCTURE_COMPONENT nomVertLoadR _float 36 SYMBOL_TYPE_LINK "nomVertLoadR" /end STRUCTURE_COMPONENT
 /begin STRUCTURE_COMPONENT m _float 40 SYMBOL_TYPE_LINK "m" /end STRUCTURE_COMPONENT
/end TYPEDEF_STRUCTURE
/begin TYPEDEF_STRUCTURE FaultCodeFlags "" 0x4 SYMBOL_TYPE_LINK "FaultCodeFlags"
 /begin STRUCTURE_COMPONENT batteryVoltage uint32_t_0x80000000 0 SYMBOL_TYPE_LINK "batteryVoltage" /end STRUCTURE_COMPONENT
 /begin STRUCTURE_COMPONENT overPower uint32_t_0x40000000 0 SYMBOL_TYPE_LINK "overPower" /end STRUCTURE_COMPONENT
 /begin STRUCTURE_COMPONENT overCurrent uint32_t_0x20000000 0 SYMBOL_TYPE_LINK "overCurrent" /end STRUCTURE_COMPONENT
 /begin STRUCTURE_COMPONENT overTemperature uint32_t_0x10000000 0 SYMBOL_TYPE_LINK "overTemperature" /end STRUCTURE_COMPONENT
 /begin STRUCTURE_COMPONENT canWatchdog uint32_t_0x8000000 0 SYMBOL_TYPE_LINK "canWatchdog" /end STRUCTURE_COMPONENT
 /begin STRUCTURE_COMPONENT canCollision uint32_t_0x4000000 0 SYMBOL_TYPE_LINK "canCollision" /end STRUCTURE_COMPONENT
 /begin STRUCTURE_COMPONENT motorStall uint32_t_0x2000000 0 SYMBOL_TYPE_LINK "motorStall" /end STRUCTURE_COMPONENT
 /begin STRUCTURE_COMPONENT anyFault uint32_t_0x1000000 0 SYMBOL_TYPE_LINK "anyFault" /end STRUCTURE_COMPONENT
/end TYPEDEF_STRUCTURE
/begin TYPEDEF_STRUCTURE LiftCmd "" 0x10 SYMBOL_TYPE_LINK "LiftCmd" /begin STRUCTURE_COMPONENT cmd tLiftMovement 0 MATRIX_DIM 4 SYMBOL_TYPE_LINK "cmd" /end STRUCTURE_COMPONENT /end TYPEDEF_STRUCTURE
/begin TYPEDEF_STRUCTURE LiftStatus "" 0x11 SYMBOL_TYPE_LINK "LiftStatus" /begin STRUCTURE_COMPONENT flUp _Bool 0 SYMBOL_TYPE_LINK "flUp" /end STRUCTURE_COMPONENT /begin STRUCTURE_COMPONENT flDown _Bool 1 SYMBOL_TYPE_LINK "flDown" /end STRUCTURE_COMPONENT /begin STRUCTURE_COMPONENT flExceededUp _Bool 2 SYMBOL_TYPE_LINK "flExceededUp" /end STRUCTURE_COMPONENT /begin STRUCTURE_COMPONENT frUp _Bool 3 SYMBOL_TYPE_LINK "frUp" /end STRUCTURE_COMPONENT /begin STRUCTURE_COMPONENT frDown _Bool 4 SYMBOL_TYPE_LINK "frDown" /end STRUCTURE_COMPONENT /begin STRUCTURE_COMPONENT frExceededUp _Bool 5 SYMBOL_TYPE_LINK "frExceededUp" /end STRUCTURE_COMPONENT /begin STRUCTURE_COMPONENT rlUp _Bool 6 SYMBOL_TYPE_LINK "rlUp" /end STRUCTURE_COMPONENT /begin STRUCTURE_COMPONENT rlDown _Bool 7 SYMBOL_TYPE_LINK "rlDown" /end STRUCTURE_COMPONENT /begin STRUCTURE_COMPONENT rlExceededUp _Bool 8 SYMBOL_TYPE_LINK "rlExceededUp" /end STRUCTURE_COMPONENT /begin STRUCTURE_COMPONENT rrUp _Bool 9 SYMBOL_TYPE_LINK "rrUp" /end STRUCTURE_COMPONENT /begin STRUCTURE_COMPONENT rrDown _Bool 10 SYMBOL_TYPE_LINK "rrDown" /end STRUCTURE_COMPONENT /begin STRUCTURE_COMPONENT rrExceededUp _Bool 11 SYMBOL_TYPE_LINK "rrExceededUp" /end STRUCTURE_COMPONENT /begin STRUCTURE_COMPONENT oneExceededUp _Bool 12 SYMBOL_TYPE_LINK "oneExceededUp" /end STRUCTURE_COMPONENT /begin STRUCTURE_COMPONENT anyUp _Bool 13 SYMBOL_TYPE_LINK "anyUp" /end STRUCTURE_COMPONENT /begin STRUCTURE_COMPONENT allUp _Bool 14 SYMBOL_TYPE_LINK "allUp" /end STRUCTURE_COMPONENT /begin STRUCTURE_COMPONENT allDown _Bool 15 SYMBOL_TYPE_LINK "allDown" /end STRUCTURE_COMPONENT /begin STRUCTURE_COMPONENT allAtPosition _Bool 16 SYMBOL_TYPE_LINK "allAtPosition" /end STRUCTURE_COMPONENT /end TYPEDEF_STRUCTURE
/begin TYPEDEF_STRUCTURE PropshaftDrivingCrankStateFault "" 0x8 SYMBOL_TYPE_LINK "PropshaftDrivingCrankStateFault"
 /begin STRUCTURE_COMPONENT drvgCrkFltMask uint64_t 0 SYMBOL_TYPE_LINK "drvgCrkFltMask" /end STRUCTURE_COMPONENT
 /begin STRUCTURE_COMPONENT drvgCrkFltFlg DrvgCrkFltFlg 0 SYMBOL_TYPE_LINK "drvgCrkFltFlg" /end STRUCTURE_COMPONENT
/end TYPEDEF_STRUCTURE
/begin TYPEDEF_STRUCTURE InverterFault1 "" 0x8 SYMBOL_TYPE_LINK "InverterFault1" /begin STRUCTURE_COMPONENT all uint64_t 0 SYMBOL_TYPE_LINK "all" /end STRUCTURE_COMPONENT /begin STRUCTURE_COMPONENT bit InverterFault1Bit 0 SYMBOL_TYPE_LINK "bit" /end STRUCTURE_COMPONENT /end TYPEDEF_STRUCTURE
/begin TYPEDEF_STRUCTURE FilDeb_U "" 0x10 SYMBOL_TYPE_LINK "FilDeb_U" /begin STRUCTURE_COMPONENT debCntrThd size_t 0 SYMBOL_TYPE_LINK "debCntrThd" /end STRUCTURE_COMPONENT /begin STRUCTURE_COMPONENT samplePrev unsigned_int 4 SYMBOL_TYPE_LINK "samplePrev" /end STRUCTURE_COMPONENT /begin STRUCTURE_COMPONENT sampleStabCntr size_t 8 SYMBOL_TYPE_LINK "sampleStabCntr" /end STRUCTURE_COMPONENT
 /begin STRUCTURE_COMPONENT sampleStabPrev unsigned_int 12 SYMBOL_TYPE_LINK "sampleStabPrev" /end STRUCTURE_COMPONENT
/end TYPEDEF_STRUCTURE
/begin TYPEDEF_STRUCTURE StatyCrkFltFlg "" 0x8 SYMBOL_TYPE_LINK "StatyCrkFltFlg"
 /begin STRUCTURE_COMPONENT _bit_fill_ uint64_t_0x8000000000000000 0 SYMBOL_TYPE_LINK "_bit_fill_" /end STRUCTURE_COMPONENT
 /begin STRUCTURE_COMPONENT initCTestPause uint64_t_0x4000000000000000 0 SYMBOL_TYPE_LINK "initCTestPause" /end STRUCTURE_COMPONENT
 /begin STRUCTURE_COMPONENT initCenCluSt uint64_t_0x2000000000000000 0 SYMBOL_TYPE_LINK "initCenCluSt" /end STRUCTURE_COMPONENT
 /begin STRUCTURE_COMPONENT initElSysSt uint64_t_0x1000000000000000 0 SYMBOL_TYPE_LINK "initElSysSt" /end STRUCTURE_COMPONENT
 /begin STRUCTURE_COMPONENT initIceCtrlSt uint64_t_0x800000000000000 0 SYMBOL_TYPE_LINK "initIceCtrlSt" /end STRUCTURE_COMPONENT
 /begin STRUCTURE_COMPONENT initWhlCluStFL uint64_t_0x400000000000000 0 SYMBOL_TYPE_LINK "initWhlCluStFL" /end STRUCTURE_COMPONENT
 /begin STRUCTURE_COMPONENT initWhlCluStFR uint64_t_0x200000000000000 0 SYMBOL_TYPE_LINK "initWhlCluStFR" /end STRUCTURE_COMPONENT
 /begin STRUCTURE_COMPONENT initWhlCluStRL uint64_t_0x100000000000000 0 SYMBOL_TYPE_LINK "initWhlCluStRL" /end STRUCTURE_COMPONENT
 /begin STRUCTURE_COMPONENT initWhlCluStRR uint64_t_0x80000000000000 0 SYMBOL_TYPE_LINK "initWhlCluStRR" /end STRUCTURE_COMPONENT
 /begin STRUCTURE_COMPONENT initLsttCrkSt uint64_t_0x40000000000000 0 SYMBOL_TYPE_LINK "initLsttCrkSt" /end STRUCTURE_COMPONENT
 /begin STRUCTURE_COMPONENT initTimeout uint64_t_0x20000000000000 0 SYMBOL_TYPE_LINK "initTimeout" /end STRUCTURE_COMPONENT
 /begin STRUCTURE_COMPONENT coupleTimeout uint64_t_0x10000000000000 0 SYMBOL_TYPE_LINK "coupleTimeout" /end STRUCTURE_COMPONENT
 /begin STRUCTURE_COMPONENT coupleLsttCrkStFlt uint64_t_0x8000000000000 0 SYMBOL_TYPE_LINK "coupleLsttCrkStFlt" /end STRUCTURE_COMPONENT
 /begin STRUCTURE_COMPONENT coupleVehRollgSt uint64_t_0x4000000000000 0 SYMBOL_TYPE_LINK "coupleVehRollgSt" /end STRUCTURE_COMPONENT
 /begin STRUCTURE_COMPONENT coupleElSysSt uint64_t_0x2000000000000 0 SYMBOL_TYPE_LINK "coupleElSysSt" /end STRUCTURE_COMPONENT
 /begin STRUCTURE_COMPONENT coupleIceCtrlSt uint64_t_0x1000000000000 0 SYMBOL_TYPE_LINK "coupleIceCtrlSt" /end STRUCTURE_COMPONENT
 /begin STRUCTURE_COMPONENT coupleWhlCluStFL uint64_t_0x800000000000 0 SYMBOL_TYPE_LINK "coupleWhlCluStFL" /end STRUCTURE_COMPONENT
 /begin STRUCTURE_COMPONENT coupleWhlCluStFR uint64_t_0x400000000000 0 SYMBOL_TYPE_LINK "coupleWhlCluStFR" /end STRUCTURE_COMPONENT
 /begin STRUCTURE_COMPONENT coupleWhlCluStRL uint64_t_0x200000000000 0 SYMBOL_TYPE_LINK "coupleWhlCluStRL" /end STRUCTURE_COMPONENT
 /begin STRUCTURE_COMPONENT coupleWhlCluStRR uint64_t_0x100000000000 0 SYMBOL_TYPE_LINK "coupleWhlCluStRR" /end STRUCTURE_COMPONENT
 /begin STRUCTURE_COMPONENT coupleCTestPause uint64_t_0x80000000000 0 SYMBOL_TYPE_LINK "coupleCTestPause" /end STRUCTURE_COMPONENT
 /begin STRUCTURE_COMPONENT coupleCenCluSt uint64_t_0x40000000000 0 SYMBOL_TYPE_LINK "coupleCenCluSt" /end STRUCTURE_COMPONENT
 /begin STRUCTURE_COMPONENT coupleLsttCrkStCouple uint64_t_0x20000000000 0 SYMBOL_TYPE_LINK "coupleLsttCrkStCouple" /end STRUCTURE_COMPONENT
 /begin STRUCTURE_COMPONENT coupleGear uint64_t_0x10000000000 0 SYMBOL_TYPE_LINK "coupleGear" /end STRUCTURE_COMPONENT
 /begin STRUCTURE_COMPONENT syncTimeout uint64_t_0x8000000000 0 SYMBOL_TYPE_LINK "syncTimeout" /end STRUCTURE_COMPONENT
 /begin STRUCTURE_COMPONENT syncLsttCrkStFlt uint64_t_0x4000000000 0 SYMBOL_TYPE_LINK "syncLsttCrkStFlt" /end STRUCTURE_COMPONENT
 /begin STRUCTURE_COMPONENT syncVehRollgSt uint64_t_0x2000000000 0 SYMBOL_TYPE_LINK "syncVehRollgSt" /end STRUCTURE_COMPONENT
 /begin STRUCTURE_COMPONENT syncElSysSt uint64_t_0x1000000000 0 SYMBOL_TYPE_LINK "syncElSysSt" /end STRUCTURE_COMPONENT
 /begin STRUCTURE_COMPONENT syncIceCtrlSt uint64_t_0x800000000 0 SYMBOL_TYPE_LINK "syncIceCtrlSt" /end STRUCTURE_COMPONENT
 /begin STRUCTURE_COMPONENT syncWhlCluStFL uint64_t_0x400000000 0 SYMBOL_TYPE_LINK "syncWhlCluStFL" /end STRUCTURE_COMPONENT
 /begin STRUCTURE_COMPONENT syncWhlCluStFR uint64_t_0x200000000 0 SYMBOL_TYPE_LINK "syncWhlCluStFR" /end STRUCTURE_COMPONENT
 /begin STRUCTURE_COMPONENT syncWhlCluStRL uint64_t_0x100000000 0 SYMBOL_TYPE_LINK "syncWhlCluStRL" /end STRUCTURE_COMPONENT
 /begin STRUCTURE_COMPONENT syncWhlCluStRR uint64_t_0x80000000 0 SYMBOL_TYPE_LINK "syncWhlCluStRR" /end STRUCTURE_COMPONENT
 /begin STRUCTURE_COMPONENT syncCenCluSt uint64_t_0x40000000 0 SYMBOL_TYPE_LINK "syncCenCluSt" /end STRUCTURE_COMPONENT
 /begin STRUCTURE_COMPONENT syncGear uint64_t_0x20000000 0 SYMBOL_TYPE_LINK "syncGear" /end STRUCTURE_COMPONENT
 /begin STRUCTURE_COMPONENT syncCTestPause uint64_t_0x10000000 0 SYMBOL_TYPE_LINK "syncCTestPause" /end STRUCTURE_COMPONENT
 /begin STRUCTURE_COMPONENT syncPropshRateSyncSt uint64_t_0x8000000 0 SYMBOL_TYPE_LINK "syncPropshRateSyncSt" /end STRUCTURE_COMPONENT
 /begin STRUCTURE_COMPONENT syncPropshRateMinRate uint64_t_0x4000000 0 SYMBOL_TYPE_LINK "syncPropshRateMinRate" /end STRUCTURE_COMPONENT
 /begin STRUCTURE_COMPONENT startTimeout uint64_t_0x2000000 0 SYMBOL_TYPE_LINK "startTimeout" /end STRUCTURE_COMPONENT
 /begin STRUCTURE_COMPONENT startLsttCrkStFlt uint64_t_0x1000000 0 SYMBOL_TYPE_LINK "startLsttCrkStFlt" /end STRUCTURE_COMPONENT
 /begin STRUCTURE_COMPONENT startVehRollgSt uint64_t_0x800000 0 SYMBOL_TYPE_LINK "startVehRollgSt" /end STRUCTURE_COMPONENT
 /begin STRUCTURE_COMPONENT startElSysSt uint64_t_0x400000 0 SYMBOL_TYPE_LINK "startElSysSt" /end STRUCTURE_COMPONENT
 /begin STRUCTURE_COMPONENT startIceCtrlSt uint64_t_0x200000 0 SYMBOL_TYPE_LINK "startIceCtrlSt" /end STRUCTURE_COMPONENT
 /begin STRUCTURE_COMPONENT startWhlCluStFL uint64_t_0x100000 0 SYMBOL_TYPE_LINK "startWhlCluStFL" /end STRUCTURE_COMPONENT
 /begin STRUCTURE_COMPONENT startWhlCluStFR uint64_t_0x80000 0 SYMBOL_TYPE_LINK "startWhlCluStFR" /end STRUCTURE_COMPONENT
 /begin STRUCTURE_COMPONENT startWhlCluStRL uint64_t_0x40000 0 SYMBOL_TYPE_LINK "startWhlCluStRL" /end STRUCTURE_COMPONENT
 /begin STRUCTURE_COMPONENT startWhlCluStRR uint64_t_0x20000 0 SYMBOL_TYPE_LINK "startWhlCluStRR" /end STRUCTURE_COMPONENT
 /begin STRUCTURE_COMPONENT startCenCluStDisengd uint64_t_0x10000 0 SYMBOL_TYPE_LINK "startCenCluStDisengd" /end STRUCTURE_COMPONENT
 /begin STRUCTURE_COMPONENT startGear uint64_t_0x8000 0 SYMBOL_TYPE_LINK "startGear" /end STRUCTURE_COMPONENT
 /begin STRUCTURE_COMPONENT startCTestPause uint64_t_0x4000 0 SYMBOL_TYPE_LINK "startCTestPause" /end STRUCTURE_COMPONENT
 /begin STRUCTURE_COMPONENT startIceRunngDetd uint64_t_0x2000 0 SYMBOL_TYPE_LINK "startIceRunngDetd" /end STRUCTURE_COMPONENT
 /begin STRUCTURE_COMPONENT runningTimeout uint64_t_0x1000 0 SYMBOL_TYPE_LINK "runningTimeout" /end STRUCTURE_COMPONENT
 /begin STRUCTURE_COMPONENT runningLsttCrkStFlt uint64_t_0x800 0 SYMBOL_TYPE_LINK "runningLsttCrkStFlt" /end STRUCTURE_COMPONENT
 /begin STRUCTURE_COMPONENT runningVehRollgSt uint64_t_0x400 0 SYMBOL_TYPE_LINK "runningVehRollgSt" /end STRUCTURE_COMPONENT
 /begin STRUCTURE_COMPONENT runningElSysSt uint64_t_0x200 0 SYMBOL_TYPE_LINK "runningElSysSt" /end STRUCTURE_COMPONENT
 /begin STRUCTURE_COMPONENT runningIceCtrlSt uint64_t_0x100 0 SYMBOL_TYPE_LINK "runningIceCtrlSt" /end STRUCTURE_COMPONENT
 /begin STRUCTURE_COMPONENT runningWhlCluStFL uint64_t_0x80 0 SYMBOL_TYPE_LINK "runningWhlCluStFL" /end STRUCTURE_COMPONENT
 /begin STRUCTURE_COMPONENT runningWhlCluStFR uint64_t_0x40 0 SYMBOL_TYPE_LINK "runningWhlCluStFR" /end STRUCTURE_COMPONENT
 /begin STRUCTURE_COMPONENT runningWhlCluStRL uint64_t_0x20 0 SYMBOL_TYPE_LINK "runningWhlCluStRL" /end STRUCTURE_COMPONENT
 /begin STRUCTURE_COMPONENT runningWhlCluStRR uint64_t_0x10 0 SYMBOL_TYPE_LINK "runningWhlCluStRR" /end STRUCTURE_COMPONENT
 /begin STRUCTURE_COMPONENT runningCenCluStDisengd uint64_t_0x8 0 SYMBOL_TYPE_LINK "runningCenCluStDisengd" /end STRUCTURE_COMPONENT
 /begin STRUCTURE_COMPONENT runningGear uint64_t_0x4 0 SYMBOL_TYPE_LINK "runningGear" /end STRUCTURE_COMPONENT
 /begin STRUCTURE_COMPONENT runningEngRunng uint64_t_0x2 0 SYMBOL_TYPE_LINK "runningEngRunng" /end STRUCTURE_COMPONENT
 /begin STRUCTURE_COMPONENT runningRateSync uint64_t_0x1 0 SYMBOL_TYPE_LINK "runningRateSync" /end STRUCTURE_COMPONENT
/end TYPEDEF_STRUCTURE
/begin TYPEDEF_STRUCTURE TsmPtCriticalFault "" 0x4 SYMBOL_TYPE_LINK "TsmPtCriticalFault"
 /begin STRUCTURE_COMPONENT ptCriticalFaultMask uint32_t 0 SYMBOL_TYPE_LINK "ptCriticalFaultMask" /end STRUCTURE_COMPONENT
 /begin STRUCTURE_COMPONENT flags TsmPtCriticalFaultFlags 0 SYMBOL_TYPE_LINK "flags" /end STRUCTURE_COMPONENT
/end TYPEDEF_STRUCTURE
/begin TYPEDEF_STRUCTURE TsmElecTurtleMask "" 0x4 SYMBOL_TYPE_LINK "TsmElecTurtleMask"
 /begin STRUCTURE_COMPONENT elecTurtleMask uint32_t 0 SYMBOL_TYPE_LINK "elecTurtleMask" /end STRUCTURE_COMPONENT
 /begin STRUCTURE_COMPONENT flags TsmElecTurtleMaskFlags 0 SYMBOL_TYPE_LINK "flags" /end STRUCTURE_COMPONENT
/end TYPEDEF_STRUCTURE
/begin TYPEDEF_STRUCTURE ReferenceGenCals "" 0x30 SYMBOL_TYPE_LINK "ReferenceGenCals" /begin STRUCTURE_COMPONENT kBlendVx0 _float 0 SYMBOL_TYPE_LINK "kBlendVx0" /end STRUCTURE_COMPONENT /begin STRUCTURE_COMPONENT kBlendVxMax _float 4 SYMBOL_TYPE_LINK "kBlendVxMax" /end STRUCTURE_COMPONENT /begin STRUCTURE_COMPONENT wb_scaling _float 8 SYMBOL_TYPE_LINK "wb_scaling" /end STRUCTURE_COMPONENT /begin STRUCTURE_COMPONENT csiTarget _float 12 SYMBOL_TYPE_LINK "csiTarget" /end STRUCTURE_COMPONENT /begin STRUCTURE_COMPONENT kOmegan _float 16 SYMBOL_TYPE_LINK "kOmegan" /end STRUCTURE_COMPONENT /begin STRUCTURE_COMPONENT Kus_safe_min _float 20 SYMBOL_TYPE_LINK "Kus_safe_min" /end STRUCTURE_COMPONENT
 /begin STRUCTURE_COMPONENT ayMaxScalingCoeff _float 24 SYMBOL_TYPE_LINK "ayMaxScalingCoeff" /end STRUCTURE_COMPONENT
 /begin STRUCTURE_COMPONENT psidotStarCoeff _float 28 SYMBOL_TYPE_LINK "psidotStarCoeff" /end STRUCTURE_COMPONENT
 /begin STRUCTURE_COMPONENT psidotRefMaxGlobal _float 32 SYMBOL_TYPE_LINK "psidotRefMaxGlobal" /end STRUCTURE_COMPONENT
 /begin STRUCTURE_COMPONENT secantMaxIter uint8_t 36 SYMBOL_TYPE_LINK "secantMaxIter" /end STRUCTURE_COMPONENT
 /begin STRUCTURE_COMPONENT secantTol _float 40 SYMBOL_TYPE_LINK "secantTol" /end STRUCTURE_COMPONENT
 /begin STRUCTURE_COMPONENT secantInitWidth _float 44 SYMBOL_TYPE_LINK "secantInitWidth" /end STRUCTURE_COMPONENT
/end TYPEDEF_STRUCTURE
/begin TYPEDEF_STRUCTURE RideSensorLocals "" 0x36C SYMBOL_TYPE_LINK "RideSensorLocals" /begin STRUCTURE_COMPONENT initDone _Bool 0 SYMBOL_TYPE_LINK "initDone" /end STRUCTURE_COMPONENT /begin STRUCTURE_COMPONENT raw RideSensorsRaw 4 SYMBOL_TYPE_LINK "raw" /end STRUCTURE_COMPONENT /begin STRUCTURE_COMPONENT suspSt SuspensionState 52 SYMBOL_TYPE_LINK "suspSt" /end STRUCTURE_COMPONENT
 /begin STRUCTURE_COMPONENT liftCircChkCtx CheckOorCtx 204 MATRIX_DIM 4 SYMBOL_TYPE_LINK "liftCircChkCtx" /end STRUCTURE_COMPONENT
 /begin STRUCTURE_COMPONENT liftCircRatyChkCtx RationalityDiagCtx 316 MATRIX_DIM 4 SYMBOL_TYPE_LINK "liftCircRatyChkCtx" /end STRUCTURE_COMPONENT
 /begin STRUCTURE_COMPONENT wishboneSnsrCircRatyChkCtx RationalityDiagCtx 380 MATRIX_DIM 4 SYMBOL_TYPE_LINK "wishboneSnsrCircRatyChkCtx" /end STRUCTURE_COMPONENT
 /begin STRUCTURE_COMPONENT liftOorChkCtx CheckOorCtx 444 MATRIX_DIM 4 SYMBOL_TYPE_LINK "liftOorChkCtx" /end STRUCTURE_COMPONENT
 /begin STRUCTURE_COMPONENT wishboneSnsrCircChkCtx CheckOorCtx 556 MATRIX_DIM 4 SYMBOL_TYPE_LINK "wishboneSnsrCircChkCtx" /end STRUCTURE_COMPONENT
 /begin STRUCTURE_COMPONENT whlTrvlOorChkCtx CheckOorCtx 668 MATRIX_DIM 4 SYMBOL_TYPE_LINK "whlTrvlOorChkCtx" /end STRUCTURE_COMPONENT
 /begin STRUCTURE_COMPONENT liftSnsrDiagCtx RideSensorsDiag 780 MATRIX_DIM 4 SYMBOL_TYPE_LINK "liftSnsrDiagCtx" /end STRUCTURE_COMPONENT
 /begin STRUCTURE_COMPONENT wishboneSnsrDiagCtx RideSensorsDiag 828 MATRIX_DIM 4 SYMBOL_TYPE_LINK "wishboneSnsrDiagCtx" /end STRUCTURE_COMPONENT
/end TYPEDEF_STRUCTURE
/begin TYPEDEF_STRUCTURE O2Butter "" 0x24 SYMBOL_TYPE_LINK "O2Butter"
 /begin STRUCTURE_COMPONENT normalizedCutoffFreq _float 0 SYMBOL_TYPE_LINK "normalizedCutoffFreq" /end STRUCTURE_COMPONENT
 /begin STRUCTURE_COMPONENT outerFactor _float 4 SYMBOL_TYPE_LINK "outerFactor" /end STRUCTURE_COMPONENT
 /begin STRUCTURE_COMPONENT outputFactor1 _float 8 SYMBOL_TYPE_LINK "outputFactor1" /end STRUCTURE_COMPONENT
 /begin STRUCTURE_COMPONENT outputFactor2 _float 12 SYMBOL_TYPE_LINK "outputFactor2" /end STRUCTURE_COMPONENT
 /begin STRUCTURE_COMPONENT inputPrevious1 _float 16 SYMBOL_TYPE_LINK "inputPrevious1" /end STRUCTURE_COMPONENT
 /begin STRUCTURE_COMPONENT inputPrevious2 _float 20 SYMBOL_TYPE_LINK "inputPrevious2" /end STRUCTURE_COMPONENT
 /begin STRUCTURE_COMPONENT outputPrevious1 _float 24 SYMBOL_TYPE_LINK "outputPrevious1" /end STRUCTURE_COMPONENT
 /begin STRUCTURE_COMPONENT outputPrevious2 _float 28 SYMBOL_TYPE_LINK "outputPrevious2" /end STRUCTURE_COMPONENT
 /begin STRUCTURE_COMPONENT bInitiated _Bool 32 SYMBOL_TYPE_LINK "bInitiated" /end STRUCTURE_COMPONENT
/end TYPEDEF_STRUCTURE
/begin TYPEDEF_STRUCTURE OscillationStatus "" 0x14 SYMBOL_TYPE_LINK "OscillationStatus" /begin STRUCTURE_COMPONENT amplPeakToPeak int16_t 0 SYMBOL_TYPE_LINK "amplPeakToPeak" /end STRUCTURE_COMPONENT /begin STRUCTURE_COMPONENT amplPeakPos int16_t 2 SYMBOL_TYPE_LINK "amplPeakPos" /end STRUCTURE_COMPONENT /begin STRUCTURE_COMPONENT amplPeakNeg int16_t 4 SYMBOL_TYPE_LINK "amplPeakNeg" /end STRUCTURE_COMPONENT
 /begin STRUCTURE_COMPONENT B_crossedZero uint64_t_0x8000 6 SYMBOL_TYPE_LINK "B_crossedZero" /end STRUCTURE_COMPONENT
 /begin STRUCTURE_COMPONENT B_reachedAmplThresh uint64_t_0x4000 6 SYMBOL_TYPE_LINK "B_reachedAmplThresh" /end STRUCTURE_COMPONENT
 /begin STRUCTURE_COMPONENT B_sync uint64_t_0x2000 6 SYMBOL_TYPE_LINK "B_sync" /end STRUCTURE_COMPONENT
 /begin STRUCTURE_COMPONENT lastStamp tMillisecond_U32 8 SYMBOL_TYPE_LINK "lastStamp" /end STRUCTURE_COMPONENT
 /begin STRUCTURE_COMPONENT periodCounter uint16_t 12 SYMBOL_TYPE_LINK "periodCounter" /end STRUCTURE_COMPONENT
 /begin STRUCTURE_COMPONENT period tMillisecond_U32 16 SYMBOL_TYPE_LINK "period" /end STRUCTURE_COMPONENT
/end TYPEDEF_STRUCTURE
/begin TYPEDEF_STRUCTURE RhsCycleState "" 0x8 SYMBOL_TYPE_LINK "RhsCycleState"
 /begin STRUCTURE_COMPONENT cycleStart tMillisecond_U32 0 SYMBOL_TYPE_LINK "cycleStart" /end STRUCTURE_COMPONENT
 /begin STRUCTURE_COMPONENT cyclesDone uint32_t 4 SYMBOL_TYPE_LINK "cyclesDone" /end STRUCTURE_COMPONENT
/end TYPEDEF_STRUCTURE
/begin TYPEDEF_STRUCTURE inverterFault2 "" 0x8 SYMBOL_TYPE_LINK "inverterFault2" /begin STRUCTURE_COMPONENT all uint64_t 0 SYMBOL_TYPE_LINK "all" /end STRUCTURE_COMPONENT /begin STRUCTURE_COMPONENT bit InverterFault2Bit 0 SYMBOL_TYPE_LINK "bit" /end STRUCTURE_COMPONENT /end TYPEDEF_STRUCTURE
/begin TYPEDEF_STRUCTURE RhsCalibState "" 0x34 SYMBOL_TYPE_LINK "RhsCalibState" /begin STRUCTURE_COMPONENT cycleState RhsCycleState 0 SYMBOL_TYPE_LINK "cycleState" /end STRUCTURE_COMPONENT
 /begin STRUCTURE_COMPONENT enableBleedLiftingCylinders _Bool 8 SYMBOL_TYPE_LINK "enableBleedLiftingCylinders" /end STRUCTURE_COMPONENT
 /begin STRUCTURE_COMPONENT stateEnterTime tMillisecond_U32 12 SYMBOL_TYPE_LINK "stateEnterTime" /end STRUCTURE_COMPONENT
 /begin STRUCTURE_COMPONENT state tLiftCalibState 16 SYMBOL_TYPE_LINK "state" /end STRUCTURE_COMPONENT
 /begin STRUCTURE_COMPONENT changedCalibStatePrev _Bool 20 SYMBOL_TYPE_LINK "changedCalibStatePrev" /end STRUCTURE_COMPONENT
 /begin STRUCTURE_COMPONENT liftCylCalibSetpoint RidePositionCalibSetpoint 22 SYMBOL_TYPE_LINK "liftCylCalibSetpoint" /end STRUCTURE_COMPONENT
 /begin STRUCTURE_COMPONENT positionAtCalibrationStart LiftCylinderPositions 38 SYMBOL_TYPE_LINK "positionAtCalibrationStart" /end STRUCTURE_COMPONENT
 /begin STRUCTURE_COMPONENT returnToStartFinishedTimeout tMillisecond_U32 48 SYMBOL_TYPE_LINK "returnToStartFinishedTimeout" /end STRUCTURE_COMPONENT
/end TYPEDEF_STRUCTURE
/begin TYPEDEF_STRUCTURE TsmIceTurtleMask "" 0x4 SYMBOL_TYPE_LINK "TsmIceTurtleMask" /begin STRUCTURE_COMPONENT iceTurtleMask uint32_t 0 SYMBOL_TYPE_LINK "iceTurtleMask" /end STRUCTURE_COMPONENT /begin STRUCTURE_COMPONENT flags TsmIceTurtleMaskFlags 0 SYMBOL_TYPE_LINK "flags" /end STRUCTURE_COMPONENT /end TYPEDEF_STRUCTURE
/begin TYPEDEF_STRUCTURE InvSmCtx "" 0x28 SYMBOL_TYPE_LINK "InvSmCtx" /begin STRUCTURE_COMPONENT state tInvSmStatus 0 SYMBOL_TYPE_LINK "state" /end STRUCTURE_COMPONENT /begin STRUCTURE_COMPONENT firstStateRun _Bool 4 SYMBOL_TYPE_LINK "firstStateRun" /end STRUCTURE_COMPONENT /begin STRUCTURE_COMPONENT invEnableReq _Bool 5 SYMBOL_TYPE_LINK "invEnableReq" /end STRUCTURE_COMPONENT /begin STRUCTURE_COMPONENT motorEnableReq _Bool 6 SYMBOL_TYPE_LINK "motorEnableReq" /end STRUCTURE_COMPONENT /begin STRUCTURE_COMPONENT invShutdownReq _Bool 7 SYMBOL_TYPE_LINK "invShutdownReq" /end STRUCTURE_COMPONENT /begin STRUCTURE_COMPONENT hybState tHybSmState 8 SYMBOL_TYPE_LINK "hybState" /end STRUCTURE_COMPONENT
 /begin STRUCTURE_COMPONENT inverterTimeout _Bool 12 SYMBOL_TYPE_LINK "inverterTimeout" /end STRUCTURE_COMPONENT
 /begin STRUCTURE_COMPONENT invState tInvState 16 SYMBOL_TYPE_LINK "invState" /end STRUCTURE_COMPONENT
 /begin STRUCTURE_COMPONENT invFaultLevel tFaultLevel 20 SYMBOL_TYPE_LINK "invFaultLevel" /end STRUCTURE_COMPONENT
 /begin STRUCTURE_COMPONENT invFaultFlags1 InverterFault1 24 SYMBOL_TYPE_LINK "invFaultFlags1" /end STRUCTURE_COMPONENT
 /begin STRUCTURE_COMPONENT invFaultFlags2 inverterFault2 32 SYMBOL_TYPE_LINK "invFaultFlags2" /end STRUCTURE_COMPONENT
/end TYPEDEF_STRUCTURE
/begin TYPEDEF_STRUCTURE Dfd "" 0x2C SYMBOL_TYPE_LINK "Dfd"
 /begin STRUCTURE_COMPONENT normalizedCutoffFreq _float 0 SYMBOL_TYPE_LINK "normalizedCutoffFreq" /end STRUCTURE_COMPONENT
 /begin STRUCTURE_COMPONENT timestep _float 4 SYMBOL_TYPE_LINK "timestep" /end STRUCTURE_COMPONENT
 /begin STRUCTURE_COMPONENT outerFactor _float 8 SYMBOL_TYPE_LINK "outerFactor" /end STRUCTURE_COMPONENT
 /begin STRUCTURE_COMPONENT inputFactor _float 12 SYMBOL_TYPE_LINK "inputFactor" /end STRUCTURE_COMPONENT
 /begin STRUCTURE_COMPONENT outputFactor1 _float 16 SYMBOL_TYPE_LINK "outputFactor1" /end STRUCTURE_COMPONENT
 /begin STRUCTURE_COMPONENT outputFactor2 _float 20 SYMBOL_TYPE_LINK "outputFactor2" /end STRUCTURE_COMPONENT
 /begin STRUCTURE_COMPONENT inputPrevious1 _float 24 SYMBOL_TYPE_LINK "inputPrevious1" /end STRUCTURE_COMPONENT
 /begin STRUCTURE_COMPONENT inputPrevious2 _float 28 SYMBOL_TYPE_LINK "inputPrevious2" /end STRUCTURE_COMPONENT
 /begin STRUCTURE_COMPONENT outputPrevious1 _float 32 SYMBOL_TYPE_LINK "outputPrevious1" /end STRUCTURE_COMPONENT
 /begin STRUCTURE_COMPONENT outputPrevious2 _float 36 SYMBOL_TYPE_LINK "outputPrevious2" /end STRUCTURE_COMPONENT
 /begin STRUCTURE_COMPONENT bInitiated _Bool 40 SYMBOL_TYPE_LINK "bInitiated" /end STRUCTURE_COMPONENT
/end TYPEDEF_STRUCTURE
/begin TYPEDEF_STRUCTURE OscillationParams "" 0x14 SYMBOL_TYPE_LINK "OscillationParams" /begin STRUCTURE_COMPONENT amplThreshold int16_t 0 SYMBOL_TYPE_LINK "amplThreshold" /end STRUCTURE_COMPONENT /begin STRUCTURE_COMPONENT filtCoef _float 4 SYMBOL_TYPE_LINK "filtCoef" /end STRUCTURE_COMPONENT /begin STRUCTURE_COMPONENT maxPeriod tMillisecond_U32 8 SYMBOL_TYPE_LINK "maxPeriod" /end STRUCTURE_COMPONENT /begin STRUCTURE_COMPONENT syncCount uint8_t 12 SYMBOL_TYPE_LINK "syncCount" /end STRUCTURE_COMPONENT
 /begin STRUCTURE_COMPONENT syncMaxDeviation tFactor 16 SYMBOL_TYPE_LINK "syncMaxDeviation" /end STRUCTURE_COMPONENT
/end TYPEDEF_STRUCTURE
/begin TYPEDEF_STRUCTURE TorqueLimitReason "" 0x2 SYMBOL_TYPE_LINK "TorqueLimitReason"
 /begin STRUCTURE_COMPONENT torqueLimitFlags TorqueLimitFlags 0 SYMBOL_TYPE_LINK "torqueLimitFlags" /end STRUCTURE_COMPONENT
 /begin STRUCTURE_COMPONENT torqueLimitMask uint16_t 0 SYMBOL_TYPE_LINK "torqueLimitMask" /end STRUCTURE_COMPONENT
/end TYPEDEF_STRUCTURE
/begin TYPEDEF_STRUCTURE RhsActiveState "" 0x10 SYMBOL_TYPE_LINK "RhsActiveState" /begin STRUCTURE_COMPONENT state tLiftState 0 SYMBOL_TYPE_LINK "state" /end STRUCTURE_COMPONENT
 /begin STRUCTURE_COMPONENT stateEnterTime tMillisecond_U32 4 SYMBOL_TYPE_LINK "stateEnterTime" /end STRUCTURE_COMPONENT
 /begin STRUCTURE_COMPONENT vehicleSpeedTooHighForLiftUp _Bool 8 SYMBOL_TYPE_LINK "vehicleSpeedTooHighForLiftUp" /end STRUCTURE_COMPONENT
 /begin STRUCTURE_COMPONENT prevSuppgMod tSupportingMode 12 SYMBOL_TYPE_LINK "prevSuppgMod" /end STRUCTURE_COMPONENT
/end TYPEDEF_STRUCTURE
/begin TYPEDEF_STRUCTURE RidePositionCalibSetpoint "" 0x10 SYMBOL_TYPE_LINK "RidePositionCalibSetpoint"
 /begin STRUCTURE_COMPONENT upper tMillivolt_S16 0 MATRIX_DIM 4 SYMBOL_TYPE_LINK "upper" /end STRUCTURE_COMPONENT
 /begin STRUCTURE_COMPONENT lower tMillivolt_S16 8 MATRIX_DIM 4 SYMBOL_TYPE_LINK "lower" /end STRUCTURE_COMPONENT
/end TYPEDEF_STRUCTURE
/begin TYPEDEF_STRUCTURE TsmLimpMask "" 0x4 SYMBOL_TYPE_LINK "TsmLimpMask" /begin STRUCTURE_COMPONENT tsmLimpMask uint32_t 0 SYMBOL_TYPE_LINK "tsmLimpMask" /end STRUCTURE_COMPONENT /begin STRUCTURE_COMPONENT flags TsmLimpMaskFlags 0 SYMBOL_TYPE_LINK "flags" /end STRUCTURE_COMPONENT /end TYPEDEF_STRUCTURE
/begin TYPEDEF_STRUCTURE InverterFault1Bit "" 0x8 SYMBOL_TYPE_LINK "InverterFault1Bit"
 /begin STRUCTURE_COMPONENT mcuBistFault uint64_t_0x8000000000000000 0 SYMBOL_TYPE_LINK "mcuBistFault" /end STRUCTURE_COMPONENT
 /begin STRUCTURE_COMPONENT mcuFault uint64_t_0x4000000000000000 0 SYMBOL_TYPE_LINK "mcuFault" /end STRUCTURE_COMPONENT
 /begin STRUCTURE_COMPONENT sbcBistFault uint64_t_0x2000000000000000 0 SYMBOL_TYPE_LINK "sbcBistFault" /end STRUCTURE_COMPONENT
 /begin STRUCTURE_COMPONENT sbcFault uint64_t_0x1000000000000000 0 SYMBOL_TYPE_LINK "sbcFault" /end STRUCTURE_COMPONENT
 /begin STRUCTURE_COMPONENT gateDriverBistFault uint64_t_0x800000000000000 0 SYMBOL_TYPE_LINK "gateDriverBistFault" /end STRUCTURE_COMPONENT
 /begin STRUCTURE_COMPONENT gateDriverFault uint64_t_0x400000000000000 0 SYMBOL_TYPE_LINK "gateDriverFault" /end STRUCTURE_COMPONENT
 /begin STRUCTURE_COMPONENT gateDriverWarning uint64_t_0x200000000000000 0 SYMBOL_TYPE_LINK "gateDriverWarning" /end STRUCTURE_COMPONENT
 /begin STRUCTURE_COMPONENT mosfetTFault uint64_t_0x100000000000000 0 SYMBOL_TYPE_LINK "mosfetTFault" /end STRUCTURE_COMPONENT
 /begin STRUCTURE_COMPONENT mosfetTWarning uint64_t_0x80000000000000 0 SYMBOL_TYPE_LINK "mosfetTWarning" /end STRUCTURE_COMPONENT
 /begin STRUCTURE_COMPONENT mosfetTRationality uint64_t_0x40000000000000 0 SYMBOL_TYPE_LINK "mosfetTRationality" /end STRUCTURE_COMPONENT
 /begin STRUCTURE_COMPONENT mosfetTSensing uint64_t_0x20000000000000 0 SYMBOL_TYPE_LINK "mosfetTSensing" /end STRUCTURE_COMPONENT
 /begin STRUCTURE_COMPONENT driverTFault uint64_t_0x10000000000000 0 SYMBOL_TYPE_LINK "driverTFault" /end STRUCTURE_COMPONENT
 /begin STRUCTURE_COMPONENT driverTWarning uint64_t_0x8000000000000 0 SYMBOL_TYPE_LINK "driverTWarning" /end STRUCTURE_COMPONENT
 /begin STRUCTURE_COMPONENT driverTRationality uint64_t_0x4000000000000 0 SYMBOL_TYPE_LINK "driverTRationality" /end STRUCTURE_COMPONENT
 /begin STRUCTURE_COMPONENT driverTSensing uint64_t_0x2000000000000 0 SYMBOL_TYPE_LINK "driverTSensing" /end STRUCTURE_COMPONENT
 /begin STRUCTURE_COMPONENT dcLinkTFault uint64_t_0x1000000000000 0 SYMBOL_TYPE_LINK "dcLinkTFault" /end STRUCTURE_COMPONENT
 /begin STRUCTURE_COMPONENT dcLinkTWarning uint64_t_0x800000000000 0 SYMBOL_TYPE_LINK "dcLinkTWarning" /end STRUCTURE_COMPONENT
 /begin STRUCTURE_COMPONENT dcLinkTRationality uint64_t_0x400000000000 0 SYMBOL_TYPE_LINK "dcLinkTRationality" /end STRUCTURE_COMPONENT
 /begin STRUCTURE_COMPONENT dcLinkTSensing uint64_t_0x200000000000 0 SYMBOL_TYPE_LINK "dcLinkTSensing" /end STRUCTURE_COMPONENT
 /begin STRUCTURE_COMPONENT coolantTFault uint64_t_0x100000000000 0 SYMBOL_TYPE_LINK "coolantTFault" /end STRUCTURE_COMPONENT
 /begin STRUCTURE_COMPONENT coolantTWarning uint64_t_0x80000000000 0 SYMBOL_TYPE_LINK "coolantTWarning" /end STRUCTURE_COMPONENT
 /begin STRUCTURE_COMPONENT coolantTRationality uint64_t_0x40000000000 0 SYMBOL_TYPE_LINK "coolantTRationality" /end STRUCTURE_COMPONENT
 /begin STRUCTURE_COMPONENT coolantTSensing uint64_t_0x20000000000 0 SYMBOL_TYPE_LINK "coolantTSensing" /end STRUCTURE_COMPONENT
 /begin STRUCTURE_COMPONENT motorTFault uint64_t_0x10000000000 0 SYMBOL_TYPE_LINK "motorTFault" /end STRUCTURE_COMPONENT
 /begin STRUCTURE_COMPONENT motorTWarning uint64_t_0x8000000000 0 SYMBOL_TYPE_LINK "motorTWarning" /end STRUCTURE_COMPONENT
 /begin STRUCTURE_COMPONENT motorTRationality uint64_t_0x4000000000 0 SYMBOL_TYPE_LINK "motorTRationality" /end STRUCTURE_COMPONENT
 /begin STRUCTURE_COMPONENT motorTSensing uint64_t_0x2000000000 0 SYMBOL_TYPE_LINK "motorTSensing" /end STRUCTURE_COMPONENT
 /begin STRUCTURE_COMPONENT inverterBoardsTFault uint64_t_0x1000000000 0 SYMBOL_TYPE_LINK "inverterBoardsTFault" /end STRUCTURE_COMPONENT
 /begin STRUCTURE_COMPONENT inverterBoardsTWarning uint64_t_0x800000000 0 SYMBOL_TYPE_LINK "inverterBoardsTWarning" /end STRUCTURE_COMPONENT
 /begin STRUCTURE_COMPONENT inverterBoardsTRationality uint64_t_0x400000000 0 SYMBOL_TYPE_LINK "inverterBoardsTRationality" /end STRUCTURE_COMPONENT
 /begin STRUCTURE_COMPONENT inverterBoardsTSensing uint64_t_0x200000000 0 SYMBOL_TYPE_LINK "inverterBoardsTSensing" /end STRUCTURE_COMPONENT
 /begin STRUCTURE_COMPONENT lvExtSupplyUv uint64_t_0x100000000 0 SYMBOL_TYPE_LINK "lvExtSupplyUv" /end STRUCTURE_COMPONENT
 /begin STRUCTURE_COMPONENT lvExtSupplyOv uint64_t_0x80000000 0 SYMBOL_TYPE_LINK "lvExtSupplyOv" /end STRUCTURE_COMPONENT
 /begin STRUCTURE_COMPONENT crashSignal uint64_t_0x40000000 0 SYMBOL_TYPE_LINK "crashSignal" /end STRUCTURE_COMPONENT
 /begin STRUCTURE_COMPONENT lvSelfCheckMain uint64_t_0x20000000 0 SYMBOL_TYPE_LINK "lvSelfCheckMain" /end STRUCTURE_COMPONENT
 /begin STRUCTURE_COMPONENT ipcLockMain uint64_t_0x10000000 0 SYMBOL_TYPE_LINK "ipcLockMain" /end STRUCTURE_COMPONENT
 /begin STRUCTURE_COMPONENT swCompatibility uint64_t_0x8000000 0 SYMBOL_TYPE_LINK "swCompatibility" /end STRUCTURE_COMPONENT
 /begin STRUCTURE_COMPONENT taskAliveMain uint64_t_0x4000000 0 SYMBOL_TYPE_LINK "taskAliveMain" /end STRUCTURE_COMPONENT
 /begin STRUCTURE_COMPONENT taskDeadlineMain uint64_t_0x2000000 0 SYMBOL_TYPE_LINK "taskDeadlineMain" /end STRUCTURE_COMPONENT
 /begin STRUCTURE_COMPONENT ipcLockCm uint64_t_0x1000000 0 SYMBOL_TYPE_LINK "ipcLockCm" /end STRUCTURE_COMPONENT
 /begin STRUCTURE_COMPONENT taskAliveCm uint64_t_0x800000 0 SYMBOL_TYPE_LINK "taskAliveCm" /end STRUCTURE_COMPONENT
 /begin STRUCTURE_COMPONENT taskDeadlineCm uint64_t_0x400000 0 SYMBOL_TYPE_LINK "taskDeadlineCm" /end STRUCTURE_COMPONENT
 /begin STRUCTURE_COMPONENT canE2e uint64_t_0x200000 0 SYMBOL_TYPE_LINK "canE2e" /end STRUCTURE_COMPONENT
 /begin STRUCTURE_COMPONENT canCommLossWarning uint64_t_0x100000 0 SYMBOL_TYPE_LINK "canCommLossWarning" /end STRUCTURE_COMPONENT
 /begin STRUCTURE_COMPONENT canCommLossError uint64_t_0x80000 0 SYMBOL_TYPE_LINK "canCommLossError" /end STRUCTURE_COMPONENT
 /begin STRUCTURE_COMPONENT yCapCtrlUOoR uint64_t_0x40000 0 SYMBOL_TYPE_LINK "yCapCtrlUOoR" /end STRUCTURE_COMPONENT
 /begin STRUCTURE_COMPONENT lvIntSupply uint64_t_0x20000 0 SYMBOL_TYPE_LINK "lvIntSupply" /end STRUCTURE_COMPONENT
 /begin STRUCTURE_COMPONENT rsvd uint64_t_0x1FFFF 0 SYMBOL_TYPE_LINK "rsvd" /end STRUCTURE_COMPONENT
/end TYPEDEF_STRUCTURE
/begin TYPEDEF_STRUCTURE RideHeightControlErrorStruct "" 0x2 SYMBOL_TYPE_LINK "RideHeightControlErrorStruct" /begin STRUCTURE_COMPONENT B RideHeightControlErrorStructB 0 SYMBOL_TYPE_LINK "B" /end STRUCTURE_COMPONENT /begin STRUCTURE_COMPONENT R tHex_U16 0 SYMBOL_TYPE_LINK "R" /end STRUCTURE_COMPONENT /end TYPEDEF_STRUCTURE
/begin TYPEDEF_STRUCTURE TsmTqOffMask "" 0x4 SYMBOL_TYPE_LINK "TsmTqOffMask" /begin STRUCTURE_COMPONENT tqOffMask uint32_t 0 SYMBOL_TYPE_LINK "tqOffMask" /end STRUCTURE_COMPONENT /begin STRUCTURE_COMPONENT flags TsmTqOffMaskFlags 0 SYMBOL_TYPE_LINK "flags" /end STRUCTURE_COMPONENT /end TYPEDEF_STRUCTURE
/begin TYPEDEF_STRUCTURE CylinderMovementWorkspace "" 0x18 SYMBOL_TYPE_LINK "CylinderMovementWorkspace" /begin STRUCTURE_COMPONENT atTarget _Bool 0 SYMBOL_TYPE_LINK "atTarget" /end STRUCTURE_COMPONENT
 /begin STRUCTURE_COMPONENT prevTarget tMillimetre_10_S16 2 SYMBOL_TYPE_LINK "prevTarget" /end STRUCTURE_COMPONENT
 /begin STRUCTURE_COMPONENT tightTolerance _Bool 4 SYMBOL_TYPE_LINK "tightTolerance" /end STRUCTURE_COMPONENT
 /begin STRUCTURE_COMPONENT noReachPosInTime _Bool 5 SYMBOL_TYPE_LINK "noReachPosInTime" /end STRUCTURE_COMPONENT
 /begin STRUCTURE_COMPONENT isWithinLooseTolerancesPrev _Bool 6 SYMBOL_TYPE_LINK "isWithinLooseTolerancesPrev" /end STRUCTURE_COMPONENT
 /begin STRUCTURE_COMPONENT tooManyRetries _Bool 7 SYMBOL_TYPE_LINK "tooManyRetries" /end STRUCTURE_COMPONENT
 /begin STRUCTURE_COMPONENT rstrtTmr _Bool 8 SYMBOL_TYPE_LINK "rstrtTmr" /end STRUCTURE_COMPONENT
 /begin STRUCTURE_COMPONENT cylinderIsMoving _Bool 9 SYMBOL_TYPE_LINK "cylinderIsMoving" /end STRUCTURE_COMPONENT
 /begin STRUCTURE_COMPONENT goToDesiredPosMaxTime tMillisecond_U32 12 SYMBOL_TYPE_LINK "goToDesiredPosMaxTime" /end STRUCTURE_COMPONENT
 /begin STRUCTURE_COMPONENT outOfTolrTmr tMillisecond_U32 16 SYMBOL_TYPE_LINK "outOfTolrTmr" /end STRUCTURE_COMPONENT
 /begin STRUCTURE_COMPONENT retryCounter uint8_t 20 SYMBOL_TYPE_LINK "retryCounter" /end STRUCTURE_COMPONENT
/end TYPEDEF_STRUCTURE
/begin TYPEDEF_STRUCTURE LiftCylinderPositions "" 0x8 SYMBOL_TYPE_LINK "LiftCylinderPositions" /begin STRUCTURE_COMPONENT fl tMillimetre_10_S16 0 SYMBOL_TYPE_LINK "fl" /end STRUCTURE_COMPONENT /begin STRUCTURE_COMPONENT fr tMillimetre_10_S16 2 SYMBOL_TYPE_LINK "fr" /end STRUCTURE_COMPONENT /begin STRUCTURE_COMPONENT rl tMillimetre_10_S16 4 SYMBOL_TYPE_LINK "rl" /end STRUCTURE_COMPONENT /begin STRUCTURE_COMPONENT rr tMillimetre_10_S16 6 SYMBOL_TYPE_LINK "rr" /end STRUCTURE_COMPONENT /end TYPEDEF_STRUCTURE
/begin TYPEDEF_STRUCTURE NetworkNode "" 0x10 SYMBOL_TYPE_LINK "NetworkNode"
 /begin STRUCTURE_COMPONENT slaveError tSlaveErrorStatus 0 SYMBOL_TYPE_LINK "slaveError" /end STRUCTURE_COMPONENT
 /begin STRUCTURE_COMPONENT slaveAck tAcknowledgementStatus 4 SYMBOL_TYPE_LINK "slaveAck" /end STRUCTURE_COMPONENT
 /begin STRUCTURE_COMPONENT enableHold tEnableHold 8 SYMBOL_TYPE_LINK "enableHold" /end STRUCTURE_COMPONENT
 /begin STRUCTURE_COMPONENT status tNmSlaveStatus 12 SYMBOL_TYPE_LINK "status" /end STRUCTURE_COMPONENT
/end TYPEDEF_STRUCTURE
/begin TYPEDEF_STRUCTURE SuspensionState "" 0x98 SYMBOL_TYPE_LINK "SuspensionState"
 /begin STRUCTURE_COMPONENT liftPosn tMillimetre_10_S16 0 MATRIX_DIM 4 SYMBOL_TYPE_LINK "liftPosn" /end STRUCTURE_COMPONENT
 /begin STRUCTURE_COMPONENT liftPosnQ tQualifier 8 MATRIX_DIM 4 SYMBOL_TYPE_LINK "liftPosnQ" /end STRUCTURE_COMPONENT
 /begin STRUCTURE_COMPONENT whlTrvl tMillimetre_10_S16 24 MATRIX_DIM 4 SYMBOL_TYPE_LINK "whlTrvl" /end STRUCTURE_COMPONENT
 /begin STRUCTURE_COMPONENT whlTrvlQ tQualifier 32 MATRIX_DIM 4 SYMBOL_TYPE_LINK "whlTrvlQ" /end STRUCTURE_COMPONENT
 /begin STRUCTURE_COMPONENT wishboneSnsrAg tDegree_10_S16 48 MATRIX_DIM 4 SYMBOL_TYPE_LINK "wishboneSnsrAg" /end STRUCTURE_COMPONENT
 /begin STRUCTURE_COMPONENT wishboneSnsrAgQ tQualifier 56 MATRIX_DIM 4 SYMBOL_TYPE_LINK "wishboneSnsrAgQ" /end STRUCTURE_COMPONENT
 /begin STRUCTURE_COMPONENT damprTrvl tMillimetre_10_S16 72 MATRIX_DIM 4 SYMBOL_TYPE_LINK "damprTrvl" /end STRUCTURE_COMPONENT
 /begin STRUCTURE_COMPONENT damprTrvlQ tQualifier 80 MATRIX_DIM 4 SYMBOL_TYPE_LINK "damprTrvlQ" /end STRUCTURE_COMPONENT
 /begin STRUCTURE_COMPONENT sprgTrvl tMillimetre_10_S16 96 MATRIX_DIM 4 SYMBOL_TYPE_LINK "sprgTrvl" /end STRUCTURE_COMPONENT
 /begin STRUCTURE_COMPONENT sprgTrvlQ tQualifier 104 MATRIX_DIM 4 SYMBOL_TYPE_LINK "sprgTrvlQ" /end STRUCTURE_COMPONENT
 /begin STRUCTURE_COMPONENT rideHeight tMillimetre_10_S16 120 MATRIX_DIM 4 SYMBOL_TYPE_LINK "rideHeight" /end STRUCTURE_COMPONENT
 /begin STRUCTURE_COMPONENT rideHeightQ tQualifier 128 MATRIX_DIM 4 SYMBOL_TYPE_LINK "rideHeightQ" /end STRUCTURE_COMPONENT
 /begin STRUCTURE_COMPONENT mtnRat tFactor_1000_S16 144 MATRIX_DIM 4 SYMBOL_TYPE_LINK "mtnRat" /end STRUCTURE_COMPONENT
/end TYPEDEF_STRUCTURE
/begin TYPEDEF_STRUCTURE DrvgCrkFltFlg "" 0x8 SYMBOL_TYPE_LINK "DrvgCrkFltFlg"
 /begin STRUCTURE_COMPONENT _bit_fill_ uint64_t_0xFFFFFFFFFFFFC000 0 SYMBOL_TYPE_LINK "_bit_fill_" /end STRUCTURE_COMPONENT
 /begin STRUCTURE_COMPONENT initCTestPause uint64_t_0x2000 0 SYMBOL_TYPE_LINK "initCTestPause" /end STRUCTURE_COMPONENT
 /begin STRUCTURE_COMPONENT initDrvMod uint64_t_0x1000 0 SYMBOL_TYPE_LINK "initDrvMod" /end STRUCTURE_COMPONENT
 /begin STRUCTURE_COMPONENT initElSysSt uint64_t_0x800 0 SYMBOL_TYPE_LINK "initElSysSt" /end STRUCTURE_COMPONENT
 /begin STRUCTURE_COMPONENT initIceCtrlStUkwn uint64_t_0x400 0 SYMBOL_TYPE_LINK "initIceCtrlStUkwn" /end STRUCTURE_COMPONENT
 /begin STRUCTURE_COMPONENT initIceCtrlStUnavl uint64_t_0x200 0 SYMBOL_TYPE_LINK "initIceCtrlStUnavl" /end STRUCTURE_COMPONENT
 /begin STRUCTURE_COMPONENT initLsttCrkSt uint64_t_0x100 0 SYMBOL_TYPE_LINK "initLsttCrkSt" /end STRUCTURE_COMPONENT
 /begin STRUCTURE_COMPONENT initTakeoffSt uint64_t_0x80 0 SYMBOL_TYPE_LINK "initTakeoffSt" /end STRUCTURE_COMPONENT
 /begin STRUCTURE_COMPONENT coupleCTestPause uint64_t_0x40 0 SYMBOL_TYPE_LINK "coupleCTestPause" /end STRUCTURE_COMPONENT
 /begin STRUCTURE_COMPONENT coupleDrvMod uint64_t_0x20 0 SYMBOL_TYPE_LINK "coupleDrvMod" /end STRUCTURE_COMPONENT
 /begin STRUCTURE_COMPONENT coupleCenCluSt uint64_t_0x10 0 SYMBOL_TYPE_LINK "coupleCenCluSt" /end STRUCTURE_COMPONENT
 /begin STRUCTURE_COMPONENT coupleElSysSt uint64_t_0x8 0 SYMBOL_TYPE_LINK "coupleElSysSt" /end STRUCTURE_COMPONENT
 /begin STRUCTURE_COMPONENT coupleIceCtrlStUkwn uint64_t_0x4 0 SYMBOL_TYPE_LINK "coupleIceCtrlStUkwn" /end STRUCTURE_COMPONENT
 /begin STRUCTURE_COMPONENT coupleIceCtrlStUnavl uint64_t_0x2 0 SYMBOL_TYPE_LINK "coupleIceCtrlStUnavl" /end STRUCTURE_COMPONENT
 /begin STRUCTURE_COMPONENT coupleLsttCrkSt uint64_t_0x1 0 SYMBOL_TYPE_LINK "coupleLsttCrkSt" /end STRUCTURE_COMPONENT
/end TYPEDEF_STRUCTURE
/begin TYPEDEF_STRUCTURE RationalityDiagCtx "" 0x10 SYMBOL_TYPE_LINK "RationalityDiagCtx" /begin STRUCTURE_COMPONENT previousValue int16_t 0 SYMBOL_TYPE_LINK "previousValue" /end STRUCTURE_COMPONENT /begin STRUCTURE_COMPONENT absDlt int16_t 2 SYMBOL_TYPE_LINK "absDlt" /end STRUCTURE_COMPONENT /begin STRUCTURE_COMPONENT errCnt int16_t 4 SYMBOL_TYPE_LINK "errCnt" /end STRUCTURE_COMPONENT /begin STRUCTURE_COMPONENT flagRat tDiagnos 8 SYMBOL_TYPE_LINK "flagRat" /end STRUCTURE_COMPONENT /begin STRUCTURE_COMPONENT healPerd tMillisecond_U32 12 SYMBOL_TYPE_LINK "healPerd" /end STRUCTURE_COMPONENT /end TYPEDEF_STRUCTURE
/begin TYPEDEF_STRUCTURE TsmPtCriticalFaultFlags "" 0x4 SYMBOL_TYPE_LINK "TsmPtCriticalFaultFlags"
 /begin STRUCTURE_COMPONENT _bit_fill_ uint32_t_0xFFFE0000 0 SYMBOL_TYPE_LINK "_bit_fill_" /end STRUCTURE_COMPONENT
 /begin STRUCTURE_COMPONENT tsmWatchdog uint32_t_0x10000 0 SYMBOL_TYPE_LINK "tsmWatchdog" /end STRUCTURE_COMPONENT
 /begin STRUCTURE_COMPONENT tsmStateUnknown uint32_t_0x8000 0 SYMBOL_TYPE_LINK "tsmStateUnknown" /end STRUCTURE_COMPONENT
 /begin STRUCTURE_COMPONENT bInvCtrlStPlaus uint32_t_0x4000 0 SYMBOL_TYPE_LINK "bInvCtrlStPlaus" /end STRUCTURE_COMPONENT
 /begin STRUCTURE_COMPONENT axleClosed uint32_t_0x2000 0 SYMBOL_TYPE_LINK "axleClosed" /end STRUCTURE_COMPONENT
 /begin STRUCTURE_COMPONENT axleElecTurtle uint32_t_0x1000 0 SYMBOL_TYPE_LINK "axleElecTurtle" /end STRUCTURE_COMPONENT
 /begin STRUCTURE_COMPONENT axleFrntMismatch uint32_t_0x800 0 SYMBOL_TYPE_LINK "axleFrntMismatch" /end STRUCTURE_COMPONENT
 /begin STRUCTURE_COMPONENT axleFwd uint32_t_0x400 0 SYMBOL_TYPE_LINK "axleFwd" /end STRUCTURE_COMPONENT
 /begin STRUCTURE_COMPONENT axleIceTurtle uint32_t_0x200 0 SYMBOL_TYPE_LINK "axleIceTurtle" /end STRUCTURE_COMPONENT
 /begin STRUCTURE_COMPONENT axleOpen uint32_t_0x100 0 SYMBOL_TYPE_LINK "axleOpen" /end STRUCTURE_COMPONENT
 /begin STRUCTURE_COMPONENT axleRearMismatch uint32_t_0x80 0 SYMBOL_TYPE_LINK "axleRearMismatch" /end STRUCTURE_COMPONENT
 /begin STRUCTURE_COMPONENT axleRwd uint32_t_0x40 0 SYMBOL_TYPE_LINK "axleRwd" /end STRUCTURE_COMPONENT
 /begin STRUCTURE_COMPONENT axleShutdown uint32_t_0x20 0 SYMBOL_TYPE_LINK "axleShutdown" /end STRUCTURE_COMPONENT
 /begin STRUCTURE_COMPONENT elecFaultEngOff uint32_t_0x10 0 SYMBOL_TYPE_LINK "elecFaultEngOff" /end STRUCTURE_COMPONENT
 /begin STRUCTURE_COMPONENT elecShutdown uint32_t_0x8 0 SYMBOL_TYPE_LINK "elecShutdown" /end STRUCTURE_COMPONENT
 /begin STRUCTURE_COMPONENT elecTurtleUnavailable uint32_t_0x4 0 SYMBOL_TYPE_LINK "elecTurtleUnavailable" /end STRUCTURE_COMPONENT
 /begin STRUCTURE_COMPONENT iceTurtleUnavailable uint32_t_0x2 0 SYMBOL_TYPE_LINK "iceTurtleUnavailable" /end STRUCTURE_COMPONENT
 /begin STRUCTURE_COMPONENT tqUnavailable uint32_t_0x1 0 SYMBOL_TYPE_LINK "tqUnavailable" /end STRUCTURE_COMPONENT
/end TYPEDEF_STRUCTURE
/begin TYPEDEF_STRUCTURE CheckOorCtx "" 0x1C SYMBOL_TYPE_LINK "CheckOorCtx" /begin STRUCTURE_COMPONENT min int32_t 0 SYMBOL_TYPE_LINK "min" /end STRUCTURE_COMPONENT /begin STRUCTURE_COMPONENT max int32_t 4 SYMBOL_TYPE_LINK "max" /end STRUCTURE_COMPONENT
 /begin STRUCTURE_COMPONENT debounceDuration tMillisecond_U32 8 SYMBOL_TYPE_LINK "debounceDuration" /end STRUCTURE_COMPONENT
 /begin STRUCTURE_COMPONENT initDelay tMillisecond_U32 12 SYMBOL_TYPE_LINK "initDelay" /end STRUCTURE_COMPONENT
 /begin STRUCTURE_COMPONENT lastOkTime tMillisecond_U32 16 SYMBOL_TYPE_LINK "lastOkTime" /end STRUCTURE_COMPONENT
 /begin STRUCTURE_COMPONENT exceededMax _Bool 20 SYMBOL_TYPE_LINK "exceededMax" /end STRUCTURE_COMPONENT
 /begin STRUCTURE_COMPONENT exceededMin _Bool 21 SYMBOL_TYPE_LINK "exceededMin" /end STRUCTURE_COMPONENT
 /begin STRUCTURE_COMPONENT status tDiagnos 24 SYMBOL_TYPE_LINK "status" /end STRUCTURE_COMPONENT
/end TYPEDEF_STRUCTURE
/begin TYPEDEF_STRUCTURE InverterFault2Bit "" 0x8 SYMBOL_TYPE_LINK "InverterFault2Bit"
 /begin STRUCTURE_COMPONENT rslvBistFault uint64_t_0x8000000000000000 0 SYMBOL_TYPE_LINK "rslvBistFault" /end STRUCTURE_COMPONENT
 /begin STRUCTURE_COMPONENT rslvFault uint64_t_0x4000000000000000 0 SYMBOL_TYPE_LINK "rslvFault" /end STRUCTURE_COMPONENT
 /begin STRUCTURE_COMPONENT rslvOffset uint64_t_0x2000000000000000 0 SYMBOL_TYPE_LINK "rslvOffset" /end STRUCTURE_COMPONENT
 /begin STRUCTURE_COMPONENT acISensorCalibration uint64_t_0x1000000000000000 0 SYMBOL_TYPE_LINK "acISensorCalibration" /end STRUCTURE_COMPONENT
 /begin STRUCTURE_COMPONENT acISensorOor uint64_t_0x800000000000000 0 SYMBOL_TYPE_LINK "acISensorOor" /end STRUCTURE_COMPONENT
 /begin STRUCTURE_COMPONENT acPhaseShort uint64_t_0x400000000000000 0 SYMBOL_TYPE_LINK "acPhaseShort" /end STRUCTURE_COMPONENT
 /begin STRUCTURE_COMPONENT acPhaseLoss uint64_t_0x200000000000000 0 SYMBOL_TYPE_LINK "acPhaseLoss" /end STRUCTURE_COMPONENT
 /begin STRUCTURE_COMPONENT acPhaseURationnality uint64_t_0x100000000000000 0 SYMBOL_TYPE_LINK "acPhaseURationnality" /end STRUCTURE_COMPONENT
 /begin STRUCTURE_COMPONENT acPhaseIImbalance uint64_t_0x80000000000000 0 SYMBOL_TYPE_LINK "acPhaseIImbalance" /end STRUCTURE_COMPONENT
 /begin STRUCTURE_COMPONENT acPhaseIOc uint64_t_0x40000000000000 0 SYMBOL_TYPE_LINK "acPhaseIOc" /end STRUCTURE_COMPONENT
 /begin STRUCTURE_COMPONENT dcBusIOc uint64_t_0x20000000000000 0 SYMBOL_TYPE_LINK "dcBusIOc" /end STRUCTURE_COMPONENT
 /begin STRUCTURE_COMPONENT dcBusIRationnality uint64_t_0x10000000000000 0 SYMBOL_TYPE_LINK "dcBusIRationnality" /end STRUCTURE_COMPONENT
 /begin STRUCTURE_COMPONENT dcBusISensing uint64_t_0x8000000000000 0 SYMBOL_TYPE_LINK "dcBusISensing" /end STRUCTURE_COMPONENT
 /begin STRUCTURE_COMPONENT dcBusUOv uint64_t_0x4000000000000 0 SYMBOL_TYPE_LINK "dcBusUOv" /end STRUCTURE_COMPONENT
 /begin STRUCTURE_COMPONENT dcBusUUv uint64_t_0x2000000000000 0 SYMBOL_TYPE_LINK "dcBusUUv" /end STRUCTURE_COMPONENT
 /begin STRUCTURE_COMPONENT dcBusURationnality uint64_t_0x1000000000000 0 SYMBOL_TYPE_LINK "dcBusURationnality" /end STRUCTURE_COMPONENT
 /begin STRUCTURE_COMPONENT dcBusUSensing uint64_t_0x800000000000 0 SYMBOL_TYPE_LINK "dcBusUSensing" /end STRUCTURE_COMPONENT
 /begin STRUCTURE_COMPONENT motorOverSpeed uint64_t_0x400000000000 0 SYMBOL_TYPE_LINK "motorOverSpeed" /end STRUCTURE_COMPONENT
 /begin STRUCTURE_COMPONENT motorSpeedRationnality uint64_t_0x200000000000 0 SYMBOL_TYPE_LINK "motorSpeedRationnality" /end STRUCTURE_COMPONENT
 /begin STRUCTURE_COMPONENT motorStall uint64_t_0x100000000000 0 SYMBOL_TYPE_LINK "motorStall" /end STRUCTURE_COMPONENT
 /begin STRUCTURE_COMPONENT trqEstimationRationnality uint64_t_0x80000000000 0 SYMBOL_TYPE_LINK "trqEstimationRationnality" /end STRUCTURE_COMPONENT
 /begin STRUCTURE_COMPONENT trqCommandRationnality uint64_t_0x40000000000 0 SYMBOL_TYPE_LINK "trqCommandRationnality" /end STRUCTURE_COMPONENT
 /begin STRUCTURE_COMPONENT lvSelfCheckCtrl uint64_t_0x20000000000 0 SYMBOL_TYPE_LINK "lvSelfCheckCtrl" /end STRUCTURE_COMPONENT
 /begin STRUCTURE_COMPONENT hvSelfCheckCtrl uint64_t_0x10000000000 0 SYMBOL_TYPE_LINK "hvSelfCheckCtrl" /end STRUCTURE_COMPONENT
 /begin STRUCTURE_COMPONENT taskAliveCtrl uint64_t_0x8000000000 0 SYMBOL_TYPE_LINK "taskAliveCtrl" /end STRUCTURE_COMPONENT
 /begin STRUCTURE_COMPONENT taskDeadlineCtrl uint64_t_0x4000000000 0 SYMBOL_TYPE_LINK "taskDeadlineCtrl" /end STRUCTURE_COMPONENT
 /begin STRUCTURE_COMPONENT ipcLockCtrl uint64_t_0x2000000000 0 SYMBOL_TYPE_LINK "ipcLockCtrl" /end STRUCTURE_COMPONENT
 /begin STRUCTURE_COMPONENT ctrlModeRationnality uint64_t_0x1000000000 0 SYMBOL_TYPE_LINK "ctrlModeRationnality" /end STRUCTURE_COMPONENT
 /begin STRUCTURE_COMPONENT rsvd uint64_t_0xFFFFFFFFF 0 SYMBOL_TYPE_LINK "rsvd" /end STRUCTURE_COMPONENT
/end TYPEDEF_STRUCTURE
/begin TYPEDEF_STRUCTURE RideSensorsRaw "" 0x30 SYMBOL_TYPE_LINK "RideSensorsRaw"
 /begin STRUCTURE_COMPONENT liftCylU tMillivolt_S16 0 MATRIX_DIM 4 SYMBOL_TYPE_LINK "liftCylU" /end STRUCTURE_COMPONENT
 /begin STRUCTURE_COMPONENT liftCylUQ tQualifier 8 MATRIX_DIM 4 SYMBOL_TYPE_LINK "liftCylUQ" /end STRUCTURE_COMPONENT
 /begin STRUCTURE_COMPONENT wishboneU tMillivolt_S16 24 MATRIX_DIM 4 SYMBOL_TYPE_LINK "wishboneU" /end STRUCTURE_COMPONENT
 /begin STRUCTURE_COMPONENT wishboneUQ tQualifier 32 MATRIX_DIM 4 SYMBOL_TYPE_LINK "wishboneUQ" /end STRUCTURE_COMPONENT
/end TYPEDEF_STRUCTURE
/begin TYPEDEF_STRUCTURE TsmElecTurtleMaskFlags "" 0x4 SYMBOL_TYPE_LINK "TsmElecTurtleMaskFlags"
 /begin STRUCTURE_COMPONENT _bit_fill_ uint32_t_0xFFFFFFE0 0 SYMBOL_TYPE_LINK "_bit_fill_" /end STRUCTURE_COMPONENT
 /begin STRUCTURE_COMPONENT forcedEvTurtle uint32_t_0x10 0 SYMBOL_TYPE_LINK "forcedEvTurtle" /end STRUCTURE_COMPONENT
 /begin STRUCTURE_COMPONENT iceSysCritical uint32_t_0x8 0 SYMBOL_TYPE_LINK "iceSysCritical" /end STRUCTURE_COMPONENT
 /begin STRUCTURE_COMPONENT cenCluFault uint32_t_0x4 0 SYMBOL_TYPE_LINK "cenCluFault" /end STRUCTURE_COMPONENT
 /begin STRUCTURE_COMPONENT bLsttCommFault uint32_t_0x2 0 SYMBOL_TYPE_LINK "bLsttCommFault" /end STRUCTURE_COMPONENT
 /begin STRUCTURE_COMPONENT bEcmCommFault uint32_t_0x1 0 SYMBOL_TYPE_LINK "bEcmCommFault" /end STRUCTURE_COMPONENT
/end TYPEDEF_STRUCTURE
/begin TYPEDEF_STRUCTURE RideSensorsDiag "" 0xC SYMBOL_TYPE_LINK "RideSensorsDiag" /begin STRUCTURE_COMPONENT circChk tDiagnos 0 SYMBOL_TYPE_LINK "circChk" /end STRUCTURE_COMPONENT /begin STRUCTURE_COMPONENT circRatyChk tDiagnos 4 SYMBOL_TYPE_LINK "circRatyChk" /end STRUCTURE_COMPONENT /begin STRUCTURE_COMPONENT oorChk tDiagnos 8 SYMBOL_TYPE_LINK "oorChk" /end STRUCTURE_COMPONENT /end TYPEDEF_STRUCTURE
/begin TYPEDEF_STRUCTURE TsmIceTurtleMaskFlags "" 0x4 SYMBOL_TYPE_LINK "TsmIceTurtleMaskFlags"
 /begin STRUCTURE_COMPONENT _bit_fill_ uint32_t_0xFFFFFFF0 0 SYMBOL_TYPE_LINK "_bit_fill_" /end STRUCTURE_COMPONENT
 /begin STRUCTURE_COMPONENT iceCtrlStUnavailable uint32_t_0x8 0 SYMBOL_TYPE_LINK "iceCtrlStUnavailable" /end STRUCTURE_COMPONENT
 /begin STRUCTURE_COMPONENT hvBattOverChrg uint32_t_0x4 0 SYMBOL_TYPE_LINK "hvBattOverChrg" /end STRUCTURE_COMPONENT
 /begin STRUCTURE_COMPONENT elecMotFault uint32_t_0x2 0 SYMBOL_TYPE_LINK "elecMotFault" /end STRUCTURE_COMPONENT
 /begin STRUCTURE_COMPONENT cenCluFault uint32_t_0x1 0 SYMBOL_TYPE_LINK "cenCluFault" /end STRUCTURE_COMPONENT
/end TYPEDEF_STRUCTURE
/begin TYPEDEF_STRUCTURE TorqueLimitFlags "" 0x2 SYMBOL_TYPE_LINK "TorqueLimitFlags" /begin STRUCTURE_COMPONENT _bit_fill_ uint16_t_0xFC00 0 SYMBOL_TYPE_LINK "_bit_fill_" /end STRUCTURE_COMPONENT
 /begin STRUCTURE_COMPONENT tireMaxLimActv uint16_t_0x200 0 SYMBOL_TYPE_LINK "tireMaxLimActv" /end STRUCTURE_COMPONENT
 /begin STRUCTURE_COMPONENT tireTcLimActv uint16_t_0x100 0 SYMBOL_TYPE_LINK "tireTcLimActv" /end STRUCTURE_COMPONENT
 /begin STRUCTURE_COMPONENT cluMaxTqLimActv uint16_t_0x80 0 SYMBOL_TYPE_LINK "cluMaxTqLimActv" /end STRUCTURE_COMPONENT
 /begin STRUCTURE_COMPONENT cluFbTqLimActv uint16_t_0x40 0 SYMBOL_TYPE_LINK "cluFbTqLimActv" /end STRUCTURE_COMPONENT
 /begin STRUCTURE_COMPONENT cluDrvCfgLimActv uint16_t_0x20 0 SYMBOL_TYPE_LINK "cluDrvCfgLimActv" /end STRUCTURE_COMPONENT
 /begin STRUCTURE_COMPONENT cptTqLimActv uint16_t_0x10 0 SYMBOL_TYPE_LINK "cptTqLimActv" /end STRUCTURE_COMPONENT
 /begin STRUCTURE_COMPONENT cptCenCluTqLimActv uint16_t_0x8 0 SYMBOL_TYPE_LINK "cptCenCluTqLimActv" /end STRUCTURE_COMPONENT
 /begin STRUCTURE_COMPONENT cptRePinionTqLimActv uint16_t_0x4 0 SYMBOL_TYPE_LINK "cptRePinionTqLimActv" /end STRUCTURE_COMPONENT
 /begin STRUCTURE_COMPONENT cptInvSpdCtrlTqLimActv uint16_t_0x2 0 SYMBOL_TYPE_LINK "cptInvSpdCtrlTqLimActv" /end STRUCTURE_COMPONENT
 /begin STRUCTURE_COMPONENT actrLimActv uint16_t_0x1 0 SYMBOL_TYPE_LINK "actrLimActv" /end STRUCTURE_COMPONENT
/end TYPEDEF_STRUCTURE
/begin TYPEDEF_STRUCTURE TsmLimpMaskFlags "" 0x4 SYMBOL_TYPE_LINK "TsmLimpMaskFlags"
 /begin STRUCTURE_COMPONENT _bit_fill_ uint32_t_0xFFFFFFE0 0 SYMBOL_TYPE_LINK "_bit_fill_" /end STRUCTURE_COMPONENT
 /begin STRUCTURE_COMPONENT bPropshPumpCtrlFlt uint32_t_0x10 0 SYMBOL_TYPE_LINK "bPropshPumpCtrlFlt" /end STRUCTURE_COMPONENT
 /begin STRUCTURE_COMPONENT bFrontAxleClosedFault uint32_t_0x8 0 SYMBOL_TYPE_LINK "bFrontAxleClosedFault" /end STRUCTURE_COMPONENT
 /begin STRUCTURE_COMPONENT bRearAxleClosedFault uint32_t_0x4 0 SYMBOL_TYPE_LINK "bRearAxleClosedFault" /end STRUCTURE_COMPONENT
 /begin STRUCTURE_COMPONENT elSysLimp uint32_t_0x2 0 SYMBOL_TYPE_LINK "elSysLimp" /end STRUCTURE_COMPONENT
 /begin STRUCTURE_COMPONENT iceSysLimp uint32_t_0x1 0 SYMBOL_TYPE_LINK "iceSysLimp" /end STRUCTURE_COMPONENT
/end TYPEDEF_STRUCTURE
/begin TYPEDEF_STRUCTURE RideHeightControlErrorStructB "" 0x2 SYMBOL_TYPE_LINK "RideHeightControlErrorStructB"
 /begin STRUCTURE_COMPONENT rideFrontLeftNoReachPosInTime uint16_t_0x2 0 SYMBOL_TYPE_LINK "rideFrontLeftNoReachPosInTime" /end STRUCTURE_COMPONENT
 /begin STRUCTURE_COMPONENT rideFrontRightNoReachPosInTime uint16_t_0x1 0 SYMBOL_TYPE_LINK "rideFrontRightNoReachPosInTime" /end STRUCTURE_COMPONENT
 /begin STRUCTURE_COMPONENT rideRearLeftNoReachPosInTime uint16_t_0x80 1 SYMBOL_TYPE_LINK "rideRearLeftNoReachPosInTime" /end STRUCTURE_COMPONENT
 /begin STRUCTURE_COMPONENT rideRearRightNoReachPosInTime uint16_t_0x40 1 SYMBOL_TYPE_LINK "rideRearRightNoReachPosInTime" /end STRUCTURE_COMPONENT
 /begin STRUCTURE_COMPONENT _reserved_0 uint16_t_0x20 1 SYMBOL_TYPE_LINK "_reserved_0" /end STRUCTURE_COMPONENT
 /begin STRUCTURE_COMPONENT _reserved_1 uint16_t_0x10 1 SYMBOL_TYPE_LINK "_reserved_1" /end STRUCTURE_COMPONENT
 /begin STRUCTURE_COMPONENT rideFrontLeftTooManyRetries uint16_t_0x8 1 SYMBOL_TYPE_LINK "rideFrontLeftTooManyRetries" /end STRUCTURE_COMPONENT
 /begin STRUCTURE_COMPONENT rideFrontRightTooManyRetries uint16_t_0x4 1 SYMBOL_TYPE_LINK "rideFrontRightTooManyRetries" /end STRUCTURE_COMPONENT
 /begin STRUCTURE_COMPONENT rideRearLeftTooManyRetries uint16_t_0x2 1 SYMBOL_TYPE_LINK "rideRearLeftTooManyRetries" /end STRUCTURE_COMPONENT
 /begin STRUCTURE_COMPONENT rideRearRightTooManyRetries uint16_t_0x1 1 SYMBOL_TYPE_LINK "rideRearRightTooManyRetries" /end STRUCTURE_COMPONENT
/end TYPEDEF_STRUCTURE
/begin TYPEDEF_STRUCTURE TsmTqOffMaskFlags "" 0x4 SYMBOL_TYPE_LINK "TsmTqOffMaskFlags"
 /begin STRUCTURE_COMPONENT _bit_fill_ uint32_t_0xFFFFFFC0 0 SYMBOL_TYPE_LINK "_bit_fill_" /end STRUCTURE_COMPONENT
 /begin STRUCTURE_COMPONENT elSysSt uint32_t_0x20 0 SYMBOL_TYPE_LINK "elSysSt" /end STRUCTURE_COMPONENT
 /begin STRUCTURE_COMPONENT pwrSt uint32_t_0x10 0 SYMBOL_TYPE_LINK "pwrSt" /end STRUCTURE_COMPONENT
 /begin STRUCTURE_COMPONENT cTsmStateEnableMask uint32_t_0x8 0 SYMBOL_TYPE_LINK "cTsmStateEnableMask" /end STRUCTURE_COMPONENT
 /begin STRUCTURE_COMPONENT ptCriticalFault uint32_t_0x4 0 SYMBOL_TYPE_LINK "ptCriticalFault" /end STRUCTURE_COMPONENT
 /begin STRUCTURE_COMPONENT iceStUnavl uint32_t_0x2 0 SYMBOL_TYPE_LINK "iceStUnavl" /end STRUCTURE_COMPONENT
 /begin STRUCTURE_COMPONENT cTestTsmMstSwt uint32_t_0x1 0 SYMBOL_TYPE_LINK "cTestTsmMstSwt" /end STRUCTURE_COMPONENT
/end TYPEDEF_STRUCTURE
/begin INSTANCE taskInverterHandler "" TaskInverterHandler 0x40034460 READ_WRITE SYMBOL_LINK "taskInverterHandler" 0
 /begin IF_DATA XCP
  /begin DAQ_EVENT VARIABLE /begin DEFAULT_EVENT_LIST EVENT 3 /end DEFAULT_EVENT_LIST /end DAQ_EVENT
 /end IF_DATA
/end INSTANCE
/begin INSTANCE taskInverterCtrl "" TaskInverterCtrl 0x400344B0 READ_WRITE SYMBOL_LINK "taskInverterCtrl" 0
 /begin IF_DATA XCP
  /begin DAQ_EVENT VARIABLE /begin DEFAULT_EVENT_LIST EVENT 3 /end DEFAULT_EVENT_LIST /end DAQ_EVENT
 /end IF_DATA
/end INSTANCE
/begin INSTANCE taskTqStruct "" TaskTqStruct 0x40034870 READ_WRITE SYMBOL_LINK "taskTqStruct" 0
 /begin IF_DATA XCP
  /begin DAQ_EVENT VARIABLE /begin DEFAULT_EVENT_LIST EVENT 3 /end DEFAULT_EVENT_LIST /end DAQ_EVENT
 /end IF_DATA
/end INSTANCE
/begin INSTANCE taskTqMgr "" TaskTqMgr 0x40034CA0 READ_WRITE SYMBOL_LINK "taskTqMgr" 0
 /begin IF_DATA XCP
  /begin DAQ_EVENT VARIABLE /begin DEFAULT_EVENT_LIST EVENT 3 /end DEFAULT_EVENT_LIST /end DAQ_EVENT
 /end IF_DATA
/end INSTANCE
/begin INSTANCE taskRideHeight "" TaskRideHeight 0x400369B8 READ_WRITE SYMBOL_LINK "taskRideHeight" 0
 /begin IF_DATA XCP
  /begin DAQ_EVENT VARIABLE /begin DEFAULT_EVENT_LIST EVENT 3 /end DEFAULT_EVENT_LIST /end DAQ_EVENT
 /end IF_DATA
/end INSTANCE
/begin INSTANCE taskNetworkManagement "" TaskNetworkManagement 0x400372C8 READ_WRITE SYMBOL_LINK "taskNetworkManagement" 0
 /begin IF_DATA XCP
  /begin DAQ_EVENT VARIABLE /begin DEFAULT_EVENT_LIST EVENT 3 /end DEFAULT_EVENT_LIST /end DAQ_EVENT
 /end IF_DATA
/end INSTANCE
/begin INSTANCE taskWhlCluCtrl1ms "" TaskWhlCluCtrl1ms 0x4003745C READ_WRITE SYMBOL_LINK "taskWhlCluCtrl1ms" 0
 /begin IF_DATA XCP
  /begin DAQ_EVENT VARIABLE /begin DEFAULT_EVENT_LIST EVENT 3 /end DEFAULT_EVENT_LIST /end DAQ_EVENT
 /end IF_DATA
/end INSTANCE
/begin INSTANCE taskThermal "" TaskThermalManager 0x4003788C READ_WRITE SYMBOL_LINK "taskThermal" 0
 /begin IF_DATA XCP
  /begin DAQ_EVENT VARIABLE /begin DEFAULT_EVENT_LIST EVENT 3 /end DEFAULT_EVENT_LIST /end DAQ_EVENT
 /end IF_DATA
/end INSTANCE
/begin INSTANCE taskNvmTrigger "" tTaskNvmTrigger 0x40037B78 READ_WRITE SYMBOL_LINK "taskNvmTrigger" 0
 /begin IF_DATA XCP
  /begin DAQ_EVENT VARIABLE /begin DEFAULT_EVENT_LIST EVENT 3 /end DEFAULT_EVENT_LIST /end DAQ_EVENT
 /end IF_DATA
/end INSTANCE
/begin COMPU_METHOD tFactor "" IDENTICAL "%.6" "" /end COMPU_METHOD
/begin COMPU_METHOD tFraction "" IDENTICAL "%.6" "" /end COMPU_METHOD
/begin COMPU_METHOD tFactor_1000_S16 "" LINEAR "%.3" "-" COEFFS_LINEAR 0.001000 0 /end COMPU_METHOD
/begin COMPU_METHOD tPercent_100_S16 "" LINEAR "%.2" "%" COEFFS_LINEAR 0.010000 0 /end COMPU_METHOD
/begin COMPU_METHOD tPercent_S8 "" IDENTICAL "%.0" "%" /end COMPU_METHOD
/begin COMPU_METHOD tSecond "" IDENTICAL "%.3" "s" /end COMPU_METHOD
/begin COMPU_METHOD tHertz "" IDENTICAL "%.3" "Hz" /end COMPU_METHOD
/begin COMPU_METHOD tHertz_10_S16 "" LINEAR "%.1" "Hz" COEFFS_LINEAR 0.100000 0 /end COMPU_METHOD
/begin COMPU_METHOD tMillisecond "" IDENTICAL "%.3" "ms" /end COMPU_METHOD
/begin COMPU_METHOD tMillisecond_U32 "" IDENTICAL "%.3" "ms" /end COMPU_METHOD
/begin COMPU_METHOD tMillimetre_10_S16 "" LINEAR "%.1" "mm" COEFFS_LINEAR 0.100000 0 /end COMPU_METHOD
/begin COMPU_METHOD tKilometrePerHour "" IDENTICAL "%.3" "km/h" /end COMPU_METHOD
/begin COMPU_METHOD tKilometrePerHour_S16 "" IDENTICAL "%.0" "km/h" /end COMPU_METHOD
/begin COMPU_METHOD tKilometrePerHour_10_S16 "" LINEAR "%.1" "km/h" COEFFS_LINEAR 0.100000 0 /end COMPU_METHOD
/begin COMPU_METHOD tMetrePerSquareSecond "" IDENTICAL "%.3" "m/s2" /end COMPU_METHOD
/begin COMPU_METHOD tRadian "" IDENTICAL "%.3" "rad" /end COMPU_METHOD
/begin COMPU_METHOD tDegree "" IDENTICAL "%.3" "deg" /end COMPU_METHOD
/begin COMPU_METHOD tDegree_10_S16 "" LINEAR "%.1" "deg" COEFFS_LINEAR 0.100000 0 /end COMPU_METHOD
/begin COMPU_METHOD tRadianPerSecond "" IDENTICAL "%.3" "rad/s" /end COMPU_METHOD
/begin COMPU_METHOD tRevolutionPerMinute "" IDENTICAL "%.3" "rpm" /end COMPU_METHOD
/begin COMPU_METHOD tRevolutionPerMinute_S16 "" IDENTICAL "%.0" "rpm" /end COMPU_METHOD
/begin COMPU_METHOD tRadianPerSquareSecond "" IDENTICAL "%.3" "rad/s2" /end COMPU_METHOD
/begin COMPU_METHOD tNewtonMetre "" IDENTICAL "%.3" "Nm" /end COMPU_METHOD
/begin COMPU_METHOD tNewtonMetrePerBar "" IDENTICAL "%.2" "Nm/bar" /end COMPU_METHOD
/begin COMPU_METHOD tKilowatt "" IDENTICAL "%.3" "kW" /end COMPU_METHOD
/begin COMPU_METHOD tWatt "" IDENTICAL "%.1" "W" /end COMPU_METHOD
/begin COMPU_METHOD tJoule "" IDENTICAL "%.1" "J" /end COMPU_METHOD
/begin COMPU_METHOD tMegaJoule "" IDENTICAL "%.6" "MJ" /end COMPU_METHOD
/begin COMPU_METHOD tMegaJoule_U32 "" IDENTICAL "%.0" "MJ" /end COMPU_METHOD
/begin COMPU_METHOD tCelsius_10_S16 "" LINEAR "%.1" "C" COEFFS_LINEAR 0.100000 0 /end COMPU_METHOD
/begin COMPU_METHOD tBar "" IDENTICAL "%.3" "bar" /end COMPU_METHOD
/begin COMPU_METHOD tBar_100_S16 "" LINEAR "%.2" "bar" COEFFS_LINEAR 0.010000 0 /end COMPU_METHOD
/begin COMPU_METHOD tAmpere "" IDENTICAL "%.3" "A" /end COMPU_METHOD
/begin COMPU_METHOD tMillivolt_S16 "" IDENTICAL "%.0" "mV" /end COMPU_METHOD
/begin COMPU_METHOD tHex_U16 "" IDENTICAL "%.0" "HEX" /end COMPU_METHOD
/begin COMPU_METHOD tQualifier "" TAB_VERB "%.0" "" COMPU_TAB_REF tQualifier /end COMPU_METHOD
/begin COMPU_METHOD tSign "" TAB_VERB "%.0" "" COMPU_TAB_REF tSign /end COMPU_METHOD
/begin COMPU_METHOD tCluIdx "" TAB_VERB "%.0" "" COMPU_TAB_REF tCluIdx /end COMPU_METHOD
/begin COMPU_METHOD tCluCtrlState "" TAB_VERB "%.0" "" COMPU_TAB_REF tCluCtrlState /end COMPU_METHOD
/begin COMPU_METHOD tDiagnos "" TAB_VERB "%.0" "" COMPU_TAB_REF tDiagnos /end COMPU_METHOD
/begin COMPU_METHOD tIntegratorState "" TAB_VERB "%.0" "" COMPU_TAB_REF tIntegratorState /end COMPU_METHOD
/begin COMPU_METHOD tRateControllerGainSet "" TAB_VERB "%.0" "" COMPU_TAB_REF tRateControllerGainSet /end COMPU_METHOD
/begin COMPU_METHOD tTqMacSt "" TAB_VERB "%.0" "" COMPU_TAB_REF tTqMacSt /end COMPU_METHOD
/begin COMPU_METHOD tPropshaftStationaryCrankState "" TAB_VERB "%.0" "" COMPU_TAB_REF tPropshaftStationaryCrankState /end COMPU_METHOD
/begin COMPU_METHOD tPropshaftDrivingCrankState "" TAB_VERB "%.0" "" COMPU_TAB_REF tPropshaftDrivingCrankState /end COMPU_METHOD
/begin COMPU_METHOD tPropulsionMode "" TAB_VERB "%.0" "" COMPU_TAB_REF tPropulsionMode /end COMPU_METHOD
/begin COMPU_METHOD tDriveConfiguration "" TAB_VERB "%.0" "" COMPU_TAB_REF tDriveConfiguration /end COMPU_METHOD
/begin COMPU_METHOD tDriveMode "" TAB_VERB "%.0" "" COMPU_TAB_REF tDriveMode /end COMPU_METHOD
/begin COMPU_METHOD tGear "" TAB_VERB "%.0" "" COMPU_TAB_REF tGear /end COMPU_METHOD
/begin COMPU_METHOD tPerformanceMode "" TAB_VERB "%.0" "" COMPU_TAB_REF tPerformanceMode /end COMPU_METHOD
/begin COMPU_METHOD tPerformanceModeRHC "" TAB_VERB "%.0" "" COMPU_TAB_REF tPerformanceModeRHC /end COMPU_METHOD
/begin COMPU_METHOD tAxleSystemState "" TAB_VERB "%.0" "" COMPU_TAB_REF tAxleSystemState /end COMPU_METHOD
/begin COMPU_METHOD tTorqueSystemState "" TAB_VERB "%.0" "" COMPU_TAB_REF tTorqueSystemState /end COMPU_METHOD
/begin COMPU_METHOD tPowerState "" TAB_VERB "%.0" "" COMPU_TAB_REF tPowerState /end COMPU_METHOD
/begin COMPU_METHOD tRollingState "" TAB_VERB "%.0" "" COMPU_TAB_REF tRollingState /end COMPU_METHOD
/begin COMPU_METHOD tClutchState "" TAB_VERB "%.0" "" COMPU_TAB_REF tClutchState /end COMPU_METHOD
/begin COMPU_METHOD tTakeoffState "" TAB_VERB "%.0" "" COMPU_TAB_REF tTakeoffState /end COMPU_METHOD
/begin COMPU_METHOD tIdleState "" TAB_VERB "%.0" "" COMPU_TAB_REF tIdleState /end COMPU_METHOD
/begin COMPU_METHOD tRampState "" TAB_VERB "%.0" "" COMPU_TAB_REF tRampState /end COMPU_METHOD
/begin COMPU_METHOD tCombustionEngineControlState "" TAB_VERB "%.0" "" COMPU_TAB_REF tCombustionEngineControlState /end COMPU_METHOD
/begin COMPU_METHOD tSupportingMode "" TAB_VERB "%.0" "" COMPU_TAB_REF tSupportingMode /end COMPU_METHOD
/begin COMPU_METHOD tFrictionBrakeTorqueArbitrationMode "" TAB_VERB "%.0" "" COMPU_TAB_REF tFrictionBrakeTorqueArbitrationMode /end COMPU_METHOD
/begin COMPU_METHOD tFunctionStatus "" TAB_VERB "%.0" "" COMPU_TAB_REF tFunctionStatus /end COMPU_METHOD
/begin COMPU_METHOD tHybSmState "" TAB_VERB "%.0" "" COMPU_TAB_REF tHybSmState /end COMPU_METHOD
/begin COMPU_METHOD tInvSmStatus "" TAB_VERB "%.0" "" COMPU_TAB_REF tInvSmStatus /end COMPU_METHOD
/begin COMPU_METHOD tInvCtrlMode "" TAB_VERB "%.0" "" COMPU_TAB_REF tInvCtrlMode /end COMPU_METHOD
/begin COMPU_METHOD tInvSpdCtrlGainSet "" TAB_VERB "%.0" "" COMPU_TAB_REF tInvSpdCtrlGainSet /end COMPU_METHOD
/begin COMPU_METHOD tLiftIndication "" TAB_VERB "%.0" "" COMPU_TAB_REF tLiftIndication /end COMPU_METHOD
/begin COMPU_METHOD tLiftState "" TAB_VERB "%.0" "" COMPU_TAB_REF tLiftState /end COMPU_METHOD
/begin COMPU_METHOD tLiftMovement "" TAB_VERB "%.0" "" COMPU_TAB_REF tLiftMovement /end COMPU_METHOD
/begin COMPU_METHOD tRideHeightMode "" TAB_VERB "%.0" "" COMPU_TAB_REF tRideHeightMode /end COMPU_METHOD
/begin COMPU_METHOD tRideHeightRollCompensationState "" TAB_VERB "%.0" "" COMPU_TAB_REF tRideHeightRollCompensationState /end COMPU_METHOD
/begin COMPU_METHOD tPressureReqRsn "" TAB_VERB "%.0" "" COMPU_TAB_REF tPressureReqRsn /end COMPU_METHOD
/begin COMPU_METHOD tPropshaftChargeState "" TAB_VERB "%.0" "" COMPU_TAB_REF tPropshaftChargeState /end COMPU_METHOD
/begin COMPU_METHOD tSleepMode "" TAB_VERB "%.0" "" COMPU_TAB_REF tSleepMode /end COMPU_METHOD
/begin COMPU_METHOD tGpggaQuality "" TAB_VERB "%.0" "" COMPU_TAB_REF tGpggaQuality /end COMPU_METHOD
/begin COMPU_METHOD tTaskIdentifier "" TAB_VERB "%.0" "" COMPU_TAB_REF tTaskIdentifier /end COMPU_METHOD
/begin COMPU_METHOD tLiftCalibState "" TAB_VERB "%.0" "" COMPU_TAB_REF tLiftCalibState /end COMPU_METHOD
/begin COMPU_METHOD tCluCtrlType "" TAB_VERB "%.0" "" COMPU_TAB_REF tCluCtrlType /end COMPU_METHOD
/begin COMPU_METHOD tThermalUnitFailReason "" TAB_VERB "%.0" "" COMPU_TAB_REF tThermalUnitFailReason /end COMPU_METHOD
/begin COMPU_METHOD tPrelCluReqSt "" TAB_VERB "%.0" "" COMPU_TAB_REF tPrelCluReqSt /end COMPU_METHOD
/begin COMPU_METHOD tAcknowledgementStatus "" TAB_VERB "%.0" "" COMPU_TAB_REF tAcknowledgementStatus /end COMPU_METHOD
/begin COMPU_METHOD tPumpModel "" TAB_VERB "%.0" "" COMPU_TAB_REF tPumpModel /end COMPU_METHOD
/begin COMPU_METHOD tRideHeightControlStrategy "" TAB_VERB "%.0" "" COMPU_TAB_REF tRideHeightControlStrategy /end COMPU_METHOD
/begin COMPU_METHOD tNmRequest "" TAB_VERB "%.0" "" COMPU_TAB_REF tNmRequest /end COMPU_METHOD
/begin COMPU_METHOD tThermalDiagStatus "" TAB_VERB "%.0" "" COMPU_TAB_REF tThermalDiagStatus /end COMPU_METHOD
/begin COMPU_METHOD tEnableHold "" TAB_VERB "%.0" "" COMPU_TAB_REF tEnableHold /end COMPU_METHOD
/begin COMPU_METHOD tInvState "" TAB_VERB "%.0" "" COMPU_TAB_REF tInvState /end COMPU_METHOD
/begin COMPU_METHOD tFanModel "" TAB_VERB "%.0" "" COMPU_TAB_REF tFanModel /end COMPU_METHOD
/begin COMPU_METHOD tSlaveErrorStatus "" TAB_VERB "%.0" "" COMPU_TAB_REF tSlaveErrorStatus /end COMPU_METHOD
/begin COMPU_METHOD tFaultLevel "" TAB_VERB "%.0" "" COMPU_TAB_REF tFaultLevel /end COMPU_METHOD
/begin COMPU_METHOD tYawTorqueRequestSaturation "" TAB_VERB "%.0" "" COMPU_TAB_REF tYawTorqueRequestSaturation /end COMPU_METHOD
/begin COMPU_METHOD tPowerSupply "" TAB_VERB "%.0" "" COMPU_TAB_REF tPowerSupply /end COMPU_METHOD
/begin COMPU_METHOD tNmSlaveStatus "" TAB_VERB "%.0" "" COMPU_TAB_REF tNmSlaveStatus /end COMPU_METHOD
/begin COMPU_VTAB tQualifier "" TAB_VERB 4 0 "Q_NOT_INITIALIZED" 1 "Q_FAULTY" 2 "Q_NORMAL" 3 "Q_LOW_QUALITY" /end COMPU_VTAB
/begin COMPU_VTAB tSign "" TAB_VERB 2 -1 "SIGN_NEGATIVE" 0 "SIGN_ZERO" 1 "SIGN_POSITIVE" /end COMPU_VTAB
/begin COMPU_VTAB tCluIdx "" TAB_VERB 5 0 "CLU_FL" 1 "CLU_FR" 2 "CLU_RL" 3 "CLU_RR" 4 "NUM_OF_CLU" /end COMPU_VTAB
/begin COMPU_VTAB tCluCtrlState "" TAB_VERB 7 0 "CLU_CTRL_DISENGAGED" 1 "CLU_CTRL_TINYFILL" 2 "CLU_CTRL_FASTFILL_PEAK" 3 "CLU_CTRL_FASTFILL_HOLD" 4 "CLU_CTRL_FASTFILL_END" 5 "CLU_CTRL_ENGAGED" 6 "CLU_CTRL_ENGAGED_PWM" /end COMPU_VTAB
/begin COMPU_VTAB tDiagnos "" TAB_VERB 3 0 "DIAG_UNKNOWN" 1 "DIAG_BAD" 2 "DIAG_OK" /end COMPU_VTAB
/begin COMPU_VTAB tIntegratorState "" TAB_VERB 5 0 "INTGTR_RESET" 1 "INTGTR_FREEZE" 2 "INTGTR_LIMIT" 3 "INTGTR_INTEGRATE" 4 "INTGTR_INITIALIZE" /end COMPU_VTAB
/begin COMPU_VTAB tRateControllerGainSet "" TAB_VERB 3 0 "PROPSH_CTRL_ST_CEN_CLU_EG" 1 "PROPSH_CTRL_ST_CEN_CLU_DISEG_ELEC_FWD" 2 "PROPSH_CTRL_ST_CEN_CLU_DISEG_ICE_RWD" /end COMPU_VTAB
/begin COMPU_VTAB tTqMacSt "" TAB_VERB 21 0 "TQ_MAC_ST_UNKNOWN" 1 "TQ_MAC_ST_TQ_OFF" 2 "TQ_MAC_ST_ELEC_IDLE" 3 "TQ_MAC_ST_ELEC_DRIVE" 4 "TQ_MAC_ST_CRK_PARK" 5 "TQ_MAC_ST_CRK_STATY" 6 "TQ_MAC_ST_CRK_DRVG" 7 "TQ_MAC_ST_HYB_IDLE" 8 "TQ_MAC_ST_HYB_DRV" 9 "TQ_MAC_ST_HYB_DECOUPL_IDLE" 10 "TQ_MAC_ST_HYB_DECOUPL_DRV" 11 "TQ_MAC_ST_HYB_RVSG" 12 "TQ_MAC_ST_HYB_LNCH" 13 "TQ_MAC_ST_ICE_IDLE" 14 "TQ_MAC_ST_ICE_DRIVE" 15 "TQ_MAC_ST_ICE_RVSG" 16 "TQ_MAC_ST_ELEC_TURTLE" 17 "TQ_MAC_ST_ELEC_TURTLE_IDLE" 18 "TQ_MAC_ST_ICE_TURTLE" 19 "TQ_MAC_ST_ICE_TURTLE_IDLE" 20 "TQ_MAC_ST_LENGTH" /end COMPU_VTAB
/begin COMPU_VTAB tPropshaftStationaryCrankState "" TAB_VERB 6 0 "STATY_CRK_ST_INIT" 1 "STATY_CRK_ST_COUPLE" 2 "STATY_CRK_ST_SYNC" 3 "STATY_CRK_ST_START" 4 "STATY_CRK_ST_RUNNING" 5 "STATY_CRK_ST_FAULT" /end COMPU_VTAB
/begin COMPU_VTAB tPropshaftDrivingCrankState "" TAB_VERB 4 0 "DRVG_CRK_ST_INIT" 1 "DRVG_CRK_ST_COUPLE" 2 "DRVG_CRK_ST_START" 3 "DRVG_CRK_ST_FAULT" /end COMPU_VTAB
/begin COMPU_VTAB tPropulsionMode "" TAB_VERB 5 0 "PRPL_MOD_UNKNOWN" 1 "PRPL_MOD_ELEC_FORCED" 2 "PRPL_MOD_ELEC" 3 "PRPL_MOD_HYBRID" 4 "PRPL_MOD_ICE_FORCED" /end COMPU_VTAB
/begin COMPU_VTAB tDriveConfiguration "" TAB_VERB 4 0 "DRV_CFG_UNKNOWN" 1 "DRV_CFG_AWD" 2 "DRV_CFG_FWD" 3 "DRV_CFG_RWD" /end COMPU_VTAB
/begin COMPU_VTAB tDriveMode "" TAB_VERB 6 0 "DRV_MOD_UNKNOWN" 1 "DRV_MOD_PARK" 2 "DRV_MOD_NEUTRAL" 3 "DRV_MOD_REVERSE" 4 "DRV_MOD_DRIVE" 5 "NUM_OF_DRV_MOD" /end COMPU_VTAB
/begin COMPU_VTAB tGear "" TAB_VERB 11 0 "GEAR_INVALID" 1 "GEAR_1" 2 "GEAR_2" 3 "GEAR_3" 4 "GEAR_4" 5 "GEAR_5" 6 "GEAR_6" 7 "GEAR_7" 8 "GEAR_8" 9 "GEAR_9" 10 "GEAR_N" /end COMPU_VTAB
/begin COMPU_VTAB tPerformanceMode "" TAB_VERB 8 0 "PERF_MOD_UNKNOWN" 1 "PERF_MOD_GHOST_EV" 2 "PERF_MOD_COMFORT" 3 "PERF_MOD_WET_SNOW" 4 "PERF_MOD_SPORT" 5 "PERF_MOD_TRACK" 6 "PERF_MOD_INDIVIDUAL" 7 "NUM_OF_PERF_MOD" /end COMPU_VTAB
/begin COMPU_VTAB tPerformanceModeRHC "" TAB_VERB 4 0 "RHC_PERF_MOD_UKWN" 1 "RHC_PERF_MOD_LOW" 2 "RHC_PERF_MOD_MED" 3 "RHC_PERF_MOD_HIGH" /end COMPU_VTAB
/begin COMPU_VTAB tAxleSystemState "" TAB_VERB 4 0 "AXLE_SYS_ST_UNKNOWN" 1 "AXLE_SYS_ST_CRITICAL_FAULT" 2 "AXLE_SYS_ST_LIMP" 3 "AXLE_SYS_ST_NORMAL" /end COMPU_VTAB
/begin COMPU_VTAB tTorqueSystemState "" TAB_VERB 6 0 "TQ_SYS_ST_UNKNOWN" 1 "TQ_SYS_ST_CRITICAL_FAULT" 2 "TQ_SYS_ST_TURTLE_ELEC" 3 "TQ_SYS_ST_TURTLE_ICE" 4 "TQ_SYS_ST_LIMP" 5 "TQ_SYS_ST_NORMAL" /end COMPU_VTAB
/begin COMPU_VTAB tPowerState "" TAB_VERB 16 0 "PWR_ST_UNAVL" 1 "PWR_ST_SLEEP" 2 "PWR_ST_THERM_MNGT" 3 "PWR_ST_POST_CRASH" 4 "PWR_ST_INTRUSION" 5 "PWR_ST_BATT_CHRGN" 6 "PWR_ST_USR_ACS" 7 "PWR_ST_IGN" 8 "PWR_ST_FLASHING" 15 "PWR_ST_INVLD" /end COMPU_VTAB
/begin COMPU_VTAB tRollingState "" TAB_VERB 5 0 "ROLLING_UNKNOWN" 1 "ROLLING_STATIONARY" 2 "ROLLING_FORWARD" 3 "ROLLING_REARWARD" 4 "ROLLING_OVERSPEED" /end COMPU_VTAB
/begin COMPU_VTAB tClutchState "" TAB_VERB 8 0 "CLU_ST_UNKNOWN" 1 "CLU_ST_DISENGAGED" 2 "CLU_ST_TQ_CTRL" 3 "CLU_ST_SLIP_CTRL" 4 "CLU_ST_ENGAGED" 5 "CLU_ST_FAULT_ENGAGED" 6 "CLU_ST_FAULT_DISENGAGED" 7 "CLU_ST_FAULT_SHUTDOWN" /end COMPU_VTAB
/begin COMPU_VTAB tTakeoffState "" TAB_VERB 5 0 "TAKEOFF_ST_SPD_RAMP" 1 "TAKEOFF_ST_COUPLE" 2 "TAKEOFF_ST_READY" 3 "TAKEOFF_ST_TQ_RAMP" 4 "TAKEOFF_ST_DRIVE" /end COMPU_VTAB
/begin COMPU_VTAB tIdleState "" TAB_VERB 5 0 "IDLE_ST_SPD_RAMP" 1 "IDLE_ST_COUPLE" 2 "IDLE_ST_IDLING" 3 "IDLE_ST_REVVING" 4 "IDLE_ST_DECOUPL" /end COMPU_VTAB
/begin COMPU_VTAB tRampState "" TAB_VERB 3 0 "RAMP_ST_ZERO" 1 "RAMP_ST_RAMPING" 2 "RAMP_ST_VALUE" /end COMPU_VTAB
/begin COMPU_VTAB tCombustionEngineControlState "" TAB_VERB 7 0 "ICE_ST_UNKNOWN" 1 "ICE_ST_OFF" 2 "ICE_ST_DECOUPL_IDLE" 3 "ICE_ST_DECOUPL_SPD_CTRL" 4 "ICE_ST_COUPL_TQ_CTRL" 5 "ICE_ST_COUPL_SPD_CTRL" 6 "ICE_ST_UNAVAILABLE" /end COMPU_VTAB
/begin COMPU_VTAB tSupportingMode "" TAB_VERB 7 0 "SUPPG_MOD_UNKNOWN" 1 "SUPPG_MOD_NONE" 2 "SUPPG_MOD_LIFT" 3 "SUPPG_MOD_DYNO" 4 "SUPPG_MOD_DAMP_SERV" 5 "SUPPG_MOD_TRANSPORT" 6 "SUPPG_MOD_STAGE" /end COMPU_VTAB
/begin COMPU_VTAB tFrictionBrakeTorqueArbitrationMode "" TAB_VERB 6 0 "FRIC_BRK_TQ_ARBN_MODE_UNKNOWN" 1 "FRIC_BRK_TQ_ARBN_MODE_UNAVL" 2 "FRIC_BRK_TQ_ARBN_MODE_VECT_FRNT_AXLE" 3 "FRIC_BRK_TQ_ARBN_MODE_VECT_RE_AXLE" 4 "FRIC_BRK_TQ_ARBN_MODE_RECUP_FRNT_AXLE" 5 "FRIC_BRK_TQ_ARBN_MODE_RECUP_RE_AXLE" /end COMPU_VTAB
/begin COMPU_VTAB tFunctionStatus "" TAB_VERB 4 0 "FCT_STS_UNKNOWN" 1 "FCT_STS_UNAVAILABLE" 2 "FCT_STS_AVAILABLE" 3 "FCT_STS_ACTIVE" /end COMPU_VTAB
/begin COMPU_VTAB tHybSmState "" TAB_VERB 7 0 "HYB_SM_OFF" 1 "HYB_SM_SHUTDOWN" 2 "HYB_SM_SAFESTATE" 3 "HYB_SM_PRECHARGING" 4 "HYB_SM_LIVE" 5 "HYB_SM_RUNNING" 6 "HYB_SM_CHARGING" /end COMPU_VTAB
/begin COMPU_VTAB tInvSmStatus "" TAB_VERB 6 0 "INV_SM_INIT" 1 "INV_SM_SELFCHECK" 2 "INV_SM_READY" 3 "INV_SM_RUNNING" 4 "INV_SM_SHUTDOWN" 5 "INV_SM_SAFESTATE" /end COMPU_VTAB
/begin COMPU_VTAB tInvCtrlMode "" TAB_VERB 4 0 "INV_CTRL_MODE_NONE" 1 "INV_CTRL_MODE_TORQUE" 2 "INV_CTRL_MODE_SPEED" 3 "INV_CTRL_MODE_MAX" /end COMPU_VTAB
/begin COMPU_VTAB tInvSpdCtrlGainSet "" TAB_VERB 8 0 "INV_GAIN_SET_0" 1 "INV_GAIN_SET_1" 2 "INV_GAIN_SET_2" 3 "INV_GAIN_SET_3" 4 "INV_GAIN_SET_4" 5 "INV_GAIN_SET_5" 6 "INV_GAIN_SET_6" 7 "INV_GAIN_SET_NUM" /end COMPU_VTAB
/begin COMPU_VTAB tLiftIndication "" TAB_VERB 6 0 "LIFT_IND_OFF" 1 "LIFT_IND_UP" 2 "LIFT_IND_LIFTING" 3 "LIFT_IND_PAUSED" 4 "LIFT_IND_LOWERING" 5 "LIFT_IND_DOWN" /end COMPU_VTAB
/begin COMPU_VTAB tLiftState "" TAB_VERB 7 0 "LIFT_ST_UNKNOWN" 1 "LIFT_ST_UP" 2 "LIFT_ST_CONTROL" 3 "LIFT_ST_LIFTING" 4 "LIFT_ST_PARTLYUP" 5 "LIFT_ST_LOWERING" 6 "LIFT_ST_PARTLYDOWN" /end COMPU_VTAB
/begin COMPU_VTAB tLiftMovement "" TAB_VERB 3 0 "LIFT_HOLD" 1 "LIFT_LOWER" 2 "LIFT_RAISE" /end COMPU_VTAB
/begin COMPU_VTAB tRideHeightMode "" TAB_VERB 9 0 "RIDE_MOD_OFF" 1 "RIDE_MOD_STOP" 2 "RIDE_MOD_CYCLE" 3 "RIDE_MOD_CALIBRATE" 4 "RIDE_MOD_MANUAL" 5 "RIDE_MOD_DYNO" 6 "RIDE_MOD_ACTIVE" 7 "RIDE_MOD_TRANSPORT" 8 "RIDE_MOD_SERVICE" /end COMPU_VTAB
/begin COMPU_VTAB tRideHeightRollCompensationState "" TAB_VERB 4 0 "RIDE_HEI_ROLL_COMP_INACTIVE" 1 "RIDE_HEI_ROLL_COMP_ACTIVE_NO_COMP" 2 "RIDE_HEI_ROLL_COMP_ACTIVE_LEFT_COMP" 3 "RIDE_HEI_ROLL_COMP_ACTIVE_RIGHT_COMP" /end COMPU_VTAB
/begin COMPU_VTAB tPressureReqRsn "" TAB_VERB 6 0 "PRR_UNKNOWN" 1 "PRR_NO_REQUEST" 2 "PRR_REGEN_COMPENSATION" 3 "PRR_YAW_TORQUE" 4 "PRR_COMP_YAW_TORQUE" 5 "PRR_AUTO_HILL_HOLD" /end COMPU_VTAB
/begin COMPU_VTAB tPropshaftChargeState "" TAB_VERB 3 0 "PRPSH_CHRG_ST_NO_CHRG" 1 "PRPSH_CHRG_ST_IDLE_CHRG" 2 "PRPSH_CHRG_ST_DRVG_CHRG" /end COMPU_VTAB
/begin COMPU_VTAB tSleepMode "" TAB_VERB 3 0 "SLEEP_UNKNOWN" 1 "SLEEP_NOT_OK_TO_SLEEP" 2 "SLEEP_OK_TO_SLEEP" /end COMPU_VTAB
/begin COMPU_VTAB tGpggaQuality "" TAB_VERB 9 0 "GPS_QUAL_NO_FIX" 1 "GPS_QUAL_SINGLE_POINT" 2 "GPS_QUAL_PSEUDO_RANGE" 3 "GPS_QUAL_RTK_FIXED" 4 "GPS_QUAL_RTK_FLOAT" 5 "GPS_QUAL_DEAD_RECKONING" 6 "GPS_QUAL_MANUAL_INPUT" 7 "GPS_QUAL_SIMULATION" 8 "GPS_QUAL_WAAS" /end COMPU_VTAB
/begin COMPU_VTAB tTaskIdentifier "" TAB_VERB 256 0 "TASKID_UNKNOWN" 1 "TASKID_IDLE" 2 "TASKID_SBC" 3 "TASKID_UDS" 4 "TASKID_UDS_TIMEOUT_HANDLER" 5 "TASKID_XCP" 6 "TASKID_VX1000" 7 "TASKID_CAN_A" 8 "TASKID_CAN_B" 9 "TASKID_CAN_C" 10 "TASKID_CAN_D" 11 "TASKID_CAN_E" 12 "TASKID_CAN_F" 13 "TASKID_INVERTER_CTRL" 14 "TASKID_INVERTER_SM" 15 "TASKID_HYBRID_SM" 16 "TASKID_HYBRID_TORQUE" 17 "TASKID_ENERGY_MANAGER" 18 "TASKID_TQ_STRUCT" 19 "TASKID_TQ_MGR" 20 "TASKID_DYNAMICS_VSO" 21 "TASKID_DYNAMICS_DTR" 22 "TASKID_DYNAMICS_DMR" 23 "TASKID_DYNAMICS_HOMLN_SFTY" 24 "TASKID_DYNAMICS_GATEWAY" 25 "TASKID_HWIO_1MS" 26 "TASKID_HWIO_100MS" 27 "TASKID_HWIO_SOLNDRV" 28 "TASKID_WHL_CLU_CTRL_1MS" 29 "TASKID_THERMAL_MANAGER" 30 "TASKID_RIDE_HEIGHT" 31 "TASKID_DIAG_MANAGER_100MS" 32 "TASKID_NETWORK_MANAGEMENT" 33 "TASKID_NVM_TRIGGER" 34 "TASKID_HMI" 35 "TASKID_SLEEP" 255 "TASKID_KERNEL" /end COMPU_VTAB
/begin COMPU_VTAB tLiftCalibState "" TAB_VERB 6 0 "LIFT_CALIB_INACTIVE" 1 "LIFT_CALIB_BLEED" 2 "LIFT_CALIB_DOWN" 3 "LIFT_CALIB_UP" 4 "LIFT_CALIB_DOWN_VERIFICATION" 5 "LIFT_CALIB_RETURN_TO_POSITION" /end COMPU_VTAB
/begin COMPU_VTAB tCluCtrlType "" TAB_VERB 2 0 "PWM_CONTROL" 1 "PID_CONTROL" /end COMPU_VTAB
/begin COMPU_VTAB tThermalUnitFailReason "" TAB_VERB 4 0 "THERMAL_UNIT_FAIL_NONE" 1 "THERMAL_UNIT_FAIL_FAULT" 2 "THERMAL_UNIT_FAIL_TIMEOUT" 3 "THERMAL_UNIT_FAIL_DEGRADED" /end COMPU_VTAB
/begin COMPU_VTAB tPrelCluReqSt "" TAB_VERB 7 0 "CLU_REQ_ST_NONE" 1 "CLU_REQ_ST_LOW_SPD" 2 "CLU_REQ_ST_HIGH_SPD" 3 "CLU_REQ_ST_LOW_SPD_LE" 4 "CLU_REQ_ST_LOW_SPD_RI" 5 "CLU_REQ_ST_FAULT" 6 "CLU_REQ_ST_MANUAL_SELN" /end COMPU_VTAB
/begin COMPU_VTAB tAcknowledgementStatus "" TAB_VERB 3 0 "NM_SLAVE_UNKNOWN_ACK" 1 "NM_SLAVE_ACKNOWLEDGED" 2 "NM_SLAVE_NOT_ACKNOWLEDGED" /end COMPU_VTAB
/begin COMPU_VTAB tPumpModel "" TAB_VERB 4 0 "PUMP_MODEL_UNKNOWN" 1 "PUMP_MODEL_ECP80" 2 "PUMP_MODEL_CWA100" 3 "PUMP_MODEL_CWA150" /end COMPU_VTAB
/begin COMPU_VTAB tRideHeightControlStrategy "" TAB_VERB 2 0 "RH_STRATEGY_OPEN_LOOP" 1 "RH_STRATEGY_CLOSED_LOOP" /end COMPU_VTAB
/begin COMPU_VTAB tNmRequest "" TAB_VERB 5 0 "NM_MASTER_UNKNOWN_REQUEST" 1 "NM_MASTER_STANDBY_REQUEST" 2 "NM_MASTER_ACTIVE_REQUEST" 3 "NM_MASTER_SLEEP_REQUEST" 4 "NM_MASTER_REQUEST_MAX" /end COMPU_VTAB
/begin COMPU_VTAB tThermalDiagStatus "" TAB_VERB 5 0 "THERMAL_DIAG_STS_IDLE" 1 "THERMAL_DIAG_STS_START" 2 "THERMAL_DIAG_STS_WAIT_STABILIZATION" 3 "THERMAL_DIAG_STS_EVALUATE" 4 "THERMAL_DIAG_STS_DONE" /end COMPU_VTAB
/begin COMPU_VTAB tEnableHold "" TAB_VERB 3 0 "NM_ENABLE_HOLD_UNKNOWN" 1 "NM_ENABLE_HOLD_OFF" 2 "NM_ENABLE_HOLD_ON" /end COMPU_VTAB
/begin COMPU_VTAB tInvState "" TAB_VERB 7 0 "INV_STATE_INIT" 1 "INV_STATE_APPL_SELFCHECK" 2 "INV_STATE_CTRL_SELFCHECK" 3 "INV_STATE_READY" 4 "INV_STATE_RUN" 5 "INV_STATE_IDLE" 6 "INV_STATE_SAFE_STATE" /end COMPU_VTAB
/begin COMPU_VTAB tFanModel "" TAB_VERB 4 0 "FAN_MODEL_FIC_UNKNOWN" 1 "FAN_MODEL_FIC_10" 2 "FAN_MODEL_FIC_11" 3 "FAN_MODEL_FIC_MAX" /end COMPU_VTAB
/begin COMPU_VTAB tSlaveErrorStatus "" TAB_VERB 3 0 "NM_SLAVE_ERROR_UNKNOWN" 1 "NM_SLAVE_ERROR_OK" 2 "NM_SLAVE_ERROR_NOK" /end COMPU_VTAB
/begin COMPU_VTAB tFaultLevel "" TAB_VERB 7 0 "FAULT_LEVEL_NONE" 1 "FAULT_LEVEL_0" 2 "FAULT_LEVEL_1" 3 "FAULT_LEVEL_2" 4 "FAULT_LEVEL_3" 5 "FAULT_LEVEL_4" 6 "FAULT_LEVEL_MAX" /end COMPU_VTAB
/begin COMPU_VTAB tYawTorqueRequestSaturation "" TAB_VERB 4 0 "YTR_NO_SAT" 1 "YTR_RE_SAT" 2 "YTR_FRNT_SAT" 3 "YTR_FULL_SAT" /end COMPU_VTAB
/begin COMPU_VTAB tPowerSupply "" TAB_VERB 3 0 "POWER_SUPPLY_12V" 1 "POWER_SUPPLY_48V" 2 "POWER_SUPPLY_MAX" /end COMPU_VTAB
/begin COMPU_VTAB tNmSlaveStatus "" TAB_VERB 9 0 "NM_SLAVE_UNKNOWN" 1 "NM_SLAVE_STANDBY" 2 "NM_SLAVE_ACTIVE" 3 "NM_SLAVE_READY_SLEEP" 8 "NM_SLAVE_ERR" 9 "NM_SLAVE_STANDBY_ERR" 10 "NM_SLAVE_ACTIVE_ERR" 11 "NM_SLAVE_READY_SLEEP_ERR" 12 "NM_SLAVE_MAX" /end COMPU_VTAB
/begin MEASUREMENT CTestIsEcuResetAllowed "" UBYTE NO_COMPU_METHOD 0 0 0 1 FORMAT "%.2" ECU_ADDRESS 0x40034458 READ_WRITE
 /begin IF_DATA XCP
  /begin DAQ_EVENT VARIABLE /begin DEFAULT_EVENT_LIST EVENT 3 /end DEFAULT_EVENT_LIST /end DAQ_EVENT
 /end IF_DATA
/end MEASUREMENT
/begin MEASUREMENT activeTask "" UBYTE NO_COMPU_METHOD 0 0 0 255 FORMAT "%.0" ECU_ADDRESS 0x40051d65 READ_WRITE
 /begin IF_DATA XCP
  /begin DAQ_EVENT VARIABLE /begin DEFAULT_EVENT_LIST EVENT 3 /end DEFAULT_EVENT_LIST /end DAQ_EVENT
 /end IF_DATA
/end MEASUREMENT
/begin MEASUREMENT vx1000EventRunningInKernel "" UBYTE NO_COMPU_METHOD 0 0 0 1 FORMAT "%.2" ECU_ADDRESS 0x40051d66 READ_WRITE
 /begin IF_DATA XCP
  /begin DAQ_EVENT VARIABLE /begin DEFAULT_EVENT_LIST EVENT 3 /end DEFAULT_EVENT_LIST /end DAQ_EVENT
 /end IF_DATA
/end MEASUREMENT
/begin GROUP setup ""
 /begin REF_MEASUREMENT taskInverterCtrl taskInverterHandler taskNetworkManagement taskNvmTrigger taskRideHeight taskThermal taskTqMgr taskTqStruct taskWhlCluCtrl1ms /end REF_MEASUREMENT
/end GROUP
/end MODULE
/end PROJECT
