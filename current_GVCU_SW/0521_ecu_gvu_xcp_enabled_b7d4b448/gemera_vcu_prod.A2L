ASAP2_VERSION 1 71
/begin PROJECT GEMERA ""
/begin MODULE GVCU ""
/begin MOD_COMMON "" BYTE_ORDER MSB_FIRST ALIGNMENT_BYTE 1 ALIGNMENT_WORD 2 ALIGNMENT_LONG 4 ALIGNMENT_FLOAT16_IEEE 2 ALIGNMENT_FLOAT32_IEEE 4 ALIGNMENT_FLOAT64_IEEE 8 ALIGNMENT_INT64 8 /end MOD_COMMON
/begin RECORD_LAYOUT __Float32_Value FNC_VALUES 1 FLOAT32_IEEE ROW_DIR DIRECT /end RECORD_LAYOUT
/begin RECORD_LAYOUT __UByte_Value FNC_VALUES 1 UBYTE ROW_DIR DIRECT /end RECORD_LAYOUT
/begin RECORD_LAYOUT __SLong_Axis AXIS_PTS_X 1 SLONG INDEX_INCR DIRECT /end RECORD_LAYOUT
/begin RECORD_LAYOUT __SLong_Value FNC_VALUES 1 SLONG ROW_DIR DIRECT /end RECORD_LAYOUT
/begin RECORD_LAYOUT __ULong_Value FNC_VALUES 1 ULONG ROW_DIR DIRECT /end RECORD_LAYOUT
/begin RECORD_LAYOUT __SWord_Axis AXIS_PTS_X 1 SWORD INDEX_INCR DIRECT /end RECORD_LAYOUT
/begin RECORD_LAYOUT __SWord_Value FNC_VALUES 1 SWORD ROW_DIR DIRECT /end RECORD_LAYOUT
/begin RECORD_LAYOUT __UInt64_Axis AXIS_PTS_X 1 A_UINT64 INDEX_INCR DIRECT /end RECORD_LAYOUT
/begin RECORD_LAYOUT __UInt64_Value FNC_VALUES 1 A_UINT64 ROW_DIR DIRECT /end RECORD_LAYOUT
/begin TYPEDEF_MEASUREMENT tBar_10_S16 "" SWORD tBar_10_S16 0 0 -1.0 1000.0 /end TYPEDEF_MEASUREMENT
/begin TYPEDEF_MEASUREMENT tGear "" ULONG tGear 0 0 0 10 /end TYPEDEF_MEASUREMENT
/begin TYPEDEF_MEASUREMENT tRadianPerSecond "" FLOAT32_IEEE tRadianPerSecond 0 0 -1000 1000 /end TYPEDEF_MEASUREMENT
/begin TYPEDEF_MEASUREMENT tPercent_S8 "" SBYTE tPercent_S8 0 0 0 100 /end TYPEDEF_MEASUREMENT
/begin TYPEDEF_MEASUREMENT tNewtonMetre "" FLOAT32_IEEE tNewtonMetre 0 0 -100000 100000 /end TYPEDEF_MEASUREMENT
/begin TYPEDEF_MEASUREMENT ETPU_VERSION "" ULONG ETPU_VERSION 0 0 0 2 /end TYPEDEF_MEASUREMENT
/begin TYPEDEF_MEASUREMENT tMillivolt_S32 "" SLONG tMillivolt_S32 0 0 0 1000000 /end TYPEDEF_MEASUREMENT
/begin TYPEDEF_MEASUREMENT tPercent_100_S32 "" SLONG tPercent_100_S32 0 0 0.0 100.0 /end TYPEDEF_MEASUREMENT
/begin TYPEDEF_MEASUREMENT tHex_U8 "" UBYTE tHex_U8 0 0 0 255 /end TYPEDEF_MEASUREMENT
/begin TYPEDEF_MEASUREMENT tHybSmState "" ULONG tHybSmState 0 0 0 6 /end TYPEDEF_MEASUREMENT
/begin TYPEDEF_MEASUREMENT tQualifier "" ULONG tQualifier 0 0 0 3 /end TYPEDEF_MEASUREMENT
/begin TYPEDEF_MEASUREMENT tFraction "" FLOAT32_IEEE tFraction 0 0 0 1 /end TYPEDEF_MEASUREMENT
/begin TYPEDEF_MEASUREMENT uint32_t "" ULONG NO_COMPU_METHOD 0 0 0 4294967295 /end TYPEDEF_MEASUREMENT
/begin TYPEDEF_MEASUREMENT uint64_t_0x4000 "" A_UINT64 NO_COMPU_METHOD 0 0 0 1 BIT_MASK 0x4000 /end TYPEDEF_MEASUREMENT
/begin TYPEDEF_MEASUREMENT tEnableState "" ULONG tEnableState 0 0 0 3 /end TYPEDEF_MEASUREMENT
/begin TYPEDEF_MEASUREMENT int16_t "" SWORD NO_COMPU_METHOD 0 0 -32768 32767 /end TYPEDEF_MEASUREMENT
/begin TYPEDEF_MEASUREMENT tInvCtrlMode "" ULONG tInvCtrlMode 0 0 0 3 /end TYPEDEF_MEASUREMENT
/begin TYPEDEF_MEASUREMENT UBaseType_t "" ULONG NO_COMPU_METHOD 0 0 0 4294967295 /end TYPEDEF_MEASUREMENT
/begin TYPEDEF_MEASUREMENT ETPU_ENGINE "" ULONG ETPU_ENGINE 0 0 0 2 /end TYPEDEF_MEASUREMENT
/begin TYPEDEF_MEASUREMENT uint64_t_0x8000 "" A_UINT64 NO_COMPU_METHOD 0 0 0 1 BIT_MASK 0x8000 /end TYPEDEF_MEASUREMENT
/begin TYPEDEF_MEASUREMENT uint8_t "" UBYTE NO_COMPU_METHOD 0 0 0 255 /end TYPEDEF_MEASUREMENT
/begin TYPEDEF_MEASUREMENT tNewtonMetre_100_S32 "" SLONG tNewtonMetre_100_S32 0 0 -100000.0 100000.0 /end TYPEDEF_MEASUREMENT
/begin TYPEDEF_MEASUREMENT tSupportingMode "" ULONG tSupportingMode 0 0 0 6 /end TYPEDEF_MEASUREMENT
/begin TYPEDEF_MEASUREMENT tAvasMod "" ULONG tAvasMod 0 0 0 3 /end TYPEDEF_MEASUREMENT
/begin TYPEDEF_MEASUREMENT tRevolutionPerMinute_S16 "" SWORD tRevolutionPerMinute_S16 0 0 -32768 32767 /end TYPEDEF_MEASUREMENT
/begin TYPEDEF_MEASUREMENT tMetrePerSquareSecond "" FLOAT32_IEEE tMetrePerSquareSecond 0 0 -50 50 /end TYPEDEF_MEASUREMENT
/begin TYPEDEF_MEASUREMENT tKilowatt "" FLOAT32_IEEE tKilowatt 0 0 -10000 10000 /end TYPEDEF_MEASUREMENT
/begin TYPEDEF_MEASUREMENT tKilometrePerHour_10_S16 "" SWORD tKilometrePerHour_10_S16 0 0 -600.0 600.0 /end TYPEDEF_MEASUREMENT
/begin TYPEDEF_MEASUREMENT tFactor "" FLOAT32_IEEE tFactor 0 0 -3.40282346639E+38 3.40282346639E+38 /end TYPEDEF_MEASUREMENT
/begin TYPEDEF_MEASUREMENT unsigned_char "" UBYTE NO_COMPU_METHOD 0 0 0 255 /end TYPEDEF_MEASUREMENT
/begin TYPEDEF_MEASUREMENT tCelsius_10_S16 "" SWORD tCelsius_10_S16 0 0 -400.0 10000.0 /end TYPEDEF_MEASUREMENT
/begin TYPEDEF_MEASUREMENT tMetrePerSecond "" FLOAT32_IEEE tMetrePerSecond 0 0 -200 200 /end TYPEDEF_MEASUREMENT
/begin TYPEDEF_MEASUREMENT tDriveConfiguration "" ULONG tDriveConfiguration 0 0 0 3 /end TYPEDEF_MEASUREMENT
/begin TYPEDEF_MEASUREMENT tTqMacSt "" ULONG tTqMacSt 0 0 0 20 /end TYPEDEF_MEASUREMENT
/begin TYPEDEF_MEASUREMENT uint16_t "" UWORD NO_COMPU_METHOD 0 0 0 65535 /end TYPEDEF_MEASUREMENT
/begin TYPEDEF_MEASUREMENT tMillivolt_S16 "" SWORD tMillivolt_S16 0 0 0 10000 /end TYPEDEF_MEASUREMENT
/begin TYPEDEF_STRUCTURE etpu_awac_engine_t "" 0x28 SYMBOL_TYPE_LINK "etpu_awac_engine_t" /begin STRUCTURE_COMPONENT engine ETPU_ENGINE 4 SYMBOL_TYPE_LINK "engine" /end STRUCTURE_COMPONENT /begin STRUCTURE_COMPONENT version ETPU_VERSION 8 SYMBOL_TYPE_LINK "version" /end STRUCTURE_COMPONENT /begin STRUCTURE_COMPONENT code_start uint32_t 12 SYMBOL_TYPE_LINK "code_start" /end STRUCTURE_COMPONENT
 /begin STRUCTURE_COMPONENT data_ram_start uint32_t 16 SYMBOL_TYPE_LINK "data_ram_start" /end STRUCTURE_COMPONENT
 /begin STRUCTURE_COMPONENT data_ram_end uint32_t 20 SYMBOL_TYPE_LINK "data_ram_end" /end STRUCTURE_COMPONENT
 /begin STRUCTURE_COMPONENT data_ram_pse_start uint32_t 24 SYMBOL_TYPE_LINK "data_ram_pse_start" /end STRUCTURE_COMPONENT
/end TYPEDEF_STRUCTURE
/begin TYPEDEF_STRUCTURE tDTC "" 0x18 SYMBOL_TYPE_LINK "tDTC" /begin STRUCTURE_COMPONENT Code uint16_t 4 SYMBOL_TYPE_LINK "Code" /end STRUCTURE_COMPONENT /begin STRUCTURE_COMPONENT warmUpCycleCnt uint8_t 6 SYMBOL_TYPE_LINK "warmUpCycleCnt" /end STRUCTURE_COMPONENT
 /begin STRUCTURE_COMPONENT drivingCycleCnt uint8_t 7 SYMBOL_TYPE_LINK "drivingCycleCnt" /end STRUCTURE_COMPONENT
 /begin STRUCTURE_COMPONENT b_ReportedOkFlagcnt uint8_t 8 SYMBOL_TYPE_LINK "b_ReportedOkFlagcnt" /end STRUCTURE_COMPONENT
 /begin STRUCTURE_COMPONENT Last_ReportOk_DCY uint16_t 10 SYMBOL_TYPE_LINK "Last_ReportOk_DCY" /end STRUCTURE_COMPONENT
 /begin STRUCTURE_COMPONENT Last_ReportFault_DCY uint16_t 12 SYMBOL_TYPE_LINK "Last_ReportFault_DCY" /end STRUCTURE_COMPONENT
 /begin STRUCTURE_COMPONENT b_ReportedOkInSameDrivingCycle uint64_t_0x8000 14 SYMBOL_TYPE_LINK "b_ReportedOkInSameDrivingCycle" /end STRUCTURE_COMPONENT
 /begin STRUCTURE_COMPONENT DrivingConditions tDrivingConditions 16 SYMBOL_TYPE_LINK "DrivingConditions" /end STRUCTURE_COMPONENT
 /begin STRUCTURE_COMPONENT b_MIL uint64_t_0x8000 22 SYMBOL_TYPE_LINK "b_MIL" /end STRUCTURE_COMPONENT
 /begin STRUCTURE_COMPONENT b_EmissionRelated uint64_t_0x4000 22 SYMBOL_TYPE_LINK "b_EmissionRelated" /end STRUCTURE_COMPONENT
/end TYPEDEF_STRUCTURE
/begin TYPEDEF_STRUCTURE etpu_awac_config_t "" 0x2C SYMBOL_TYPE_LINK "etpu_awac_config_t" /begin STRUCTURE_COMPONENT mcr uint32_t 0 SYMBOL_TYPE_LINK "mcr" /end STRUCTURE_COMPONENT /begin STRUCTURE_COMPONENT misc uint32_t 4 SYMBOL_TYPE_LINK "misc" /end STRUCTURE_COMPONENT /begin STRUCTURE_COMPONENT ecr_a uint32_t 8 SYMBOL_TYPE_LINK "ecr_a" /end STRUCTURE_COMPONENT /begin STRUCTURE_COMPONENT tbcr_a uint32_t 12 SYMBOL_TYPE_LINK "tbcr_a" /end STRUCTURE_COMPONENT /begin STRUCTURE_COMPONENT stacr_a uint32_t 16 SYMBOL_TYPE_LINK "stacr_a" /end STRUCTURE_COMPONENT /begin STRUCTURE_COMPONENT ecr_b uint32_t 20 SYMBOL_TYPE_LINK "ecr_b" /end STRUCTURE_COMPONENT /begin STRUCTURE_COMPONENT tbcr_b uint32_t 24 SYMBOL_TYPE_LINK "tbcr_b" /end STRUCTURE_COMPONENT /begin STRUCTURE_COMPONENT stacr_b uint32_t 28 SYMBOL_TYPE_LINK "stacr_b" /end STRUCTURE_COMPONENT /begin STRUCTURE_COMPONENT wdtr_a uint32_t 32 SYMBOL_TYPE_LINK "wdtr_a" /end STRUCTURE_COMPONENT /begin STRUCTURE_COMPONENT wdtr_b uint32_t 36 SYMBOL_TYPE_LINK "wdtr_b" /end STRUCTURE_COMPONENT /begin STRUCTURE_COMPONENT scmoff uint32_t 40 SYMBOL_TYPE_LINK "scmoff" /end STRUCTURE_COMPONENT /end TYPEDEF_STRUCTURE
/begin TYPEDEF_STRUCTURE ExampleStruct "" 0x8 SYMBOL_TYPE_LINK "ExampleStruct" /begin STRUCTURE_COMPONENT var3 uint8_t 0 SYMBOL_TYPE_LINK "var3" /end STRUCTURE_COMPONENT /begin STRUCTURE_COMPONENT var4 uint16_t 2 SYMBOL_TYPE_LINK "var4" /end STRUCTURE_COMPONENT /begin STRUCTURE_COMPONENT var5 uint32_t 4 SYMBOL_TYPE_LINK "var5" /end STRUCTURE_COMPONENT /end TYPEDEF_STRUCTURE
/begin TYPEDEF_STRUCTURE tMonitorStatus "" 0x4 SYMBOL_TYPE_LINK "tMonitorStatus" /begin STRUCTURE_COMPONENT St _unnamed_union_00 0 SYMBOL_TYPE_LINK "St" /end STRUCTURE_COMPONENT /end TYPEDEF_STRUCTURE
/begin TYPEDEF_STRUCTURE _unnamed_union_00 "" 0x4 SYMBOL_TYPE_LINK "_unnamed_union_00" /begin STRUCTURE_COMPONENT uxDummy2 UBaseType_t 0 SYMBOL_TYPE_LINK "uxDummy2" /end STRUCTURE_COMPONENT /end TYPEDEF_STRUCTURE
/begin TYPEDEF_STRUCTURE tDrivingConditions "" 0x6 SYMBOL_TYPE_LINK "tDrivingConditions" /begin STRUCTURE_COMPONENT rpm int16_t 0 SYMBOL_TYPE_LINK "rpm" /end STRUCTURE_COMPONENT /begin STRUCTURE_COMPONENT load int16_t 2 SYMBOL_TYPE_LINK "load" /end STRUCTURE_COMPONENT /begin STRUCTURE_COMPONENT tmot int16_t 4 SYMBOL_TYPE_LINK "tmot" /end STRUCTURE_COMPONENT /end TYPEDEF_STRUCTURE
/begin TYPEDEF_STRUCTURE tFreezeFrame "" 0x10 SYMBOL_TYPE_LINK "tFreezeFrame" /begin STRUCTURE_COMPONENT DTC uint16_t 0 SYMBOL_TYPE_LINK "DTC" /end STRUCTURE_COMPONENT /begin STRUCTURE_COMPONENT isPrio uint8_t 2 SYMBOL_TYPE_LINK "isPrio" /end STRUCTURE_COMPONENT /begin STRUCTURE_COMPONENT data unsigned_char 3 MATRIX_DIM 12 SYMBOL_TYPE_LINK "data" /end STRUCTURE_COMPONENT /end TYPEDEF_STRUCTURE
/begin CHARACTERISTIC CWishboneAgSnsrVoltDeltaFrnt "Wishbone angle sensors Voltage delta between full droop to full bump, front suspension [V]" VALUE 1073881572 __SWord_Value 0 tMillivolt_S16 0 10000 STEP_SIZE 1 /end CHARACTERISTIC
/begin CHARACTERISTIC CWishboneAgSnsrVoltDeltaRe "Wishbone angle sensors Voltage swing delta between full droop to full bump, rear suspension [V]" VALUE 1073881570 __SWord_Value 0 tMillivolt_S16 0 10000 STEP_SIZE 1 /end CHARACTERISTIC
/begin CHARACTERISTIC CWishboneSnsrOutpVoltMin "voltage minimum for wishbone angle sensor to be considered in the reading range [V]" VALUE 1073881568 __SWord_Value 0 tMillivolt_S16 0 10000 STEP_SIZE 1 /end CHARACTERISTIC
/begin CHARACTERISTIC CWishboneSnsrOutpVoltMax "voltage maximum for wishbone angle sensor to be considered in the reading range [V]" VALUE 1073881566 __SWord_Value 0 tMillivolt_S16 0 10000 STEP_SIZE 1 /end CHARACTERISTIC
/begin CHARACTERISTIC CWhlTqSplLongPos "Longitudinal torque split percent front in DRV_CFG_AWD on positive torque request" VALUE 1073881192 __Float32_Value 0 NO_COMPU_METHOD -3.40282346639E+38 3.40282346639E+38 STEP_SIZE 1 FORMAT "%.6" /end CHARACTERISTIC
/begin CHARACTERISTIC CWhlTqSplLongNeg "Longitudinal torque split percent front in DRV_CFG_AWD on negative torque request" VALUE 1073881188 __Float32_Value 0 NO_COMPU_METHOD -3.40282346639E+38 3.40282346639E+38 STEP_SIZE 1 FORMAT "%.6" /end CHARACTERISTIC
/begin CHARACTERISTIC CWhlTqReLimLowrAbsActv "Wheel torque limit for rear axle while ABS active [Nm]" VALUE 1073881180 __Float32_Value 0 tNewtonMetre 0 15000.0 STEP_SIZE 10 /end CHARACTERISTIC
/begin CHARACTERISTIC CYtrYawTqLimFrnt "Front yaw tq limit, will limit torque steer feel [Nm]" VALUE 1073879932 __Float32_Value 0 tNewtonMetre -100000 100000 STEP_SIZE 1 /end CHARACTERISTIC
/begin CHARACTERISTIC CYawRefGenPacejkaRby1FacFrnt "Pacejka model front rby1 (parameter for longitudinal slip derating factor on lateral forces)" VALUE 1073878876 __Float32_Value 0 tFactor -3.40282346639E+38 3.40282346639E+38 STEP_SIZE 1 /end CHARACTERISTIC
/begin CHARACTERISTIC CYawRefGenPacejkaRby2FacFrnt "Pacejka model front rby2 (parameter for longitudinal slip derating factor on lateral forces)" VALUE 1073878872 __Float32_Value 0 tFactor -3.40282346639E+38 3.40282346639E+38 STEP_SIZE 1 /end CHARACTERISTIC
/begin CHARACTERISTIC CYawRefGenPacejkaRby1FacRe "Pacejka model rear rby1 (parameter for longitudinal slip derating factor on lateral forces)" VALUE 1073878868 __Float32_Value 0 tFactor -3.40282346639E+38 3.40282346639E+38 STEP_SIZE 1 /end CHARACTERISTIC
/begin CHARACTERISTIC CYawRefGenPacejkaRby2FacRe "Pacejka model rear rby2 (parameter for longitudinal slip derating factor on lateral forces)" VALUE 1073878864 __Float32_Value 0 tFactor -3.40282346639E+38 3.40282346639E+38 STEP_SIZE 1 /end CHARACTERISTIC
/begin CHARACTERISTIC CYawRefGenBlendFacVx0 "Low speed blend factor, minimum blending speed Vx0" VALUE 1073878860 __Float32_Value 0 tMetrePerSecond -200 200 STEP_SIZE 1 /end CHARACTERISTIC
/begin CHARACTERISTIC CYawRefGenBlendFacVxMax "Low speed blend factor, maximum blending speed VxMax" VALUE 1073878856 __Float32_Value 0 tMetrePerSecond -200 200 STEP_SIZE 1 /end CHARACTERISTIC
/begin CHARACTERISTIC CYawRefGenKinSngTrackYawRateScalingFac "Kinematic single track model scaling factor for yaw rate" VALUE 1073878852 __Float32_Value 0 tFactor -3.40282346639E+38 3.40282346639E+38 STEP_SIZE 1 /end CHARACTERISTIC
/begin CHARACTERISTIC CYawRefGenCsiTarget "Maximum delta->psidot frequency-domain damping factor {suggested value: 1}" VALUE 1073878848 __Float32_Value 0 tMetrePerSquareSecond -50 50 STEP_SIZE 1 /end CHARACTERISTIC
/begin CHARACTERISTIC CYawRefGenKOmegan "Multiplicative coefficient for frequency-domain natural frequency {suggested value: 2}" VALUE 1073878844 __Float32_Value 0 tMetrePerSquareSecond -50 50 STEP_SIZE 1 /end CHARACTERISTIC
/begin CHARACTERISTIC CYawRefGenMinUndersteerGain "Minimum understeering gain to prevent oversteering tendencies (Kus<Kus_safe_min) and instability at high speeds" VALUE 1073878840 __Float32_Value 0 tFactor -3.40282346639E+38 3.40282346639E+38 STEP_SIZE 1 /end CHARACTERISTIC
/begin CHARACTERISTIC CYawRefGenAyMaxScalingCoeff "Ay_max_gg_plot expansion factor from passive to active vehicle {suggested value: 1.0}" VALUE 1073878836 __Float32_Value 0 NO_COMPU_METHOD -3.40282346639E+38 3.40282346639E+38 STEP_SIZE 1 FORMAT "%.6" /end CHARACTERISTIC
/begin CHARACTERISTIC CYawRefGenPsidotStarCoeff "Percentage of band inside the psidot_ref bounds where the reference is not smooth saturated {suggested value: 0.9}" VALUE 1073878832 __Float32_Value 0 tFraction 0 1 STEP_SIZE 1 /end CHARACTERISTIC
/begin CHARACTERISTIC CYawRefGenYawRateTarMax "Maximum yaw rate reference value" VALUE 1073878828 __Float32_Value 0 tRadianPerSecond -1000 1000 STEP_SIZE 1 /end CHARACTERISTIC
/begin CHARACTERISTIC CYawRefGenSecantMaxIter "Maximum number of iterations for the secant method" VALUE 1073878824 __UByte_Value 0 NO_COMPU_METHOD 0 255 STEP_SIZE 1 FORMAT "%.0" /end CHARACTERISTIC
/begin CHARACTERISTIC CYawRefGenSecantTol "Tolerance for convergence for the secant method" VALUE 1073878820 __Float32_Value 0 NO_COMPU_METHOD -3.40282346639E+38 3.40282346639E+38 STEP_SIZE 1 FORMAT "%.6" /end CHARACTERISTIC
/begin CHARACTERISTIC CYawRefGenSecantInitWidth "Initial width for the secant method" VALUE 1073878816 __Float32_Value 0 NO_COMPU_METHOD -3.40282346639E+38 3.40282346639E+38 STEP_SIZE 1 FORMAT "%.6" /end CHARACTERISTIC
/begin AXIS_PTS CStatyCrkTrsmOilTXsp "Stationary Crank Temperature Axis based on transmission oil temperature [C]" 1073878792 shared.engine.trsmOilT __SWord_Axis 0 tCelsius_10_S16 11 -50 200 STEP_SIZE 5 /end AXIS_PTS
/begin AXIS_PTS CTrsmOilTXsp "Transmission oil temperature X-setpoint for interpolation tables/maps [C]" 1073878404 shared.engine.trsmOilT __SLong_Axis 0 NO_COMPU_METHOD 11 -50 200 STEP_SIZE 5 FORMAT "%.0" /end AXIS_PTS
/begin CHARACTERISTIC CTestTsmIceDebugMode "Force powertrain to ICE-only mode (can only be done from hybrid, engine must be running. Locks out Reverse)" VALUE 1073887645 __UByte_Value 0 NO_COMPU_METHOD 0 1 STEP_SIZE 1 FORMAT "%.2" /end CHARACTERISTIC
/begin CHARACTERISTIC CTrsmRvsgEna "Enable reversing via transmission" VALUE 1073887644 __UByte_Value 0 NO_COMPU_METHOD 0 1 STEP_SIZE 1 FORMAT "%.2" /end CHARACTERISTIC
/begin CHARACTERISTIC CAvasModSwt "AVAS mode switch" VALUE 1073887640 __ULong_Value 0 tAvasMod 0 3 STEP_SIZE 1 /end CHARACTERISTIC
/begin CHARACTERISTIC CTestTsmDrvCfg "TSM drive config override" VALUE 1073887636 __ULong_Value 0 tDriveConfiguration 0 3 STEP_SIZE 1 /end CHARACTERISTIC
/begin CHARACTERISTIC CTestSpeedLimiter "Speed Limiter test caldata, when bigger than zero ignore any other mask condition [km/h]" VALUE 1073887634 __SWord_Value 0 tKilometrePerHour_10_S16 -600.0 600.0 STEP_SIZE 1 /end CHARACTERISTIC
/begin CHARACTERISTIC CEnaColdRigMode "Enable Wheel clutches consideratiton for stationary cranking" VALUE 1073887632 __UByte_Value 0 NO_COMPU_METHOD 0 1 STEP_SIZE 1 FORMAT "%.2" /end CHARACTERISTIC
/begin CHARACTERISTIC CTestSuppgMod "Override Supporting mode outp from DVI [0 = SUPPG_MOD_UNKNOWN, 1 = SUPPG_MOD_NONE, 2 = SUPPG_MOD_LIFT, 3 = SUPPG_MOD_DYNO, 4 = SUPPG_MOD_DAMP_SERV, 5 = SUPPG_MOD_TRANSPORT, 6 = SUPPG_MOD_STAGE]" VALUE 1073887628 __ULong_Value 0 tSupportingMode 0 6 STEP_SIZE 1 /end CHARACTERISTIC
/begin CHARACTERISTIC CBatSoCPowerDemandMaxTab "eMotor power demand vs SOC maximum [kW]" CURVE 1073887584 __SLong_Value 0 tKilowatt_S32 -50 0 STEP_SIZE 1
 /begin AXIS_DESCR COM_AXIS shared.engine.trsmOilT NO_COMPU_METHOD 11 0 0 AXIS_PTS_REF CTrsmOilTXsp /end AXIS_DESCR
/end CHARACTERISTIC
/begin CHARACTERISTIC CTsmStateEnableMask "TSM state enable mask [0]  TQ_MAC_ST_UNKNOWN [1]  TQ_MAC_ST_TQ_OFF [2]  TQ_MAC_ST_ELEC_IDLE [3]  TQ_MAC_ST_ELEC_DRIVE [4]  TQ_MAC_ST_CRK_PARK [5]  TQ_MAC_ST_CRK_STATY [6]  TQ_MAC_ST_CRK_DRVG [7]  TQ_MAC_ST_HYB_IDLE [8]  TQ_MAC_ST_HYB_DRV [9]  TQ_MAC_ST_HYB_DECOUPL_IDLE [10]  TQ_MAC_ST_HYB_DECOUPL_DRV [11]  TQ_MAC_ST_HYB_RVSG [12] TQ_MAC_ST_HYB_LNCH [13] TQ_MAC_ST_ICE_IDLE [14] TQ_MAC_ST_ICE_DRIVE [15] TQ_MAC_ST_ICE_RVSG [16] TQ_MAC_ST_ELEC_TURTLE [17] TQ_MAC_ST_ELEC_TURTLE_IDLE [18] TQ_MAC_ST_ICE_TURTLE [19] TQ_MAC_ST_ICE_TURTLE_IDLE" CURVE 1073887564 __UByte_Value 0 NO_COMPU_METHOD 0 1 STEP_SIZE 1 FORMAT "%.2"
 /begin AXIS_DESCR FIX_AXIS NO_INPUT_QUANTITY tTqMacSt 20 0 19 FIX_AXIS_PAR_DIST 0 1 20 /end AXIS_DESCR
/end CHARACTERISTIC
/begin CHARACTERISTIC CStatyCrkGearTab "Stationary cranking gear request to transmission Type: Curve" CURVE 1073887520 __ULong_Value 0 tGear 0 10 STEP_SIZE 1
 /begin AXIS_DESCR COM_AXIS shared.engine.trsmOilT tCelsius_10_S16 11 0 0 AXIS_PTS_REF CStatyCrkTrsmOilTXsp /end AXIS_DESCR
/end CHARACTERISTIC
/begin CHARACTERISTIC CCluDtTqHyst "Hysteresis on drivetrain torque request for propshaft/clu sync speed selection (propshaft level)" VALUE 1073887516 __SLong_Value 0 tNewtonMetre_100_S32 0 1000 STEP_SIZE 10 /end CHARACTERISTIC
/begin CHARACTERISTIC CRatBevelFrnt "Front bevel gear ratio" VALUE 1073887512 __Float32_Value 0 NO_COMPU_METHOD -3.40282346639E+38 3.40282346639E+38 STEP_SIZE 1 FORMAT "%.6" /end CHARACTERISTIC
/begin CHARACTERISTIC CRatBevelRe "Rear bevel gear ratio" VALUE 1073887508 __Float32_Value 0 NO_COMPU_METHOD -3.40282346639E+38 3.40282346639E+38 STEP_SIZE 1 FORMAT "%.6" /end CHARACTERISTIC
/begin CHARACTERISTIC CRatPropshDropGear "Propshaft drop gear ratio" VALUE 1073887504 __Float32_Value 0 NO_COMPU_METHOD -3.40282346639E+38 3.40282346639E+38 STEP_SIZE 1 FORMAT "%.6" /end CHARACTERISTIC
/begin CHARACTERISTIC CRatSideGbx "Side gearbox gear ratio" VALUE 1073887500 __Float32_Value 0 NO_COMPU_METHOD -3.40282346639E+38 3.40282346639E+38 STEP_SIZE 1 FORMAT "%.6" /end CHARACTERISTIC
/begin CHARACTERISTIC CPFricBrkMaxDegStTab "Maximum brake pressure, depending on IEB degradation state [bar]" CURVE 1073887490 __SWord_Value 0 tBar_10_S16 -1.0 1000.0 STEP_SIZE 1
 /begin AXIS_DESCR FIX_AXIS NO_INPUT_QUANTITY NO_COMPU_METHOD 5 0 4 FIX_AXIS_PAR_DIST 0 1 5 /end AXIS_DESCR
/end CHARACTERISTIC
/begin CHARACTERISTIC CVsoWhlLoadEnaSwt "enable wheel load estimation" VALUE 1073887488 __UByte_Value 0 NO_COMPU_METHOD 0 1 STEP_SIZE 1 FORMAT "%.2" /end CHARACTERISTIC
/begin CHARACTERISTIC CVsoTireMdlPureLgtSlipStfnCon "Initial Tire Model: constant pure longitudinal slip stiffness [mu/fac]" VALUE 1073887484 __Float32_Value 0 NO_COMPU_METHOD 0 200 STEP_SIZE 1 FORMAT "%.6" /end CHARACTERISTIC
/begin MEASUREMENT CTestIsEcuResetAllowed "" UBYTE NO_COMPU_METHOD 0 0 0 1 FORMAT "%.2" ECU_ADDRESS 0x40034458 READ_WRITE
 /begin IF_DATA XCP
  /begin DAQ_EVENT VARIABLE /begin DEFAULT_EVENT_LIST EVENT 3 /end DEFAULT_EVENT_LIST /end DAQ_EVENT
 /end IF_DATA
/end MEASUREMENT
/begin MEASUREMENT vx1000EventRunningInKernel "" UBYTE NO_COMPU_METHOD 0 0 0 1 FORMAT "%.2" ECU_ADDRESS 0x40051d66 READ_WRITE
 /begin IF_DATA XCP
  /begin DAQ_EVENT VARIABLE /begin DEFAULT_EVENT_LIST EVENT 3 /end DEFAULT_EVENT_LIST /end DAQ_EVENT
 /end IF_DATA
/end MEASUREMENT
/begin MEASUREMENT activeTask "" UBYTE NO_COMPU_METHOD 0 0 0 255 FORMAT "%.0" ECU_ADDRESS 0x40051d65 READ_WRITE
 /begin IF_DATA XCP
  /begin DAQ_EVENT VARIABLE /begin DEFAULT_EVENT_LIST EVENT 3 /end DEFAULT_EVENT_LIST /end DAQ_EVENT
 /end IF_DATA
/end MEASUREMENT
/begin COMPU_METHOD tFactor "" IDENTICAL "%.6" "" /end COMPU_METHOD
/begin COMPU_METHOD tFraction "" IDENTICAL "%.6" "" /end COMPU_METHOD
/begin COMPU_METHOD tPercent_S8 "" IDENTICAL "%.0" "%" /end COMPU_METHOD
/begin COMPU_METHOD tPercent_100_S32 "" LINEAR "%.2" "%" COEFFS_LINEAR 0.010000 0 /end COMPU_METHOD
/begin COMPU_METHOD tSecond_1000_U32 "" LINEAR "%.3" "s" COEFFS_LINEAR 0.001000 0 /end COMPU_METHOD
/begin COMPU_METHOD tMicrosecond_U32 "" IDENTICAL "%.3" "us" /end COMPU_METHOD
/begin COMPU_METHOD tMetrePerSecond "" IDENTICAL "%.3" "m/s" /end COMPU_METHOD
/begin COMPU_METHOD tKilometrePerHour_10_S16 "" LINEAR "%.1" "km/h" COEFFS_LINEAR 0.100000 0 /end COMPU_METHOD
/begin COMPU_METHOD tMetrePerSquareSecond "" IDENTICAL "%.3" "m/s2" /end COMPU_METHOD
/begin COMPU_METHOD tRadianPerSecond "" IDENTICAL "%.3" "rad/s" /end COMPU_METHOD
/begin COMPU_METHOD tRevolutionPerMinute_S16 "" IDENTICAL "%.0" "rpm" /end COMPU_METHOD
/begin COMPU_METHOD tDegreePerSec_100_S16 "" LINEAR "%.2" "deg/s" COEFFS_LINEAR 0.010000 0 /end COMPU_METHOD
/begin COMPU_METHOD tNewtonMetre "" IDENTICAL "%.3" "Nm" /end COMPU_METHOD
/begin COMPU_METHOD tNewtonMetre_100_S32 "" LINEAR "%.2" "Nm" COEFFS_LINEAR 0.010000 0 /end COMPU_METHOD
/begin COMPU_METHOD tKilowatt "" IDENTICAL "%.3" "kW" /end COMPU_METHOD
/begin COMPU_METHOD tKilowatt_S32 "" IDENTICAL "%.0" "kW" /end COMPU_METHOD
/begin COMPU_METHOD tKelvin "" IDENTICAL "%.3" "K" /end COMPU_METHOD
/begin COMPU_METHOD tCelsius_10_S16 "" LINEAR "%.1" "C" COEFFS_LINEAR 0.100000 0 /end COMPU_METHOD
/begin COMPU_METHOD tBar_10_S16 "" LINEAR "%.1" "bar" COEFFS_LINEAR 0.100000 0 /end COMPU_METHOD
/begin COMPU_METHOD tAmpere_100_S16 "" LINEAR "%.2" "A" COEFFS_LINEAR 0.010000 0 /end COMPU_METHOD
/begin COMPU_METHOD tNewtonMetrePerDegree "" IDENTICAL "%.3" "Nm/deg" /end COMPU_METHOD
/begin COMPU_METHOD tMillivolt_S16 "" IDENTICAL "%.0" "mV" /end COMPU_METHOD
/begin COMPU_METHOD tMillivolt_S32 "" IDENTICAL "%.0" "mV" /end COMPU_METHOD
/begin COMPU_METHOD tHex_U8 "" IDENTICAL "%.0" "HEX" /end COMPU_METHOD
/begin COMPU_METHOD tQualifier "" TAB_VERB "%.0" "" COMPU_TAB_REF tQualifier /end COMPU_METHOD
/begin COMPU_METHOD tWheel "" TAB_VERB "%.0" "" COMPU_TAB_REF tWheel /end COMPU_METHOD
/begin COMPU_METHOD tDrivetrainType "" TAB_VERB "%.0" "" COMPU_TAB_REF tDrivetrainType /end COMPU_METHOD
/begin COMPU_METHOD tSolnIdx "" TAB_VERB "%.0" "" COMPU_TAB_REF tSolnIdx /end COMPU_METHOD
/begin COMPU_METHOD tImuIdx "" TAB_VERB "%.0" "" COMPU_TAB_REF tImuIdx /end COMPU_METHOD
/begin COMPU_METHOD tAxes "" TAB_VERB "%.0" "" COMPU_TAB_REF tAxes /end COMPU_METHOD
/begin COMPU_METHOD tImuAccel "" TAB_VERB "%.0" "" COMPU_TAB_REF tImuAccel /end COMPU_METHOD
/begin COMPU_METHOD tImuGyro "" TAB_VERB "%.0" "" COMPU_TAB_REF tImuGyro /end COMPU_METHOD
/begin COMPU_METHOD tAxle "" TAB_VERB "%.0" "" COMPU_TAB_REF tAxle /end COMPU_METHOD
/begin COMPU_METHOD tAvasMod "" TAB_VERB "%.0" "" COMPU_TAB_REF tAvasMod /end COMPU_METHOD
/begin COMPU_METHOD tTqMacSt "" TAB_VERB "%.0" "" COMPU_TAB_REF tTqMacSt /end COMPU_METHOD
/begin COMPU_METHOD tVelocityControllerFfCmpTq "" TAB_VERB "%.0" "" COMPU_TAB_REF tVelocityControllerFfCmpTq /end COMPU_METHOD
/begin COMPU_METHOD tDriveConfiguration "" TAB_VERB "%.0" "" COMPU_TAB_REF tDriveConfiguration /end COMPU_METHOD
/begin COMPU_METHOD tGear "" TAB_VERB "%.0" "" COMPU_TAB_REF tGear /end COMPU_METHOD
/begin COMPU_METHOD tPerformanceModeCptIdx "" TAB_VERB "%.0" "" COMPU_TAB_REF tPerformanceModeCptIdx /end COMPU_METHOD
/begin COMPU_METHOD tEnableState "" TAB_VERB "%.0" "" COMPU_TAB_REF tEnableState /end COMPU_METHOD
/begin COMPU_METHOD tThermalStatus "" TAB_VERB "%.0" "" COMPU_TAB_REF tThermalStatus /end COMPU_METHOD
/begin COMPU_METHOD tTireMdlPacejkaAxes "" TAB_VERB "%.0" "" COMPU_TAB_REF tTireMdlPacejkaAxes /end COMPU_METHOD
/begin COMPU_METHOD tTireMdlPacejkaParamIdx "" TAB_VERB "%.0" "" COMPU_TAB_REF tTireMdlPacejkaParamIdx /end COMPU_METHOD
/begin COMPU_METHOD tSupportingMode "" TAB_VERB "%.0" "" COMPU_TAB_REF tSupportingMode /end COMPU_METHOD
/begin COMPU_METHOD tDamperError "" TAB_VERB "%.0" "" COMPU_TAB_REF tDamperError /end COMPU_METHOD
/begin COMPU_METHOD tSensorStatus "" TAB_VERB "%.0" "" COMPU_TAB_REF tSensorStatus /end COMPU_METHOD
/begin COMPU_METHOD tHandsOffSteering "" TAB_VERB "%.0" "" COMPU_TAB_REF tHandsOffSteering /end COMPU_METHOD
/begin COMPU_METHOD tHillHoldDirection "" TAB_VERB "%.0" "" COMPU_TAB_REF tHillHoldDirection /end COMPU_METHOD
/begin COMPU_METHOD tHillHoldInhibitReq "" TAB_VERB "%.0" "" COMPU_TAB_REF tHillHoldInhibitReq /end COMPU_METHOD
/begin COMPU_METHOD tImuStatus "" TAB_VERB "%.0" "" COMPU_TAB_REF tImuStatus /end COMPU_METHOD
/begin COMPU_METHOD tWheelClutchRateSource "" TAB_VERB "%.0" "" COMPU_TAB_REF tWheelClutchRateSource /end COMPU_METHOD
/begin COMPU_METHOD tHybSmState "" TAB_VERB "%.0" "" COMPU_TAB_REF tHybSmState /end COMPU_METHOD
/begin COMPU_METHOD tInvCtrlMode "" TAB_VERB "%.0" "" COMPU_TAB_REF tInvCtrlMode /end COMPU_METHOD
/begin COMPU_METHOD tLiftPosnCalIdx "" TAB_VERB "%.0" "" COMPU_TAB_REF tLiftPosnCalIdx /end COMPU_METHOD
/begin COMPU_METHOD tWhlTrvlCalIdx "" TAB_VERB "%.0" "" COMPU_TAB_REF tWhlTrvlCalIdx /end COMPU_METHOD
/begin COMPU_METHOD tAccVehicleType "" TAB_VERB "%.0" "" COMPU_TAB_REF tAccVehicleType /end COMPU_METHOD
/begin COMPU_METHOD tAccCameraVisibilityState "" TAB_VERB "%.0" "" COMPU_TAB_REF tAccCameraVisibilityState /end COMPU_METHOD
/begin COMPU_METHOD tWiperStatus "" TAB_VERB "%.0" "" COMPU_TAB_REF tWiperStatus /end COMPU_METHOD
/begin COMPU_METHOD tVsoWheelLoadCpt "" TAB_VERB "%.0" "" COMPU_TAB_REF tVsoWheelLoadCpt /end COMPU_METHOD
/begin COMPU_METHOD ETPU_VERSION "" TAB_VERB "%.0" "" COMPU_TAB_REF ETPU_VERSION /end COMPU_METHOD
/begin COMPU_METHOD ETPU_ENGINE "" TAB_VERB "%.0" "" COMPU_TAB_REF ETPU_ENGINE /end COMPU_METHOD
/begin COMPU_VTAB tQualifier "" TAB_VERB 4 0 "Q_NOT_INITIALIZED" 1 "Q_FAULTY" 2 "Q_NORMAL" 3 "Q_LOW_QUALITY" /end COMPU_VTAB
/begin COMPU_VTAB tWheel "" TAB_VERB 5 0 "FL" 1 "FR" 2 "RL" 3 "RR" 4 "NUM_WHEELS" /end COMPU_VTAB
/begin COMPU_VTAB tDrivetrainType "" TAB_VERB 4 0 "DT_TYPE_UNKNOWN" 1 "DT_TYPE_HYB" 2 "DT_TYPE_ICE" 3 "NUM_DT_TYPES" /end COMPU_VTAB
/begin COMPU_VTAB tSolnIdx "" TAB_VERB 5 0 "SOLN_1" 1 "SOLN_2" 2 "SOLN_3" 3 "SOLN_4" 4 "NUM_OF_SOLENOIDS" /end COMPU_VTAB
/begin COMPU_VTAB tImuIdx "" TAB_VERB 4 0 "IMU_SNSR_IDX_1" 1 "IMU_SNSR_IDX_2" 2 "IMU_SNSR_IDX_3" 3 "NUM_OF_IMU_SNSR" /end COMPU_VTAB
/begin COMPU_VTAB tAxes "" TAB_VERB 4 0 "AXIS_X" 1 "AXIS_Y" 2 "AXIS_Z" 3 "NUM_OF_AXES" /end COMPU_VTAB
/begin COMPU_VTAB tImuAccel "" TAB_VERB 4 0 "IMU_ACCEL_LONG" 1 "IMU_ACCEL_LAT" 2 "IMU_ACCEL_VERT" 3 "NUM_OF_ACCEL_AXES" /end COMPU_VTAB
/begin COMPU_VTAB tImuGyro "" TAB_VERB 4 0 "IMU_GYRO_ROLL" 1 "IMU_GYRO_PITCH" 2 "IMU_GYRO_YAW" 3 "NUM_OF_GYRO_AXES" /end COMPU_VTAB
/begin COMPU_VTAB tAxle "" TAB_VERB 2 0 "AXLE_FRONT" 1 "AXLE_REAR" /end COMPU_VTAB
/begin COMPU_VTAB tAvasMod "" TAB_VERB 4 0 "AVAS_MOD_OFF" 1 "AVAS_MOD_FAN_STBY" 2 "AVAS_MOD_FAN" 3 "AVAS_MOD_SPEAKER" /end COMPU_VTAB
/begin COMPU_VTAB tTqMacSt "" TAB_VERB 21 0 "TQ_MAC_ST_UNKNOWN" 1 "TQ_MAC_ST_TQ_OFF" 2 "TQ_MAC_ST_ELEC_IDLE" 3 "TQ_MAC_ST_ELEC_DRIVE" 4 "TQ_MAC_ST_CRK_PARK" 5 "TQ_MAC_ST_CRK_STATY" 6 "TQ_MAC_ST_CRK_DRVG" 7 "TQ_MAC_ST_HYB_IDLE" 8 "TQ_MAC_ST_HYB_DRV" 9 "TQ_MAC_ST_HYB_DECOUPL_IDLE" 10 "TQ_MAC_ST_HYB_DECOUPL_DRV" 11 "TQ_MAC_ST_HYB_RVSG" 12 "TQ_MAC_ST_HYB_LNCH" 13 "TQ_MAC_ST_ICE_IDLE" 14 "TQ_MAC_ST_ICE_DRIVE" 15 "TQ_MAC_ST_ICE_RVSG" 16 "TQ_MAC_ST_ELEC_TURTLE" 17 "TQ_MAC_ST_ELEC_TURTLE_IDLE" 18 "TQ_MAC_ST_ICE_TURTLE" 19 "TQ_MAC_ST_ICE_TURTLE_IDLE" 20 "TQ_MAC_ST_LENGTH" /end COMPU_VTAB
/begin COMPU_VTAB tVelocityControllerFfCmpTq "" TAB_VERB 4 0 "VEL_CTRL_TQ_CMP_COAST_DOWN" 1 "VEL_CTRL_TQ_CMP_ROAD_GRDT" 2 "VEL_CTRL_TQ_CMP_REF_ACCEL" 3 "NUM_OF_VEL_CTRL_TQ_CMP" /end COMPU_VTAB
/begin COMPU_VTAB tDriveConfiguration "" TAB_VERB 4 0 "DRV_CFG_UNKNOWN" 1 "DRV_CFG_AWD" 2 "DRV_CFG_FWD" 3 "DRV_CFG_RWD" /end COMPU_VTAB
/begin COMPU_VTAB tGear "" TAB_VERB 11 0 "GEAR_INVALID" 1 "GEAR_1" 2 "GEAR_2" 3 "GEAR_3" 4 "GEAR_4" 5 "GEAR_5" 6 "GEAR_6" 7 "GEAR_7" 8 "GEAR_8" 9 "GEAR_9" 10 "GEAR_N" /end COMPU_VTAB
/begin COMPU_VTAB tPerformanceModeCptIdx "" TAB_VERB 14 0 "CPT_PERF_MOD_UKWN" 1 "CPT_PERF_MOD_PRPL_MOD" 2 "CPT_PERF_MOD_RHC" 3 "CPT_PERF_MOD_PEDAL_MAP" 4 "CPT_PERF_MOD_RGN" 5 "CPT_PERF_MOD_PERF_STGY" 6 "CPT_PERF_MOD_AUTO_SHIFT_MOD" 7 "CPT_PERF_MOD_LC" 8 "CPT_PERF_MOD_DDC" 9 "CPT_PERF_MOD_IEB_VDC" 10 "CPT_PERF_MOD_EPS" 11 "CPT_PERF_MOD_TPMS" 12 "CPT_PERF_MOD_SPD_LIM" 13 "NUM_OF_CPT_PERF_MOD" /end COMPU_VTAB
/begin COMPU_VTAB tEnableState "" TAB_VERB 4 0 "ENA_ST_UNKNOWN" 1 "ENA_ST_OFF" 2 "ENA_ST_ON" 3 "ENA_ST_FLT" /end COMPU_VTAB
/begin COMPU_VTAB tThermalStatus "" TAB_VERB 8 0 "THERM_STS_UNKNOWN" 1 "THERM_STS_COLD" 2 "THERM_STS_LOW" 3 "THERM_STS_NOMINAL_LOW" 4 "THERM_STS_NOMINAL" 5 "THERM_STS_NOMINAL_HIGH" 6 "THERM_STS_HIGH" 7 "THERM_STS_HOT" /end COMPU_VTAB
/begin COMPU_VTAB tTireMdlPacejkaAxes "" TAB_VERB 3 0 "TIRE_AXIS_LGT" 1 "TIRE_AXIS_LAT" 2 "NUM_TIRE_AXES" /end COMPU_VTAB
/begin COMPU_VTAB tTireMdlPacejkaParamIdx "" TAB_VERB 13 0 "TIRE_MDL_PRM_B_X" 1 "TIRE_MDL_PRM_B_Y" 2 "TIRE_MDL_PRM_C_X" 3 "TIRE_MDL_PRM_C_Y" 4 "TIRE_MDL_PRM_E_X" 5 "TIRE_MDL_PRM_E_Y" 6 "TIRE_MDL_PRM_SH_X" 7 "TIRE_MDL_PRM_SH_Y" 8 "TIRE_MDL_PRM_SV_X" 9 "TIRE_MDL_PRM_SV_Y" 10 "TIRE_MDL_PRM_FZ_NOM" 11 "TIRE_MDL_PRM_P_NOM" 12 "NUM_OF_TIRE_MDL_PRM" /end COMPU_VTAB
/begin COMPU_VTAB tSupportingMode "" TAB_VERB 7 0 "SUPPG_MOD_UNKNOWN" 1 "SUPPG_MOD_NONE" 2 "SUPPG_MOD_LIFT" 3 "SUPPG_MOD_DYNO" 4 "SUPPG_MOD_DAMP_SERV" 5 "SUPPG_MOD_TRANSPORT" 6 "SUPPG_MOD_STAGE" /end COMPU_VTAB
/begin COMPU_VTAB tDamperError "" TAB_VERB 3 0 "DMP_ERR_UNKNOWN" 1 "DMP_ERR_ACTIVE" 2 "DMP_ERR_CLEAR" /end COMPU_VTAB
/begin COMPU_VTAB tSensorStatus "" TAB_VERB 3 0 "SNSR_STS_UNKNOWN" 1 "SNSR_STS_FAILURE" 2 "SNSR_STS_NO_FAILURE" /end COMPU_VTAB
/begin COMPU_VTAB tHandsOffSteering "" TAB_VERB 4 0 "HND_STEER_UNKNOWN" 1 "HND_STEER_UNAVAILABLE_OR_FAULT" 2 "HND_STEER_HND_ON" 3 "HND_STEER_HND_OFF" /end COMPU_VTAB
/begin COMPU_VTAB tHillHoldDirection "" TAB_VERB 4 0 "HHC_DIR_UNKNOWN" 1 "HHC_DIR_STANDSTILL" 2 "HHC_DIR_FRONT_UPHILL" 3 "HHC_DIR_FRONT_DOWNHILL" /end COMPU_VTAB
/begin COMPU_VTAB tHillHoldInhibitReq "" TAB_VERB 3 0 "HHC_REQ_UKWN" 1 "HHC_REQ_INHBD" 2 "HHC_REQ_ALLWD" /end COMPU_VTAB
/begin COMPU_VTAB tImuStatus "" TAB_VERB 1 0 "IMU_STS_NO_MISTAKE" 0 "IMU_STS_UNDERVOLTAGE" 0 "IMU_STS_OVERVOLTAGE" 0 "IMU_STS_SYNC_UNDERFLOW" 0 "IMU_STS_SYNC_FAIL" 0 "IMU_STS_FUNC_NOT_AVAILABLE" 0 "IMU_STS_FUNC_ERROR" 0 "IMU_STS_UNFILLED" /end COMPU_VTAB
/begin COMPU_VTAB tWheelClutchRateSource "" TAB_VERB 2 0 "WHL_CLU_RATE_SRC_CLU_SNSR" 1 "WHL_CLU_RATE_SRC_IEB_WHL_RATE" /end COMPU_VTAB
/begin COMPU_VTAB tHybSmState "" TAB_VERB 7 0 "HYB_SM_OFF" 1 "HYB_SM_SHUTDOWN" 2 "HYB_SM_SAFESTATE" 3 "HYB_SM_PRECHARGING" 4 "HYB_SM_LIVE" 5 "HYB_SM_RUNNING" 6 "HYB_SM_CHARGING" /end COMPU_VTAB
/begin COMPU_VTAB tInvCtrlMode "" TAB_VERB 4 0 "INV_CTRL_MODE_NONE" 1 "INV_CTRL_MODE_TORQUE" 2 "INV_CTRL_MODE_SPEED" 3 "INV_CTRL_MODE_MAX" /end COMPU_VTAB
/begin COMPU_VTAB tLiftPosnCalIdx "" TAB_VERB 3 0 "LIFT_POSN_CAL_IDX_CMPD" 1 "LIFT_POSN_CAL_IDX_EXTD" 2 "LIFT_POSN_CAL_LEN" /end COMPU_VTAB
/begin COMPU_VTAB tWhlTrvlCalIdx "" TAB_VERB 5 0 "WHL_TRVL_CAL_FULL_DROOP" 1 "WHL_TRVL_CAL_LIFT_UP" 2 "WHL_TRVL_CAL_LIFT_DOWN" 3 "WHL_TRVL_CAL_FULL_BUMP" 4 "WHL_TRVL_CAL_LEN" /end COMPU_VTAB
/begin COMPU_VTAB tAccVehicleType "" TAB_VERB 5 0 "VEH_TYPE_UNKNOWN" 1 "VEH_TYPE_CAR" 2 "VEH_TYPE_TRUCK" 3 "VEH_TYPE_BICYCLE" 4 "VEH_TYPE_MOTORCYCLE" /end COMPU_VTAB
/begin COMPU_VTAB tAccCameraVisibilityState "" TAB_VERB 3 0 "ACC_CAMERA_VISY_UKWN" 1 "ACC_CAMERA_VISY_OK" 2 "ACC_CAMERA_VISY_BLKD" /end COMPU_VTAB
/begin COMPU_VTAB tWiperStatus "" TAB_VERB 5 0 "WIPER_UNKNOWN" 1 "WIPER_OFF" 2 "WIPER_INTERMITTENT" 3 "WIPER_SLOW" 4 "WIPER_FAST" /end COMPU_VTAB
/begin COMPU_VTAB tVsoWheelLoadCpt "" TAB_VERB 8 0 "WHL_LOAD_CPT_SPRG" 1 "WHL_LOAD_CPT_DAMPR" 2 "WHL_LOAD_CPT_ARB_FRNT" 3 "WHL_LOAD_CPT_ARB_RE" 4 "WHL_LOAD_CPT_ANTI_DRV" 5 "WHL_LOAD_CPT_ANTI_BRK" 6 "WHL_LOAD_CPT_LAT_FORCE" 7 "NUM_OF_WHL_LOAD_CPT" /end COMPU_VTAB
/begin COMPU_VTAB ETPU_VERSION "" TAB_VERB 3 0 "ETPU_VERSION_1" 1 "ETPU_VERSION_2" 2 "ETPU_VERSION_2P" /end COMPU_VTAB
/begin COMPU_VTAB ETPU_ENGINE "" TAB_VERB 3 0 "ETPU_ENGINE_A" 1 "ETPU_ENGINE_B" 2 "ETPU_ENGINE_C" /end COMPU_VTAB
/begin CHARACTERISTIC gEcuName "" ASCII 0x40024C04 __UByte_Value 0 NO_COMPU_METHOD 0 255 NUMBER 20
 /begin IF_DATA XCP
  /begin DAQ_EVENT VARIABLE /begin DEFAULT_EVENT_LIST EVENT 3 /end DEFAULT_EVENT_LIST /end DAQ_EVENT
 /end IF_DATA
/end CHARACTERISTIC
/begin CHARACTERISTIC gCalId "" ASCII 0x40024C3C __UByte_Value 0 NO_COMPU_METHOD 0 255 NUMBER 16
 /begin IF_DATA XCP
  /begin DAQ_EVENT VARIABLE /begin DEFAULT_EVENT_LIST EVENT 3 /end DEFAULT_EVENT_LIST /end DAQ_EVENT
 /end IF_DATA
/end CHARACTERISTIC
/begin MEASUREMENT SERVICE_09_0A_ECUNAME "" UBYTE NO_COMPU_METHOD 0 0 0 255 MATRIX_DIM 20 FORMAT "%.0" ECU_ADDRESS 0x40024c50 READ_WRITE
 /begin IF_DATA XCP
  /begin DAQ_EVENT VARIABLE /begin DEFAULT_EVENT_LIST EVENT 3 /end DEFAULT_EVENT_LIST /end DAQ_EVENT
 /end IF_DATA
/end MEASUREMENT
/begin INSTANCE eTPU_engine_A "" etpu_awac_engine_t 0x400252A0 READ_WRITE SYMBOL_LINK "eTPU_engine_A" 0
 /begin IF_DATA XCP
  /begin DAQ_EVENT VARIABLE /begin DEFAULT_EVENT_LIST EVENT 3 /end DEFAULT_EVENT_LIST /end DAQ_EVENT
 /end IF_DATA
/end INSTANCE
/begin INSTANCE eTPU_engine_B "" etpu_awac_engine_t 0x400252C8 READ_WRITE SYMBOL_LINK "eTPU_engine_B" 0
 /begin IF_DATA XCP
  /begin DAQ_EVENT VARIABLE /begin DEFAULT_EVENT_LIST EVENT 3 /end DEFAULT_EVENT_LIST /end DAQ_EVENT
 /end IF_DATA
/end INSTANCE
/begin INSTANCE etpu_config "" etpu_awac_config_t 0x400252F0 READ_WRITE SYMBOL_LINK "etpu_config" 0
 /begin IF_DATA XCP
  /begin DAQ_EVENT VARIABLE /begin DEFAULT_EVENT_LIST EVENT 3 /end DEFAULT_EVENT_LIST /end DAQ_EVENT
 /end IF_DATA
/end INSTANCE
/begin INSTANCE eTPU_engine_C "" etpu_awac_engine_t 0x4002531C READ_WRITE SYMBOL_LINK "eTPU_engine_C" 0
 /begin IF_DATA XCP
  /begin DAQ_EVENT VARIABLE /begin DEFAULT_EVENT_LIST EVENT 3 /end DEFAULT_EVENT_LIST /end DAQ_EVENT
 /end IF_DATA
/end INSTANCE
/begin MEASUREMENT _SCM_code_mem_array "" ULONG NO_COMPU_METHOD 0 0 0 4294967295 MATRIX_DIM 3072 FORMAT "%.0" ECU_ADDRESS 0x40025344 READ_WRITE
 /begin IF_DATA XCP
  /begin DAQ_EVENT VARIABLE /begin DEFAULT_EVENT_LIST EVENT 3 /end DEFAULT_EVENT_LIST /end DAQ_EVENT
 /end IF_DATA
/end MEASUREMENT
/begin INSTANCE etpu_c_config "" etpu_awac_config_t 0x40028344 READ_WRITE SYMBOL_LINK "etpu_c_config" 0
 /begin IF_DATA XCP
  /begin DAQ_EVENT VARIABLE /begin DEFAULT_EVENT_LIST EVENT 3 /end DEFAULT_EVENT_LIST /end DAQ_EVENT
 /end IF_DATA
/end INSTANCE
/begin MEASUREMENT CTestInvStateMachineRun "" UBYTE NO_COMPU_METHOD 0 0 0 1 FORMAT "%.2" ECU_ADDRESS 0x40028370 READ_WRITE
 /begin IF_DATA XCP
  /begin DAQ_EVENT VARIABLE /begin DEFAULT_EVENT_LIST EVENT 3 /end DEFAULT_EVENT_LIST /end DAQ_EVENT
 /end IF_DATA
/end MEASUREMENT
/begin MEASUREMENT CRunEBrakeStateM "" UBYTE NO_COMPU_METHOD 0 0 0 1 FORMAT "%.2" ECU_ADDRESS 0x40028372 READ_WRITE
 /begin IF_DATA XCP
  /begin DAQ_EVENT VARIABLE /begin DEFAULT_EVENT_LIST EVENT 3 /end DEFAULT_EVENT_LIST /end DAQ_EVENT
 /end IF_DATA
/end MEASUREMENT
/begin MEASUREMENT BResetEbrakesOCTrigger "" UBYTE NO_COMPU_METHOD 0 0 0 1 FORMAT "%.2" ECU_ADDRESS 0x40028373 READ_WRITE
 /begin IF_DATA XCP
  /begin DAQ_EVENT VARIABLE /begin DEFAULT_EVENT_LIST EVENT 3 /end DEFAULT_EVENT_LIST /end DAQ_EVENT
 /end IF_DATA
/end MEASUREMENT
/begin MEASUREMENT CPerfModCalTab "" UBYTE NO_COMPU_METHOD 0 0 0 255 MATRIX_DIM 13 7 FORMAT "%.0" ECU_ADDRESS 0x40028374 READ_WRITE
 /begin IF_DATA XCP
  /begin DAQ_EVENT VARIABLE /begin DEFAULT_EVENT_LIST EVENT 3 /end DEFAULT_EVENT_LIST /end DAQ_EVENT
 /end IF_DATA
/end MEASUREMENT
/begin MEASUREMENT CPedlCurveLookupXsp "" FLOAT32_IEEE NO_COMPU_METHOD 0 0 -3.40282346639E+38 3.40282346639E+38 MATRIX_DIM 21 FORMAT "%.6" ECU_ADDRESS 0x400283d0 READ_WRITE
 /begin IF_DATA XCP
  /begin DAQ_EVENT VARIABLE /begin DEFAULT_EVENT_LIST EVENT 3 /end DEFAULT_EVENT_LIST /end DAQ_EVENT
 /end IF_DATA
/end MEASUREMENT
/begin MEASUREMENT CPedlCurveLookupTab "" FLOAT32_IEEE NO_COMPU_METHOD 0 0 -3.40282346639E+38 3.40282346639E+38 MATRIX_DIM 21 FORMAT "%.6" ECU_ADDRESS 0x40028424 READ_WRITE
 /begin IF_DATA XCP
  /begin DAQ_EVENT VARIABLE /begin DEFAULT_EVENT_LIST EVENT 3 /end DEFAULT_EVENT_LIST /end DAQ_EVENT
 /end IF_DATA
/end MEASUREMENT
/begin MEASUREMENT tpmsWarnLampSts "" UBYTE NO_COMPU_METHOD 0 0 0 255 FORMAT "%.0" ECU_ADDRESS 0x4002847c READ_WRITE
 /begin IF_DATA XCP
  /begin DAQ_EVENT VARIABLE /begin DEFAULT_EVENT_LIST EVENT 3 /end DEFAULT_EVENT_LIST /end DAQ_EVENT
 /end IF_DATA
/end MEASUREMENT
/begin MEASUREMENT CTestDsoCf "" FLOAT32_IEEE NO_COMPU_METHOD 0 0 -3.40282346639E+38 3.40282346639E+38 FORMAT "%.6" ECU_ADDRESS 0x40028480 READ_WRITE
 /begin IF_DATA XCP
  /begin DAQ_EVENT VARIABLE /begin DEFAULT_EVENT_LIST EVENT 3 /end DEFAULT_EVENT_LIST /end DAQ_EVENT
 /end IF_DATA
/end MEASUREMENT
/begin MEASUREMENT CTestDsoCr "" FLOAT32_IEEE NO_COMPU_METHOD 0 0 -3.40282346639E+38 3.40282346639E+38 FORMAT "%.6" ECU_ADDRESS 0x40028484 READ_WRITE
 /begin IF_DATA XCP
  /begin DAQ_EVENT VARIABLE /begin DEFAULT_EVENT_LIST EVENT 3 /end DEFAULT_EVENT_LIST /end DAQ_EVENT
 /end IF_DATA
/end MEASUREMENT
/begin CHARACTERISTIC crcAscii "" ASCII 0x40037BA4 __UByte_Value 0 NO_COMPU_METHOD 0 255 NUMBER 8
 /begin IF_DATA XCP
  /begin DAQ_EVENT VARIABLE /begin DEFAULT_EVENT_LIST EVENT 3 /end DEFAULT_EVENT_LIST /end DAQ_EVENT
 /end IF_DATA
/end CHARACTERISTIC
/begin MEASUREMENT availableAdaptionFlashDebug "" ULONG NO_COMPU_METHOD 0 0 0 4294967295 FORMAT "%.0" ECU_ADDRESS 0x400386b8 READ_WRITE
 /begin IF_DATA XCP
  /begin DAQ_EVENT VARIABLE /begin DEFAULT_EVENT_LIST EVENT 3 /end DEFAULT_EVENT_LIST /end DAQ_EVENT
 /end IF_DATA
/end MEASUREMENT
/begin MEASUREMENT gCalCvn "" UBYTE tHex_U8 0 0 0 255 MATRIX_DIM 4 ECU_ADDRESS 0x40038af0 READ_WRITE
 /begin IF_DATA XCP
  /begin DAQ_EVENT VARIABLE /begin DEFAULT_EVENT_LIST EVENT 3 /end DEFAULT_EVENT_LIST /end DAQ_EVENT
 /end IF_DATA
/end MEASUREMENT
/begin MEASUREMENT gCalDataCrc "" UBYTE tHex_U8 0 0 0 255 MATRIX_DIM 4 ECU_ADDRESS 0x40038af4 READ_WRITE
 /begin IF_DATA XCP
  /begin DAQ_EVENT VARIABLE /begin DEFAULT_EVENT_LIST EVENT 3 /end DEFAULT_EVENT_LIST /end DAQ_EVENT
 /end IF_DATA
/end MEASUREMENT
/begin MEASUREMENT MIL_Distance "" UWORD NO_COMPU_METHOD 0 0 0 65535 FORMAT "%.0" ECU_ADDRESS 0x40039548 READ_WRITE
 /begin IF_DATA XCP
  /begin DAQ_EVENT VARIABLE /begin DEFAULT_EVENT_LIST EVENT 3 /end DEFAULT_EVENT_LIST /end DAQ_EVENT
 /end IF_DATA
/end MEASUREMENT
/begin MEASUREMENT drivingCycleCnt80 "" ULONG NO_COMPU_METHOD 0 0 0 4294967295 MATRIX_DIM 6 FORMAT "%.0" ECU_ADDRESS 0x4003954c READ_WRITE
 /begin IF_DATA XCP
  /begin DAQ_EVENT VARIABLE /begin DEFAULT_EVENT_LIST EVENT 3 /end DEFAULT_EVENT_LIST /end DAQ_EVENT
 /end IF_DATA
/end MEASUREMENT
/begin INSTANCE DTCList "" tDTC 0x40039564 READ_WRITE MATRIX_DIM 15 SYMBOL_LINK "DTCList" 0
 /begin IF_DATA XCP
  /begin DAQ_EVENT VARIABLE /begin DEFAULT_EVENT_LIST EVENT 3 /end DEFAULT_EVENT_LIST /end DAQ_EVENT
 /end IF_DATA
/end INSTANCE
/begin MEASUREMENT max_DTCs_to_debug "" UBYTE NO_COMPU_METHOD 0 0 0 255 FORMAT "%.0" ECU_ADDRESS 0x400396cc READ_WRITE
 /begin IF_DATA XCP
  /begin DAQ_EVENT VARIABLE /begin DEFAULT_EVENT_LIST EVENT 3 /end DEFAULT_EVENT_LIST /end DAQ_EVENT
 /end IF_DATA
/end MEASUREMENT
/begin MEASUREMENT Last_ReportOk "" ULONG NO_COMPU_METHOD 0 0 0 4294967295 MATRIX_DIM 6 FORMAT "%.0" ECU_ADDRESS 0x400396d0 READ_WRITE
 /begin IF_DATA XCP
  /begin DAQ_EVENT VARIABLE /begin DEFAULT_EVENT_LIST EVENT 3 /end DEFAULT_EVENT_LIST /end DAQ_EVENT
 /end IF_DATA
/end MEASUREMENT
/begin MEASUREMENT Last_ReportFault "" ULONG NO_COMPU_METHOD 0 0 0 4294967295 MATRIX_DIM 6 FORMAT "%.0" ECU_ADDRESS 0x400396e8 READ_WRITE
 /begin IF_DATA XCP
  /begin DAQ_EVENT VARIABLE /begin DEFAULT_EVENT_LIST EVENT 3 /end DEFAULT_EVENT_LIST /end DAQ_EVENT
 /end IF_DATA
/end MEASUREMENT
/begin MEASUREMENT B_DenominatorConditionsMet "" UBYTE NO_COMPU_METHOD 0 0 0 1 FORMAT "%.2" ECU_ADDRESS 0x40039700 READ_WRITE
 /begin IF_DATA XCP
  /begin DAQ_EVENT VARIABLE /begin DEFAULT_EVENT_LIST EVENT 3 /end DEFAULT_EVENT_LIST /end DAQ_EVENT
 /end IF_DATA
/end MEASUREMENT
/begin MEASUREMENT DTCListToggle "" UWORD NO_COMPU_METHOD 0 0 0 65535 FORMAT "%.0" ECU_ADDRESS 0x40039702 READ_WRITE
 /begin IF_DATA XCP
  /begin DAQ_EVENT VARIABLE /begin DEFAULT_EVENT_LIST EVENT 3 /end DEFAULT_EVENT_LIST /end DAQ_EVENT
 /end IF_DATA
/end MEASUREMENT
/begin MEASUREMENT DTCListD "" UWORD NO_COMPU_METHOD 0 0 0 65535 MATRIX_DIM 6 FORMAT "%.0" ECU_ADDRESS 0x40039704 READ_WRITE
 /begin IF_DATA XCP
  /begin DAQ_EVENT VARIABLE /begin DEFAULT_EVENT_LIST EVENT 3 /end DEFAULT_EVENT_LIST /end DAQ_EVENT
 /end IF_DATA
/end MEASUREMENT
/begin MEASUREMENT FreezeDTC "" UWORD NO_COMPU_METHOD 0 0 0 65535 MATRIX_DIM 4 FORMAT "%.0" ECU_ADDRESS 0x40039710 READ_WRITE
 /begin IF_DATA XCP
  /begin DAQ_EVENT VARIABLE /begin DEFAULT_EVENT_LIST EVENT 3 /end DEFAULT_EVENT_LIST /end DAQ_EVENT
 /end IF_DATA
/end MEASUREMENT
/begin MEASUREMENT max_FreezeFrames_to_debug "" UBYTE NO_COMPU_METHOD 0 0 0 255 FORMAT "%.0" ECU_ADDRESS 0x40039718 READ_WRITE
 /begin IF_DATA XCP
  /begin DAQ_EVENT VARIABLE /begin DEFAULT_EVENT_LIST EVENT 3 /end DEFAULT_EVENT_LIST /end DAQ_EVENT
 /end IF_DATA
/end MEASUREMENT
/begin MEASUREMENT dCond_rpm "" SWORD NO_COMPU_METHOD 0 0 -32768 32767 MATRIX_DIM 6 FORMAT "%.0" ECU_ADDRESS 0x4003971a READ_WRITE
 /begin IF_DATA XCP
  /begin DAQ_EVENT VARIABLE /begin DEFAULT_EVENT_LIST EVENT 3 /end DEFAULT_EVENT_LIST /end DAQ_EVENT
 /end IF_DATA
/end MEASUREMENT
/begin MEASUREMENT mil_status "" UBYTE NO_COMPU_METHOD 0 0 0 255 MATRIX_DIM 6 FORMAT "%.0" ECU_ADDRESS 0x40039728 READ_WRITE
 /begin IF_DATA XCP
  /begin DAQ_EVENT VARIABLE /begin DEFAULT_EVENT_LIST EVENT 3 /end DEFAULT_EVENT_LIST /end DAQ_EVENT
 /end IF_DATA
/end MEASUREMENT
/begin MEASUREMENT l_DistSinceFaultsCleared "" UWORD NO_COMPU_METHOD 0 0 0 65535 FORMAT "%.0" ECU_ADDRESS 0x4003972e READ_WRITE
 /begin IF_DATA XCP
  /begin DAQ_EVENT VARIABLE /begin DEFAULT_EVENT_LIST EVENT 3 /end DEFAULT_EVENT_LIST /end DAQ_EVENT
 /end IF_DATA
/end MEASUREMENT
/begin MEASUREMENT CTestReadiness "" UBYTE NO_COMPU_METHOD 0 0 0 255 FORMAT "%.0" ECU_ADDRESS 0x40039730 READ_WRITE
 /begin IF_DATA XCP
  /begin DAQ_EVENT VARIABLE /begin DEFAULT_EVENT_LIST EVENT 3 /end DEFAULT_EVENT_LIST /end DAQ_EVENT
 /end IF_DATA
/end MEASUREMENT
/begin MEASUREMENT warmUpCycleCnt40 "" ULONG NO_COMPU_METHOD 0 0 0 4294967295 MATRIX_DIM 6 FORMAT "%.0" ECU_ADDRESS 0x40039734 READ_WRITE
 /begin IF_DATA XCP
  /begin DAQ_EVENT VARIABLE /begin DEFAULT_EVENT_LIST EVENT 3 /end DEFAULT_EVENT_LIST /end DAQ_EVENT
 /end IF_DATA
/end MEASUREMENT
/begin MEASUREMENT SecurityLevel "" UBYTE NO_COMPU_METHOD 0 0 0 255 FORMAT "%.0" ECU_ADDRESS 0x4003974c READ_WRITE
 /begin IF_DATA XCP
  /begin DAQ_EVENT VARIABLE /begin DEFAULT_EVENT_LIST EVENT 3 /end DEFAULT_EVENT_LIST /end DAQ_EVENT
 /end IF_DATA
/end MEASUREMENT
/begin MEASUREMENT FrameSize "" UWORD NO_COMPU_METHOD 0 0 0 65535 FORMAT "%.0" ECU_ADDRESS 0x4003974e READ_WRITE
 /begin IF_DATA XCP
  /begin DAQ_EVENT VARIABLE /begin DEFAULT_EVENT_LIST EVENT 3 /end DEFAULT_EVENT_LIST /end DAQ_EVENT
 /end IF_DATA
/end MEASUREMENT
/begin MEASUREMENT overrideDTCstuff "" UBYTE NO_COMPU_METHOD 0 0 0 255 FORMAT "%.0" ECU_ADDRESS 0x40039750 READ_WRITE
 /begin IF_DATA XCP
  /begin DAQ_EVENT VARIABLE /begin DEFAULT_EVENT_LIST EVENT 3 /end DEFAULT_EVENT_LIST /end DAQ_EVENT
 /end IF_DATA
/end MEASUREMENT
/begin MEASUREMENT NrOfFaults "" UWORD NO_COMPU_METHOD 0 0 0 65535 FORMAT "%.0" ECU_ADDRESS 0x40039752 READ_WRITE
 /begin IF_DATA XCP
  /begin DAQ_EVENT VARIABLE /begin DEFAULT_EVENT_LIST EVENT 3 /end DEFAULT_EVENT_LIST /end DAQ_EVENT
 /end IF_DATA
/end MEASUREMENT
/begin MEASUREMENT b_WarmUpCycleDone "" UBYTE NO_COMPU_METHOD 0 0 0 1 FORMAT "%.2" ECU_ADDRESS 0x40039754 READ_WRITE
 /begin IF_DATA XCP
  /begin DAQ_EVENT VARIABLE /begin DEFAULT_EVENT_LIST EVENT 3 /end DEFAULT_EVENT_LIST /end DAQ_EVENT
 /end IF_DATA
/end MEASUREMENT
/begin MEASUREMENT driveCycleCounter "" UWORD NO_COMPU_METHOD 0 0 0 65535 FORMAT "%.0" ECU_ADDRESS 0x40039756 READ_WRITE
 /begin IF_DATA XCP
  /begin DAQ_EVENT VARIABLE /begin DEFAULT_EVENT_LIST EVENT 3 /end DEFAULT_EVENT_LIST /end DAQ_EVENT
 /end IF_DATA
/end MEASUREMENT
/begin INSTANCE OBD_MonitorStatusSinceClearDTC "" tMonitorStatus 0x40039758 READ_WRITE SYMBOL_LINK "OBD_MonitorStatusSinceClearDTC" 0
 /begin IF_DATA XCP
  /begin DAQ_EVENT VARIABLE /begin DEFAULT_EVENT_LIST EVENT 3 /end DEFAULT_EVENT_LIST /end DAQ_EVENT
 /end IF_DATA
/end INSTANCE
/begin MEASUREMENT dCond_tmot "" SWORD NO_COMPU_METHOD 0 0 -32768 32767 MATRIX_DIM 6 FORMAT "%.0" ECU_ADDRESS 0x4003975c READ_WRITE
 /begin IF_DATA XCP
  /begin DAQ_EVENT VARIABLE /begin DEFAULT_EVENT_LIST EVENT 3 /end DEFAULT_EVENT_LIST /end DAQ_EVENT
 /end IF_DATA
/end MEASUREMENT
/begin MEASUREMENT N_WarmUpCyclesSinceFaultsCleared "" UBYTE NO_COMPU_METHOD 0 0 0 255 FORMAT "%.0" ECU_ADDRESS 0x40039768 READ_WRITE
 /begin IF_DATA XCP
  /begin DAQ_EVENT VARIABLE /begin DEFAULT_EVENT_LIST EVENT 3 /end DEFAULT_EVENT_LIST /end DAQ_EVENT
 /end IF_DATA
/end MEASUREMENT
/begin MEASUREMENT B_OutsideDrivingCycle "" UBYTE NO_COMPU_METHOD 0 0 0 255 FORMAT "%.0" ECU_ADDRESS 0x40039769 READ_WRITE
 /begin IF_DATA XCP
  /begin DAQ_EVENT VARIABLE /begin DEFAULT_EVENT_LIST EVENT 3 /end DEFAULT_EVENT_LIST /end DAQ_EVENT
 /end IF_DATA
/end MEASUREMENT
/begin MEASUREMENT PermanentDTC "" UWORD NO_COMPU_METHOD 0 0 0 65535 MATRIX_DIM 6 FORMAT "%.0" ECU_ADDRESS 0x4003976a READ_WRITE
 /begin IF_DATA XCP
  /begin DAQ_EVENT VARIABLE /begin DEFAULT_EVENT_LIST EVENT 3 /end DEFAULT_EVENT_LIST /end DAQ_EVENT
 /end IF_DATA
/end MEASUREMENT
/begin INSTANCE FreezeFrames "" tFreezeFrame 0x40039776 READ_WRITE MATRIX_DIM 4 SYMBOL_LINK "FreezeFrames" 0
 /begin IF_DATA XCP
  /begin DAQ_EVENT VARIABLE /begin DEFAULT_EVENT_LIST EVENT 3 /end DEFAULT_EVENT_LIST /end DAQ_EVENT
 /end IF_DATA
/end INSTANCE
/begin MEASUREMENT n_WarmUpCycles "" UWORD NO_COMPU_METHOD 0 0 0 65535 FORMAT "%.0" ECU_ADDRESS 0x400397b6 READ_WRITE
 /begin IF_DATA XCP
  /begin DAQ_EVENT VARIABLE /begin DEFAULT_EVENT_LIST EVENT 3 /end DEFAULT_EVENT_LIST /end DAQ_EVENT
 /end IF_DATA
/end MEASUREMENT
/begin MEASUREMENT dCond_load "" SWORD NO_COMPU_METHOD 0 0 -32768 32767 MATRIX_DIM 6 FORMAT "%.0" ECU_ADDRESS 0x400397b8 READ_WRITE
 /begin IF_DATA XCP
  /begin DAQ_EVENT VARIABLE /begin DEFAULT_EVENT_LIST EVENT 3 /end DEFAULT_EVENT_LIST /end DAQ_EVENT
 /end IF_DATA
/end MEASUREMENT
/begin MEASUREMENT freezeFrameDTC "" UWORD NO_COMPU_METHOD 0 0 0 65535 FORMAT "%.0" ECU_ADDRESS 0x400397c4 READ_WRITE
 /begin IF_DATA XCP
  /begin DAQ_EVENT VARIABLE /begin DEFAULT_EVENT_LIST EVENT 3 /end DEFAULT_EVENT_LIST /end DAQ_EVENT
 /end IF_DATA
/end MEASUREMENT
/begin MEASUREMENT SeedUpdated "" UBYTE NO_COMPU_METHOD 0 0 0 255 FORMAT "%.0" ECU_ADDRESS 0x40039a59 READ_WRITE
 /begin IF_DATA XCP
  /begin DAQ_EVENT VARIABLE /begin DEFAULT_EVENT_LIST EVENT 3 /end DEFAULT_EVENT_LIST /end DAQ_EVENT
 /end IF_DATA
/end MEASUREMENT
/begin MEASUREMENT gCanBDisableTx "" UBYTE NO_COMPU_METHOD 0 0 0 255 FORMAT "%.0" ECU_ADDRESS 0x4003db40 READ_WRITE
 /begin IF_DATA XCP
  /begin DAQ_EVENT VARIABLE /begin DEFAULT_EVENT_LIST EVENT 3 /end DEFAULT_EVENT_LIST /end DAQ_EVENT
 /end IF_DATA
/end MEASUREMENT
/begin MEASUREMENT gCanFDisableTx "" UBYTE NO_COMPU_METHOD 0 0 0 255 FORMAT "%.0" ECU_ADDRESS 0x4004079c READ_WRITE
 /begin IF_DATA XCP
  /begin DAQ_EVENT VARIABLE /begin DEFAULT_EVENT_LIST EVENT 3 /end DEFAULT_EVENT_LIST /end DAQ_EVENT
 /end IF_DATA
/end MEASUREMENT
/begin INSTANCE instance "" ExampleStruct 0x400408A0 READ_WRITE SYMBOL_LINK "instance" 0
 /begin IF_DATA XCP
  /begin DAQ_EVENT VARIABLE /begin DEFAULT_EVENT_LIST EVENT 3 /end DEFAULT_EVENT_LIST /end DAQ_EVENT
 /end IF_DATA
/end INSTANCE
/begin MEASUREMENT gConfigNvmDataStatus "" UBYTE NO_COMPU_METHOD 0 0 0 255 FORMAT "%.0" ECU_ADDRESS 0x400408a8 READ_WRITE
 /begin IF_DATA XCP
  /begin DAQ_EVENT VARIABLE /begin DEFAULT_EVENT_LIST EVENT 3 /end DEFAULT_EVENT_LIST /end DAQ_EVENT
 /end IF_DATA
/end MEASUREMENT
/begin MEASUREMENT gUserCommonNvmDataStatus "" UBYTE NO_COMPU_METHOD 0 0 0 255 FORMAT "%.0" ECU_ADDRESS 0x40040920 READ_WRITE
 /begin IF_DATA XCP
  /begin DAQ_EVENT VARIABLE /begin DEFAULT_EVENT_LIST EVENT 3 /end DEFAULT_EVENT_LIST /end DAQ_EVENT
 /end IF_DATA
/end MEASUREMENT
/begin MEASUREMENT canAPowertrainTelltales2 "" UBYTE NO_COMPU_METHOD 0 0 0 255 MATRIX_DIM 5 FORMAT "%.0" ECU_ADDRESS 0x40040978 READ_WRITE
 /begin IF_DATA XCP
  /begin DAQ_EVENT VARIABLE /begin DEFAULT_EVENT_LIST EVENT 3 /end DEFAULT_EVENT_LIST /end DAQ_EVENT
 /end IF_DATA
/end MEASUREMENT
/begin MEASUREMENT canAGvcuAdaptiveCruiseControl "" UBYTE NO_COMPU_METHOD 0 0 0 255 MATRIX_DIM 5 FORMAT "%.0" ECU_ADDRESS 0x40040980 READ_WRITE
 /begin IF_DATA XCP
  /begin DAQ_EVENT VARIABLE /begin DEFAULT_EVENT_LIST EVENT 3 /end DEFAULT_EVENT_LIST /end DAQ_EVENT
 /end IF_DATA
/end MEASUREMENT
/begin MEASUREMENT canAGvcuHvControl "" UBYTE NO_COMPU_METHOD 0 0 0 255 MATRIX_DIM 6 FORMAT "%.0" ECU_ADDRESS 0x400409c0 READ_WRITE
 /begin IF_DATA XCP
  /begin DAQ_EVENT VARIABLE /begin DEFAULT_EVENT_LIST EVENT 3 /end DEFAULT_EVENT_LIST /end DAQ_EVENT
 /end IF_DATA
/end MEASUREMENT
/begin MEASUREMENT canAPowertrainInformationMessages "" UBYTE NO_COMPU_METHOD 0 0 0 255 MATRIX_DIM 8 FORMAT "%.0" ECU_ADDRESS 0x400409d4 READ_WRITE
 /begin IF_DATA XCP
  /begin DAQ_EVENT VARIABLE /begin DEFAULT_EVENT_LIST EVENT 3 /end DEFAULT_EVENT_LIST /end DAQ_EVENT
 /end IF_DATA
/end MEASUREMENT
/begin MEASUREMENT canAGvcuCogImu "" UBYTE NO_COMPU_METHOD 0 0 0 255 MATRIX_DIM 8 FORMAT "%.0" ECU_ADDRESS 0x400409e0 READ_WRITE
 /begin IF_DATA XCP
  /begin DAQ_EVENT VARIABLE /begin DEFAULT_EVENT_LIST EVENT 3 /end DEFAULT_EVENT_LIST /end DAQ_EVENT
 /end IF_DATA
/end MEASUREMENT
/begin MEASUREMENT canAPowertrainTelltales1 "" UBYTE NO_COMPU_METHOD 0 0 0 255 MATRIX_DIM 8 FORMAT "%.0" ECU_ADDRESS 0x40040a10 READ_WRITE
 /begin IF_DATA XCP
  /begin DAQ_EVENT VARIABLE /begin DEFAULT_EVENT_LIST EVENT 3 /end DEFAULT_EVENT_LIST /end DAQ_EVENT
 /end IF_DATA
/end MEASUREMENT
/begin MEASUREMENT canAGvcuPerfMod "" UBYTE NO_COMPU_METHOD 0 0 0 255 MATRIX_DIM 5 FORMAT "%.0" ECU_ADDRESS 0x40040a1c READ_WRITE
 /begin IF_DATA XCP
  /begin DAQ_EVENT VARIABLE /begin DEFAULT_EVENT_LIST EVENT 3 /end DEFAULT_EVENT_LIST /end DAQ_EVENT
 /end IF_DATA
/end MEASUREMENT
/begin MEASUREMENT canAGvcuCruiseControlMasks "" UBYTE NO_COMPU_METHOD 0 0 0 255 MATRIX_DIM 8 FORMAT "%.0" ECU_ADDRESS 0x40040a2c READ_WRITE
 /begin IF_DATA XCP
  /begin DAQ_EVENT VARIABLE /begin DEFAULT_EVENT_LIST EVENT 3 /end DEFAULT_EVENT_LIST /end DAQ_EVENT
 /end IF_DATA
/end MEASUREMENT
/begin MEASUREMENT canADiagRespEpsBG1 "" UBYTE NO_COMPU_METHOD 0 0 0 255 MATRIX_DIM 8 FORMAT "%.0" ECU_ADDRESS 0x40040a44 READ_WRITE
 /begin IF_DATA XCP
  /begin DAQ_EVENT VARIABLE /begin DEFAULT_EVENT_LIST EVENT 3 /end DEFAULT_EVENT_LIST /end DAQ_EVENT
 /end IF_DATA
/end MEASUREMENT
/begin MEASUREMENT canAGvcuOdometer "" UBYTE NO_COMPU_METHOD 0 0 0 255 MATRIX_DIM 4 FORMAT "%.0" ECU_ADDRESS 0x40040a50 READ_WRITE
 /begin IF_DATA XCP
  /begin DAQ_EVENT VARIABLE /begin DEFAULT_EVENT_LIST EVENT 3 /end DEFAULT_EVENT_LIST /end DAQ_EVENT
 /end IF_DATA
/end MEASUREMENT
/begin MEASUREMENT canAGvcuNodesEnableHold "" UBYTE NO_COMPU_METHOD 0 0 0 255 MATRIX_DIM 4 FORMAT "%.0" ECU_ADDRESS 0x40040ab8 READ_WRITE
 /begin IF_DATA XCP
  /begin DAQ_EVENT VARIABLE /begin DEFAULT_EVENT_LIST EVENT 3 /end DEFAULT_EVENT_LIST /end DAQ_EVENT
 /end IF_DATA
/end MEASUREMENT
/begin MEASUREMENT canAGvcuVehState3 "" UBYTE NO_COMPU_METHOD 0 0 0 255 MATRIX_DIM 5 FORMAT "%.0" ECU_ADDRESS 0x40040ae4 READ_WRITE
 /begin IF_DATA XCP
  /begin DAQ_EVENT VARIABLE /begin DEFAULT_EVENT_LIST EVENT 3 /end DEFAULT_EVENT_LIST /end DAQ_EVENT
 /end IF_DATA
/end MEASUREMENT
/begin MEASUREMENT canAGvcuAutDrvr "" UBYTE NO_COMPU_METHOD 0 0 0 255 MATRIX_DIM 2 FORMAT "%.0" ECU_ADDRESS 0x40040b20 READ_WRITE
 /begin IF_DATA XCP
  /begin DAQ_EVENT VARIABLE /begin DEFAULT_EVENT_LIST EVENT 3 /end DEFAULT_EVENT_LIST /end DAQ_EVENT
 /end IF_DATA
/end MEASUREMENT
/begin MEASUREMENT canADiagRespIebG1 "" UBYTE NO_COMPU_METHOD 0 0 0 255 MATRIX_DIM 8 FORMAT "%.0" ECU_ADDRESS 0x40040b70 READ_WRITE
 /begin IF_DATA XCP
  /begin DAQ_EVENT VARIABLE /begin DEFAULT_EVENT_LIST EVENT 3 /end DEFAULT_EVENT_LIST /end DAQ_EVENT
 /end IF_DATA
/end MEASUREMENT
/begin MEASUREMENT canAGvcuRearCoolingControl "" UBYTE NO_COMPU_METHOD 0 0 0 255 MATRIX_DIM 7 FORMAT "%.0" ECU_ADDRESS 0x40040b88 READ_WRITE
 /begin IF_DATA XCP
  /begin DAQ_EVENT VARIABLE /begin DEFAULT_EVENT_LIST EVENT 3 /end DEFAULT_EVENT_LIST /end DAQ_EVENT
 /end IF_DATA
/end MEASUREMENT
/begin MEASUREMENT canAGvcuFrontCoolingControl "" UBYTE NO_COMPU_METHOD 0 0 0 255 MATRIX_DIM 8 FORMAT "%.0" ECU_ADDRESS 0x40040bb0 READ_WRITE
 /begin IF_DATA XCP
  /begin DAQ_EVENT VARIABLE /begin DEFAULT_EVENT_LIST EVENT 3 /end DEFAULT_EVENT_LIST /end DAQ_EVENT
 /end IF_DATA
/end MEASUREMENT
/begin MEASUREMENT canADebugInv "" UBYTE NO_COMPU_METHOD 0 0 0 255 MATRIX_DIM 5 FORMAT "%.0" ECU_ADDRESS 0x40040bc0 READ_WRITE
 /begin IF_DATA XCP
  /begin DAQ_EVENT VARIABLE /begin DEFAULT_EVENT_LIST EVENT 3 /end DEFAULT_EVENT_LIST /end DAQ_EVENT
 /end IF_DATA
/end MEASUREMENT
/begin MEASUREMENT canADiagRespImuG1 "" UBYTE NO_COMPU_METHOD 0 0 0 255 MATRIX_DIM 8 FORMAT "%.0" ECU_ADDRESS 0x40040c1c READ_WRITE
 /begin IF_DATA XCP
  /begin DAQ_EVENT VARIABLE /begin DEFAULT_EVENT_LIST EVENT 3 /end DEFAULT_EVENT_LIST /end DAQ_EVENT
 /end IF_DATA
/end MEASUREMENT
/begin MEASUREMENT canADiagRespInverterG1 "" UBYTE NO_COMPU_METHOD 0 0 0 255 MATRIX_DIM 8 FORMAT "%.0" ECU_ADDRESS 0x400413c8 READ_WRITE
 /begin IF_DATA XCP
  /begin DAQ_EVENT VARIABLE /begin DEFAULT_EVENT_LIST EVENT 3 /end DEFAULT_EVENT_LIST /end DAQ_EVENT
 /end IF_DATA
/end MEASUREMENT
/begin MEASUREMENT canATpmsCarData "" UBYTE NO_COMPU_METHOD 0 0 0 255 MATRIX_DIM 6 FORMAT "%.0" ECU_ADDRESS 0x400413f0 READ_WRITE
 /begin IF_DATA XCP
  /begin DAQ_EVENT VARIABLE /begin DEFAULT_EVENT_LIST EVENT 3 /end DEFAULT_EVENT_LIST /end DAQ_EVENT
 /end IF_DATA
/end MEASUREMENT
/begin MEASUREMENT canAGvcuVehState1 "" UBYTE NO_COMPU_METHOD 0 0 0 255 MATRIX_DIM 6 FORMAT "%.0" ECU_ADDRESS 0x40041418 READ_WRITE
 /begin IF_DATA XCP
  /begin DAQ_EVENT VARIABLE /begin DEFAULT_EVENT_LIST EVENT 3 /end DEFAULT_EVENT_LIST /end DAQ_EVENT
 /end IF_DATA
/end MEASUREMENT
/begin MEASUREMENT canADiagRespEpsAG1 "" UBYTE NO_COMPU_METHOD 0 0 0 255 MATRIX_DIM 8 FORMAT "%.0" ECU_ADDRESS 0x40041454 READ_WRITE
 /begin IF_DATA XCP
  /begin DAQ_EVENT VARIABLE /begin DEFAULT_EVENT_LIST EVENT 3 /end DEFAULT_EVENT_LIST /end DAQ_EVENT
 /end IF_DATA
/end MEASUREMENT
/begin MEASUREMENT canADiagAccPhysRespFvcmG1 "" UBYTE NO_COMPU_METHOD 0 0 0 255 MATRIX_DIM 8 FORMAT "%.0" ECU_ADDRESS 0x40041480 READ_WRITE
 /begin IF_DATA XCP
  /begin DAQ_EVENT VARIABLE /begin DEFAULT_EVENT_LIST EVENT 3 /end DEFAULT_EVENT_LIST /end DAQ_EVENT
 /end IF_DATA
/end MEASUREMENT
/begin MEASUREMENT canALiftCmd "" UBYTE NO_COMPU_METHOD 0 0 0 255 MATRIX_DIM 1 FORMAT "%.0" ECU_ADDRESS 0x400414b0 READ_WRITE
 /begin IF_DATA XCP
  /begin DAQ_EVENT VARIABLE /begin DEFAULT_EVENT_LIST EVENT 3 /end DEFAULT_EVENT_LIST /end DAQ_EVENT
 /end IF_DATA
/end MEASUREMENT
/begin MEASUREMENT canAGvcuSleep "" UBYTE NO_COMPU_METHOD 0 0 0 255 MATRIX_DIM 1 FORMAT "%.0" ECU_ADDRESS 0x400414bc READ_WRITE
 /begin IF_DATA XCP
  /begin DAQ_EVENT VARIABLE /begin DEFAULT_EVENT_LIST EVENT 3 /end DEFAULT_EVENT_LIST /end DAQ_EVENT
 /end IF_DATA
/end MEASUREMENT
/begin MEASUREMENT canAGvcuVehState2 "" UBYTE NO_COMPU_METHOD 0 0 0 255 MATRIX_DIM 8 FORMAT "%.0" ECU_ADDRESS 0x400414cc READ_WRITE
 /begin IF_DATA XCP
  /begin DAQ_EVENT VARIABLE /begin DEFAULT_EVENT_LIST EVENT 3 /end DEFAULT_EVENT_LIST /end DAQ_EVENT
 /end IF_DATA
/end MEASUREMENT
/begin MEASUREMENT canBOdometerValueDs1 "" UBYTE NO_COMPU_METHOD 0 0 0 255 MATRIX_DIM 6 FORMAT "%.0" ECU_ADDRESS 0x400414e8 READ_WRITE
 /begin IF_DATA XCP
  /begin DAQ_EVENT VARIABLE /begin DEFAULT_EVENT_LIST EVENT 3 /end DEFAULT_EVENT_LIST /end DAQ_EVENT
 /end IF_DATA
/end MEASUREMENT
/begin MEASUREMENT canBWhlTqActFrontDs1 "" UBYTE NO_COMPU_METHOD 0 0 0 255 MATRIX_DIM 6 FORMAT "%.0" ECU_ADDRESS 0x40041518 READ_WRITE
 /begin IF_DATA XCP
  /begin DAQ_EVENT VARIABLE /begin DEFAULT_EVENT_LIST EVENT 3 /end DEFAULT_EVENT_LIST /end DAQ_EVENT
 /end IF_DATA
/end MEASUREMENT
/begin MEASUREMENT canBPwrSteerDs1 "" UBYTE NO_COMPU_METHOD 0 0 0 255 MATRIX_DIM 6 FORMAT "%.0" ECU_ADDRESS 0x40041558 READ_WRITE
 /begin IF_DATA XCP
  /begin DAQ_EVENT VARIABLE /begin DEFAULT_EVENT_LIST EVENT 3 /end DEFAULT_EVENT_LIST /end DAQ_EVENT
 /end IF_DATA
/end MEASUREMENT
/begin MEASUREMENT canBSystemTimeDs1 "" UBYTE NO_COMPU_METHOD 0 0 0 255 MATRIX_DIM 8 FORMAT "%.0" ECU_ADDRESS 0x4004156c READ_WRITE
 /begin IF_DATA XCP
  /begin DAQ_EVENT VARIABLE /begin DEFAULT_EVENT_LIST EVENT 3 /end DEFAULT_EVENT_LIST /end DAQ_EVENT
 /end IF_DATA
/end MEASUREMENT
/begin MEASUREMENT canBStabilityInfoDs1 "" UBYTE NO_COMPU_METHOD 0 0 0 255 MATRIX_DIM 8 FORMAT "%.0" ECU_ADDRESS 0x4004157c READ_WRITE
 /begin IF_DATA XCP
  /begin DAQ_EVENT VARIABLE /begin DEFAULT_EVENT_LIST EVENT 3 /end DEFAULT_EVENT_LIST /end DAQ_EVENT
 /end IF_DATA
/end MEASUREMENT
/begin MEASUREMENT canBXcpCmdEpsB "" UBYTE NO_COMPU_METHOD 0 0 0 255 MATRIX_DIM 8 FORMAT "%.0" ECU_ADDRESS 0x4004188c READ_WRITE
 /begin IF_DATA XCP
  /begin DAQ_EVENT VARIABLE /begin DEFAULT_EVENT_LIST EVENT 3 /end DEFAULT_EVENT_LIST /end DAQ_EVENT
 /end IF_DATA
/end MEASUREMENT
/begin MEASUREMENT canBWhlTqActRearDs1 "" UBYTE NO_COMPU_METHOD 0 0 0 255 MATRIX_DIM 6 FORMAT "%.0" ECU_ADDRESS 0x40041894 READ_WRITE
 /begin IF_DATA XCP
  /begin DAQ_EVENT VARIABLE /begin DEFAULT_EVENT_LIST EVENT 3 /end DEFAULT_EVENT_LIST /end DAQ_EVENT
 /end IF_DATA
/end MEASUREMENT
/begin MEASUREMENT canBVehicleSpeedDs1 "" UBYTE NO_COMPU_METHOD 0 0 0 255 MATRIX_DIM 4 FORMAT "%.0" ECU_ADDRESS 0x400418c0 READ_WRITE
 /begin IF_DATA XCP
  /begin DAQ_EVENT VARIABLE /begin DEFAULT_EVENT_LIST EVENT 3 /end DEFAULT_EVENT_LIST /end DAQ_EVENT
 /end IF_DATA
/end MEASUREMENT
/begin MEASUREMENT canBDiagReqEpsBG2 "" UBYTE NO_COMPU_METHOD 0 0 0 255 MATRIX_DIM 8 FORMAT "%.0" ECU_ADDRESS 0x400418c8 READ_WRITE
 /begin IF_DATA XCP
  /begin DAQ_EVENT VARIABLE /begin DEFAULT_EVENT_LIST EVENT 3 /end DEFAULT_EVENT_LIST /end DAQ_EVENT
 /end IF_DATA
/end MEASUREMENT
/begin MEASUREMENT canBDiagReqEpsAG2 "" UBYTE NO_COMPU_METHOD 0 0 0 255 MATRIX_DIM 8 FORMAT "%.0" ECU_ADDRESS 0x400418d8 READ_WRITE
 /begin IF_DATA XCP
  /begin DAQ_EVENT VARIABLE /begin DEFAULT_EVENT_LIST EVENT 3 /end DEFAULT_EVENT_LIST /end DAQ_EVENT
 /end IF_DATA
/end MEASUREMENT
/begin MEASUREMENT canBNmRequestGvcuDs1 "" UBYTE NO_COMPU_METHOD 0 0 0 255 MATRIX_DIM 2 FORMAT "%.0" ECU_ADDRESS 0x400418f4 READ_WRITE
 /begin IF_DATA XCP
  /begin DAQ_EVENT VARIABLE /begin DEFAULT_EVENT_LIST EVENT 3 /end DEFAULT_EVENT_LIST /end DAQ_EVENT
 /end IF_DATA
/end MEASUREMENT
/begin MEASUREMENT canBDiagFuncreqEpsG2 "" UBYTE NO_COMPU_METHOD 0 0 0 255 MATRIX_DIM 8 FORMAT "%.0" ECU_ADDRESS 0x40041918 READ_WRITE
 /begin IF_DATA XCP
  /begin DAQ_EVENT VARIABLE /begin DEFAULT_EVENT_LIST EVENT 3 /end DEFAULT_EVENT_LIST /end DAQ_EVENT
 /end IF_DATA
/end MEASUREMENT
/begin MEASUREMENT canBDiagDs1FuncReqG2 "" UBYTE NO_COMPU_METHOD 0 0 0 255 MATRIX_DIM 8 FORMAT "%.0" ECU_ADDRESS 0x40041924 READ_WRITE
 /begin IF_DATA XCP
  /begin DAQ_EVENT VARIABLE /begin DEFAULT_EVENT_LIST EVENT 3 /end DEFAULT_EVENT_LIST /end DAQ_EVENT
 /end IF_DATA
/end MEASUREMENT
/begin MEASUREMENT canBVehicleStatusDs1 "" UBYTE NO_COMPU_METHOD 0 0 0 255 MATRIX_DIM 7 FORMAT "%.0" ECU_ADDRESS 0x40041934 READ_WRITE
 /begin IF_DATA XCP
  /begin DAQ_EVENT VARIABLE /begin DEFAULT_EVENT_LIST EVENT 3 /end DEFAULT_EVENT_LIST /end DAQ_EVENT
 /end IF_DATA
/end MEASUREMENT
/begin MEASUREMENT canBXcpCmdEpsA "" UBYTE NO_COMPU_METHOD 0 0 0 255 MATRIX_DIM 8 FORMAT "%.0" ECU_ADDRESS 0x40041950 READ_WRITE
 /begin IF_DATA XCP
  /begin DAQ_EVENT VARIABLE /begin DEFAULT_EVENT_LIST EVENT 3 /end DEFAULT_EVENT_LIST /end DAQ_EVENT
 /end IF_DATA
/end MEASUREMENT
/begin MEASUREMENT canCGvcuThermalSensor "" UBYTE NO_COMPU_METHOD 0 0 0 255 MATRIX_DIM 2 FORMAT "%.0" ECU_ADDRESS 0x40041b38 READ_WRITE
 /begin IF_DATA XCP
  /begin DAQ_EVENT VARIABLE /begin DEFAULT_EVENT_LIST EVENT 3 /end DEFAULT_EVENT_LIST /end DAQ_EVENT
 /end IF_DATA
/end MEASUREMENT
/begin MEASUREMENT canCGvcuLstReq "" UBYTE NO_COMPU_METHOD 0 0 0 255 MATRIX_DIM 8 FORMAT "%.0" ECU_ADDRESS 0x40041b48 READ_WRITE
 /begin IF_DATA XCP
  /begin DAQ_EVENT VARIABLE /begin DEFAULT_EVENT_LIST EVENT 3 /end DEFAULT_EVENT_LIST /end DAQ_EVENT
 /end IF_DATA
/end MEASUREMENT
/begin MEASUREMENT canCGvcuSts1 "" UBYTE NO_COMPU_METHOD 0 0 0 255 MATRIX_DIM 8 FORMAT "%.0" ECU_ADDRESS 0x40041b64 READ_WRITE
 /begin IF_DATA XCP
  /begin DAQ_EVENT VARIABLE /begin DEFAULT_EVENT_LIST EVENT 3 /end DEFAULT_EVENT_LIST /end DAQ_EVENT
 /end IF_DATA
/end MEASUREMENT
/begin MEASUREMENT canCGvcuSts2 "" UBYTE NO_COMPU_METHOD 0 0 0 255 MATRIX_DIM 7 FORMAT "%.0" ECU_ADDRESS 0x40041b6c READ_WRITE
 /begin IF_DATA XCP
  /begin DAQ_EVENT VARIABLE /begin DEFAULT_EVENT_LIST EVENT 3 /end DEFAULT_EVENT_LIST /end DAQ_EVENT
 /end IF_DATA
/end MEASUREMENT
/begin MEASUREMENT canDAcu01G2 "" UBYTE NO_COMPU_METHOD 0 0 0 255 MATRIX_DIM 2 FORMAT "%.0" ECU_ADDRESS 0x40041ba0 READ_WRITE
 /begin IF_DATA XCP
  /begin DAQ_EVENT VARIABLE /begin DEFAULT_EVENT_LIST EVENT 3 /end DEFAULT_EVENT_LIST /end DAQ_EVENT
 /end IF_DATA
/end MEASUREMENT
/begin MEASUREMENT canDInvMotionCmd "" UBYTE NO_COMPU_METHOD 0 0 0 255 MATRIX_DIM 7 FORMAT "%.0" ECU_ADDRESS 0x40041bb0 READ_WRITE
 /begin IF_DATA XCP
  /begin DAQ_EVENT VARIABLE /begin DEFAULT_EVENT_LIST EVENT 3 /end DEFAULT_EVENT_LIST /end DAQ_EVENT
 /end IF_DATA
/end MEASUREMENT
/begin MEASUREMENT canDDiagReqInverterG2 "" UBYTE NO_COMPU_METHOD 0 0 0 255 MATRIX_DIM 8 FORMAT "%.0" ECU_ADDRESS 0x40041bc4 READ_WRITE
 /begin IF_DATA XCP
  /begin DAQ_EVENT VARIABLE /begin DEFAULT_EVENT_LIST EVENT 3 /end DEFAULT_EVENT_LIST /end DAQ_EVENT
 /end IF_DATA
/end MEASUREMENT
/begin MEASUREMENT canDAcu03G2 "" UBYTE NO_COMPU_METHOD 0 0 0 255 MATRIX_DIM 3 FORMAT "%.0" ECU_ADDRESS 0x40041be0 READ_WRITE
 /begin IF_DATA XCP
  /begin DAQ_EVENT VARIABLE /begin DEFAULT_EVENT_LIST EVENT 3 /end DEFAULT_EVENT_LIST /end DAQ_EVENT
 /end IF_DATA
/end MEASUREMENT
/begin MEASUREMENT canDInvCmd "" UBYTE NO_COMPU_METHOD 0 0 0 255 MATRIX_DIM 4 FORMAT "%.0" ECU_ADDRESS 0x40041dc0 READ_WRITE
 /begin IF_DATA XCP
  /begin DAQ_EVENT VARIABLE /begin DEFAULT_EVENT_LIST EVENT 3 /end DEFAULT_EVENT_LIST /end DAQ_EVENT
 /end IF_DATA
/end MEASUREMENT
/begin MEASUREMENT canEDummyMessage0001 "" UBYTE NO_COMPU_METHOD 0 0 0 255 MATRIX_DIM 1 FORMAT "%.0" ECU_ADDRESS 0x40041dcc READ_WRITE
 /begin IF_DATA XCP
  /begin DAQ_EVENT VARIABLE /begin DEFAULT_EVENT_LIST EVENT 3 /end DEFAULT_EVENT_LIST /end DAQ_EVENT
 /end IF_DATA
/end MEASUREMENT
/begin MEASUREMENT canFVehicleStatusDs2 "" UBYTE NO_COMPU_METHOD 0 0 0 255 MATRIX_DIM 7 FORMAT "%.0" ECU_ADDRESS 0x40041e08 READ_WRITE
 /begin IF_DATA XCP
  /begin DAQ_EVENT VARIABLE /begin DEFAULT_EVENT_LIST EVENT 3 /end DEFAULT_EVENT_LIST /end DAQ_EVENT
 /end IF_DATA
/end MEASUREMENT
/begin MEASUREMENT canFPwrSteerInfoDs2 "" UBYTE NO_COMPU_METHOD 0 0 0 255 MATRIX_DIM 6 FORMAT "%.0" ECU_ADDRESS 0x40041e50 READ_WRITE
 /begin IF_DATA XCP
  /begin DAQ_EVENT VARIABLE /begin DEFAULT_EVENT_LIST EVENT 3 /end DEFAULT_EVENT_LIST /end DAQ_EVENT
 /end IF_DATA
/end MEASUREMENT
/begin MEASUREMENT canFOdometerValue "" UBYTE NO_COMPU_METHOD 0 0 0 255 MATRIX_DIM 6 FORMAT "%.0" ECU_ADDRESS 0x40042444 READ_WRITE
 /begin IF_DATA XCP
  /begin DAQ_EVENT VARIABLE /begin DEFAULT_EVENT_LIST EVENT 3 /end DEFAULT_EVENT_LIST /end DAQ_EVENT
 /end IF_DATA
/end MEASUREMENT
/begin MEASUREMENT canFVehicleMode "" UBYTE NO_COMPU_METHOD 0 0 0 255 MATRIX_DIM 3 FORMAT "%.0" ECU_ADDRESS 0x4004245c READ_WRITE
 /begin IF_DATA XCP
  /begin DAQ_EVENT VARIABLE /begin DEFAULT_EVENT_LIST EVENT 3 /end DEFAULT_EVENT_LIST /end DAQ_EVENT
 /end IF_DATA
/end MEASUREMENT
/begin MEASUREMENT canFAccGvcuRequest "" UBYTE NO_COMPU_METHOD 0 0 0 255 MATRIX_DIM 7 FORMAT "%.0" ECU_ADDRESS 0x400424b0 READ_WRITE
 /begin IF_DATA XCP
  /begin DAQ_EVENT VARIABLE /begin DEFAULT_EVENT_LIST EVENT 3 /end DEFAULT_EVENT_LIST /end DAQ_EVENT
 /end IF_DATA
/end MEASUREMENT
/begin MEASUREMENT canFXcpCmdIeb "" UBYTE NO_COMPU_METHOD 0 0 0 255 MATRIX_DIM 8 FORMAT "%.0" ECU_ADDRESS 0x400424c4 READ_WRITE
 /begin IF_DATA XCP
  /begin DAQ_EVENT VARIABLE /begin DEFAULT_EVENT_LIST EVENT 3 /end DEFAULT_EVENT_LIST /end DAQ_EVENT
 /end IF_DATA
/end MEASUREMENT
/begin MEASUREMENT canFDiagDs2FuncReqG2 "" UBYTE NO_COMPU_METHOD 0 0 0 255 MATRIX_DIM 8 FORMAT "%.0" ECU_ADDRESS 0x400424f8 READ_WRITE
 /begin IF_DATA XCP
  /begin DAQ_EVENT VARIABLE /begin DEFAULT_EVENT_LIST EVENT 3 /end DEFAULT_EVENT_LIST /end DAQ_EVENT
 /end IF_DATA
/end MEASUREMENT
/begin MEASUREMENT canFDiagReqIebG2 "" UBYTE NO_COMPU_METHOD 0 0 0 255 MATRIX_DIM 8 FORMAT "%.0" ECU_ADDRESS 0x40042504 READ_WRITE
 /begin IF_DATA XCP
  /begin DAQ_EVENT VARIABLE /begin DEFAULT_EVENT_LIST EVENT 3 /end DEFAULT_EVENT_LIST /end DAQ_EVENT
 /end IF_DATA
/end MEASUREMENT
/begin MEASUREMENT canFBrakePressureRequest "" UBYTE NO_COMPU_METHOD 0 0 0 255 MATRIX_DIM 7 FORMAT "%.0" ECU_ADDRESS 0x40042534 READ_WRITE
 /begin IF_DATA XCP
  /begin DAQ_EVENT VARIABLE /begin DEFAULT_EVENT_LIST EVENT 3 /end DEFAULT_EVENT_LIST /end DAQ_EVENT
 /end IF_DATA
/end MEASUREMENT
/begin MEASUREMENT canFDiagReqImuG2 "" UBYTE NO_COMPU_METHOD 0 0 0 255 MATRIX_DIM 4 FORMAT "%.0" ECU_ADDRESS 0x40042554 READ_WRITE
 /begin IF_DATA XCP
  /begin DAQ_EVENT VARIABLE /begin DEFAULT_EVENT_LIST EVENT 3 /end DEFAULT_EVENT_LIST /end DAQ_EVENT
 /end IF_DATA
/end MEASUREMENT
/begin MEASUREMENT canFRotronicsWhlBrkTq "" UBYTE NO_COMPU_METHOD 0 0 0 255 MATRIX_DIM 5 FORMAT "%.0" ECU_ADDRESS 0x40042574 READ_WRITE
 /begin IF_DATA XCP
  /begin DAQ_EVENT VARIABLE /begin DEFAULT_EVENT_LIST EVENT 3 /end DEFAULT_EVENT_LIST /end DAQ_EVENT
 /end IF_DATA
/end MEASUREMENT
/begin MEASUREMENT canFWheelTorqueActRear "" UBYTE NO_COMPU_METHOD 0 0 0 255 MATRIX_DIM 6 FORMAT "%.0" ECU_ADDRESS 0x40042588 READ_WRITE
 /begin IF_DATA XCP
  /begin DAQ_EVENT VARIABLE /begin DEFAULT_EVENT_LIST EVENT 3 /end DEFAULT_EVENT_LIST /end DAQ_EVENT
 /end IF_DATA
/end MEASUREMENT
/begin MEASUREMENT canFSysPwrMode "" UBYTE NO_COMPU_METHOD 0 0 0 255 MATRIX_DIM 4 FORMAT "%.0" ECU_ADDRESS 0x40042594 READ_WRITE
 /begin IF_DATA XCP
  /begin DAQ_EVENT VARIABLE /begin DEFAULT_EVENT_LIST EVENT 3 /end DEFAULT_EVENT_LIST /end DAQ_EVENT
 /end IF_DATA
/end MEASUREMENT
/begin MEASUREMENT canFSystemTimeDs2 "" UBYTE NO_COMPU_METHOD 0 0 0 255 MATRIX_DIM 8 FORMAT "%.0" ECU_ADDRESS 0x400425c0 READ_WRITE
 /begin IF_DATA XCP
  /begin DAQ_EVENT VARIABLE /begin DEFAULT_EVENT_LIST EVENT 3 /end DEFAULT_EVENT_LIST /end DAQ_EVENT
 /end IF_DATA
/end MEASUREMENT
/begin MEASUREMENT canFDriverAssistance01 "" UBYTE NO_COMPU_METHOD 0 0 0 255 MATRIX_DIM 2 FORMAT "%.0" ECU_ADDRESS 0x400425cc READ_WRITE
 /begin IF_DATA XCP
  /begin DAQ_EVENT VARIABLE /begin DEFAULT_EVENT_LIST EVENT 3 /end DEFAULT_EVENT_LIST /end DAQ_EVENT
 /end IF_DATA
/end MEASUREMENT
/begin MEASUREMENT canFDiagAccPhysReqFvcmG2 "" UBYTE NO_COMPU_METHOD 0 0 0 255 MATRIX_DIM 8 FORMAT "%.0" ECU_ADDRESS 0x400425d8 READ_WRITE
 /begin IF_DATA XCP
  /begin DAQ_EVENT VARIABLE /begin DEFAULT_EVENT_LIST EVENT 3 /end DEFAULT_EVENT_LIST /end DAQ_EVENT
 /end IF_DATA
/end MEASUREMENT
/begin MEASUREMENT canFRegen02 "" UBYTE NO_COMPU_METHOD 0 0 0 255 MATRIX_DIM 6 FORMAT "%.0" ECU_ADDRESS 0x40042624 READ_WRITE
 /begin IF_DATA XCP
  /begin DAQ_EVENT VARIABLE /begin DEFAULT_EVENT_LIST EVENT 3 /end DEFAULT_EVENT_LIST /end DAQ_EVENT
 /end IF_DATA
/end MEASUREMENT
/begin MEASUREMENT canFAccVehicleStatus "" UBYTE NO_COMPU_METHOD 0 0 0 255 MATRIX_DIM 7 FORMAT "%.0" ECU_ADDRESS 0x40042634 READ_WRITE
 /begin IF_DATA XCP
  /begin DAQ_EVENT VARIABLE /begin DEFAULT_EVENT_LIST EVENT 3 /end DEFAULT_EVENT_LIST /end DAQ_EVENT
 /end IF_DATA
/end MEASUREMENT
/begin MEASUREMENT canFStabilityInfoDs2 "" UBYTE NO_COMPU_METHOD 0 0 0 255 MATRIX_DIM 8 FORMAT "%.0" ECU_ADDRESS 0x40042680 READ_WRITE
 /begin IF_DATA XCP
  /begin DAQ_EVENT VARIABLE /begin DEFAULT_EVENT_LIST EVENT 3 /end DEFAULT_EVENT_LIST /end DAQ_EVENT
 /end IF_DATA
/end MEASUREMENT
/begin MEASUREMENT canFNmRequestGvcuDs2 "" UBYTE NO_COMPU_METHOD 0 0 0 255 MATRIX_DIM 2 FORMAT "%.0" ECU_ADDRESS 0x40042698 READ_WRITE
 /begin IF_DATA XCP
  /begin DAQ_EVENT VARIABLE /begin DEFAULT_EVENT_LIST EVENT 3 /end DEFAULT_EVENT_LIST /end DAQ_EVENT
 /end IF_DATA
/end MEASUREMENT
/begin MEASUREMENT canFWheelTorqueActFront "" UBYTE NO_COMPU_METHOD 0 0 0 255 MATRIX_DIM 6 FORMAT "%.0" ECU_ADDRESS 0x4004269c READ_WRITE
 /begin IF_DATA XCP
  /begin DAQ_EVENT VARIABLE /begin DEFAULT_EVENT_LIST EVENT 3 /end DEFAULT_EVENT_LIST /end DAQ_EVENT
 /end IF_DATA
/end MEASUREMENT
/begin MEASUREMENT gDebugCanEcrErrorCount "" ULONG NO_COMPU_METHOD 0 0 0 4294967295 MATRIX_DIM 4 FORMAT "%.0" ECU_ADDRESS 0x40043294 READ_WRITE
 /begin IF_DATA XCP
  /begin DAQ_EVENT VARIABLE /begin DEFAULT_EVENT_LIST EVENT 3 /end DEFAULT_EVENT_LIST /end DAQ_EVENT
 /end IF_DATA
/end MEASUREMENT
/begin MEASUREMENT _global_mem_init "" ULONG NO_COMPU_METHOD 0 0 0 4294967295 MATRIX_DIM 2 FORMAT "%.0" ECU_ADDRESS 0x40046b20 READ_WRITE
 /begin IF_DATA XCP
  /begin DAQ_EVENT VARIABLE /begin DEFAULT_EVENT_LIST EVENT 3 /end DEFAULT_EVENT_LIST /end DAQ_EVENT
 /end IF_DATA
/end MEASUREMENT
/begin MEASUREMENT RhcLiftCalibState "" UBYTE NO_COMPU_METHOD 0 0 0 255 FORMAT "%.0" ECU_ADDRESS 0x4004abcc READ_WRITE
 /begin IF_DATA XCP
  /begin DAQ_EVENT VARIABLE /begin DEFAULT_EVENT_LIST EVENT 3 /end DEFAULT_EVENT_LIST /end DAQ_EVENT
 /end IF_DATA
/end MEASUREMENT
/begin MEASUREMENT RhcWishboneSnsrVFR "" SWORD tMillivolt_S16 0 0 0 10000 ECU_ADDRESS 0x4004abce READ_WRITE
 /begin IF_DATA XCP
  /begin DAQ_EVENT VARIABLE /begin DEFAULT_EVENT_LIST EVENT 3 /end DEFAULT_EVENT_LIST /end DAQ_EVENT
 /end IF_DATA
/end MEASUREMENT
/begin MEASUREMENT RhcLiftCalibEnable "" UBYTE NO_COMPU_METHOD 0 0 0 1 FORMAT "%.2" ECU_ADDRESS 0x4004b0d0 READ_WRITE
 /begin IF_DATA XCP
  /begin DAQ_EVENT VARIABLE /begin DEFAULT_EVENT_LIST EVENT 3 /end DEFAULT_EVENT_LIST /end DAQ_EVENT
 /end IF_DATA
/end MEASUREMENT
/begin MEASUREMENT RhcWishboneSnsrVRL "" SWORD tMillivolt_S16 0 0 0 10000 ECU_ADDRESS 0x4004b0d2 READ_WRITE
 /begin IF_DATA XCP
  /begin DAQ_EVENT VARIABLE /begin DEFAULT_EVENT_LIST EVENT 3 /end DEFAULT_EVENT_LIST /end DAQ_EVENT
 /end IF_DATA
/end MEASUREMENT
/begin MEASUREMENT RhcWishboneSnsrVRR "" SWORD tMillivolt_S16 0 0 0 10000 ECU_ADDRESS 0x4004b0d4 READ_WRITE
 /begin IF_DATA XCP
  /begin DAQ_EVENT VARIABLE /begin DEFAULT_EVENT_LIST EVENT 3 /end DEFAULT_EVENT_LIST /end DAQ_EVENT
 /end IF_DATA
/end MEASUREMENT
/begin MEASUREMENT RhcWishboneSnsrVFL "" SWORD tMillivolt_S16 0 0 0 10000 ECU_ADDRESS 0x4004b0d6 READ_WRITE
 /begin IF_DATA XCP
  /begin DAQ_EVENT VARIABLE /begin DEFAULT_EVENT_LIST EVENT 3 /end DEFAULT_EVENT_LIST /end DAQ_EVENT
 /end IF_DATA
/end MEASUREMENT
/begin MEASUREMENT RhcLiftCylVRL "" SWORD tMillivolt_S16 0 0 0 10000 ECU_ADDRESS 0x4004b0d8 READ_WRITE
 /begin IF_DATA XCP
  /begin DAQ_EVENT VARIABLE /begin DEFAULT_EVENT_LIST EVENT 3 /end DEFAULT_EVENT_LIST /end DAQ_EVENT
 /end IF_DATA
/end MEASUREMENT
/begin MEASUREMENT RhcLiftCylVFL "" SWORD tMillivolt_S16 0 0 0 10000 ECU_ADDRESS 0x4004b0da READ_WRITE
 /begin IF_DATA XCP
  /begin DAQ_EVENT VARIABLE /begin DEFAULT_EVENT_LIST EVENT 3 /end DEFAULT_EVENT_LIST /end DAQ_EVENT
 /end IF_DATA
/end MEASUREMENT
/begin MEASUREMENT RhcLiftCylVRR "" SWORD tMillivolt_S16 0 0 0 10000 ECU_ADDRESS 0x4004b0dc READ_WRITE
 /begin IF_DATA XCP
  /begin DAQ_EVENT VARIABLE /begin DEFAULT_EVENT_LIST EVENT 3 /end DEFAULT_EVENT_LIST /end DAQ_EVENT
 /end IF_DATA
/end MEASUREMENT
/begin MEASUREMENT RhcLiftCylVFR "" SWORD tMillivolt_S16 0 0 0 10000 ECU_ADDRESS 0x4004b0de READ_WRITE
 /begin IF_DATA XCP
  /begin DAQ_EVENT VARIABLE /begin DEFAULT_EVENT_LIST EVENT 3 /end DEFAULT_EVENT_LIST /end DAQ_EVENT
 /end IF_DATA
/end MEASUREMENT
/begin MEASUREMENT CTestEnaInvCtrlGainSet "" UBYTE NO_COMPU_METHOD 0 0 0 255 FORMAT "%.0" ECU_ADDRESS 0x4004de24 READ_WRITE
 /begin IF_DATA XCP
  /begin DAQ_EVENT VARIABLE /begin DEFAULT_EVENT_LIST EVENT 3 /end DEFAULT_EVENT_LIST /end DAQ_EVENT
 /end IF_DATA
/end MEASUREMENT
/begin MEASUREMENT CTestInvCtrlGainSet "" UBYTE NO_COMPU_METHOD 0 0 0 255 FORMAT "%.0" ECU_ADDRESS 0x4004de25 READ_WRITE
 /begin IF_DATA XCP
  /begin DAQ_EVENT VARIABLE /begin DEFAULT_EVENT_LIST EVENT 3 /end DEFAULT_EVENT_LIST /end DAQ_EVENT
 /end IF_DATA
/end MEASUREMENT
/begin MEASUREMENT CTestMaxPosTorque "" FLOAT32_IEEE tNewtonMetre 0 0 -100000 100000 ECU_ADDRESS 0x4004e6e4 READ_WRITE
 /begin IF_DATA XCP
  /begin DAQ_EVENT VARIABLE /begin DEFAULT_EVENT_LIST EVENT 3 /end DEFAULT_EVENT_LIST /end DAQ_EVENT
 /end IF_DATA
/end MEASUREMENT
/begin MEASUREMENT CTestInvCtrlMode "" ULONG tInvCtrlMode 0 0 0 3 ECU_ADDRESS 0x4004e6e8 READ_WRITE
 /begin IF_DATA XCP
  /begin DAQ_EVENT VARIABLE /begin DEFAULT_EVENT_LIST EVENT 3 /end DEFAULT_EVENT_LIST /end DAQ_EVENT
 /end IF_DATA
/end MEASUREMENT
/begin MEASUREMENT CTestManualInvCtrl "" UBYTE NO_COMPU_METHOD 0 0 0 1 FORMAT "%.2" ECU_ADDRESS 0x4004e6ec READ_WRITE
 /begin IF_DATA XCP
  /begin DAQ_EVENT VARIABLE /begin DEFAULT_EVENT_LIST EVENT 3 /end DEFAULT_EVENT_LIST /end DAQ_EVENT
 /end IF_DATA
/end MEASUREMENT
/begin MEASUREMENT CTestMaxNegTorque "" FLOAT32_IEEE tNewtonMetre 0 0 -100000 100000 ECU_ADDRESS 0x4004e6f0 READ_WRITE
 /begin IF_DATA XCP
  /begin DAQ_EVENT VARIABLE /begin DEFAULT_EVENT_LIST EVENT 3 /end DEFAULT_EVENT_LIST /end DAQ_EVENT
 /end IF_DATA
/end MEASUREMENT
/begin MEASUREMENT CTestEmotorTorque "" SWORD NO_COMPU_METHOD 0 0 -32768 32767 FORMAT "%.0" ECU_ADDRESS 0x4004e6f4 READ_WRITE
 /begin IF_DATA XCP
  /begin DAQ_EVENT VARIABLE /begin DEFAULT_EVENT_LIST EVENT 3 /end DEFAULT_EVENT_LIST /end DAQ_EVENT
 /end IF_DATA
/end MEASUREMENT
/begin MEASUREMENT CTestMotorSpeedReq "" SWORD tRevolutionPerMinute_S16 0 0 -32768 32767 ECU_ADDRESS 0x4004e6f6 READ_WRITE
 /begin IF_DATA XCP
  /begin DAQ_EVENT VARIABLE /begin DEFAULT_EVENT_LIST EVENT 3 /end DEFAULT_EVENT_LIST /end DAQ_EVENT
 /end IF_DATA
/end MEASUREMENT
/begin MEASUREMENT hybState "" ULONG tHybSmState 0 0 0 6 ECU_ADDRESS 0x4004e70c READ_WRITE
 /begin IF_DATA XCP
  /begin DAQ_EVENT VARIABLE /begin DEFAULT_EVENT_LIST EVENT 3 /end DEFAULT_EVENT_LIST /end DAQ_EVENT
 /end IF_DATA
/end MEASUREMENT
/begin MEASUREMENT hvOnRequest "" UBYTE NO_COMPU_METHOD 0 0 0 1 FORMAT "%.2" ECU_ADDRESS 0x4004e710 READ_WRITE
 /begin IF_DATA XCP
  /begin DAQ_EVENT VARIABLE /begin DEFAULT_EVENT_LIST EVENT 3 /end DEFAULT_EVENT_LIST /end DAQ_EVENT
 /end IF_DATA
/end MEASUREMENT
/begin MEASUREMENT hvOnRequestReason "" UBYTE NO_COMPU_METHOD 0 0 0 255 FORMAT "%.0" ECU_ADDRESS 0x4004e711 READ_WRITE
 /begin IF_DATA XCP
  /begin DAQ_EVENT VARIABLE /begin DEFAULT_EVENT_LIST EVENT 3 /end DEFAULT_EVENT_LIST /end DAQ_EVENT
 /end IF_DATA
/end MEASUREMENT
/begin MEASUREMENT CTestNoHybridFaults "" UBYTE NO_COMPU_METHOD 0 0 0 1 FORMAT "%.2" ECU_ADDRESS 0x4004e720 READ_WRITE
 /begin IF_DATA XCP
  /begin DAQ_EVENT VARIABLE /begin DEFAULT_EVENT_LIST EVENT 3 /end DEFAULT_EVENT_LIST /end DAQ_EVENT
 /end IF_DATA
/end MEASUREMENT
/begin MEASUREMENT drvrAccrPedlSts "" ULONG tEnableState 0 0 0 3 ECU_ADDRESS 0x4004fa18 READ_WRITE
 /begin IF_DATA XCP
  /begin DAQ_EVENT VARIABLE /begin DEFAULT_EVENT_LIST EVENT 3 /end DEFAULT_EVENT_LIST /end DAQ_EVENT
 /end IF_DATA
/end MEASUREMENT
/begin MEASUREMENT drvrAccrPedlFaults "" UBYTE NO_COMPU_METHOD 0 0 0 255 FORMAT "%.0" ECU_ADDRESS 0x4004fa20 READ_WRITE
 /begin IF_DATA XCP
  /begin DAQ_EVENT VARIABLE /begin DEFAULT_EVENT_LIST EVENT 3 /end DEFAULT_EVENT_LIST /end DAQ_EVENT
 /end IF_DATA
/end MEASUREMENT
/begin MEASUREMENT drvrAccrPedlPercQ "" ULONG tQualifier 0 0 0 3 ECU_ADDRESS 0x40050224 READ_WRITE
 /begin IF_DATA XCP
  /begin DAQ_EVENT VARIABLE /begin DEFAULT_EVENT_LIST EVENT 3 /end DEFAULT_EVENT_LIST /end DAQ_EVENT
 /end IF_DATA
/end MEASUREMENT
/begin MEASUREMENT drvrAccrPedlPerc "" SLONG tPercent_100_S32 0 0 0.0 100.0 ECU_ADDRESS 0x40050228 READ_WRITE
 /begin IF_DATA XCP
  /begin DAQ_EVENT VARIABLE /begin DEFAULT_EVENT_LIST EVENT 3 /end DEFAULT_EVENT_LIST /end DAQ_EVENT
 /end IF_DATA
/end MEASUREMENT
/begin MEASUREMENT drvrAccrPedlU1 "" SLONG tMillivolt_S32 0 0 0 1000000 ECU_ADDRESS 0x4005022c READ_WRITE
 /begin IF_DATA XCP
  /begin DAQ_EVENT VARIABLE /begin DEFAULT_EVENT_LIST EVENT 3 /end DEFAULT_EVENT_LIST /end DAQ_EVENT
 /end IF_DATA
/end MEASUREMENT
/begin MEASUREMENT drvrAccrPedlU2 "" SLONG tMillivolt_S32 0 0 0 1000000 ECU_ADDRESS 0x40050230 READ_WRITE
 /begin IF_DATA XCP
  /begin DAQ_EVENT VARIABLE /begin DEFAULT_EVENT_LIST EVENT 3 /end DEFAULT_EVENT_LIST /end DAQ_EVENT
 /end IF_DATA
/end MEASUREMENT
/begin MEASUREMENT CTest_EBrakeOLCheck "" UBYTE NO_COMPU_METHOD 0 0 0 1 FORMAT "%.2" ECU_ADDRESS 0x400506b0 READ_WRITE
 /begin IF_DATA XCP
  /begin DAQ_EVENT VARIABLE /begin DEFAULT_EVENT_LIST EVENT 3 /end DEFAULT_EVENT_LIST /end DAQ_EVENT
 /end IF_DATA
/end MEASUREMENT
/begin MEASUREMENT CEBrakeServiceMode "" UBYTE NO_COMPU_METHOD 0 0 0 255 FORMAT "%.0" ECU_ADDRESS 0x400506b1 READ_WRITE
 /begin IF_DATA XCP
  /begin DAQ_EVENT VARIABLE /begin DEFAULT_EVENT_LIST EVENT 3 /end DEFAULT_EVENT_LIST /end DAQ_EVENT
 /end IF_DATA
/end MEASUREMENT
/begin MEASUREMENT EBrakeSMCommandOverwrite "" UBYTE NO_COMPU_METHOD 0 0 0 255 FORMAT "%.0" ECU_ADDRESS 0x400506b8 READ_WRITE
 /begin IF_DATA XCP
  /begin DAQ_EVENT VARIABLE /begin DEFAULT_EVENT_LIST EVENT 3 /end DEFAULT_EVENT_LIST /end DAQ_EVENT
 /end IF_DATA
/end MEASUREMENT
/begin MEASUREMENT U_I_E_BRAKE_RIGHT_NEG "" FLOAT32_IEEE NO_COMPU_METHOD 0 0 -3.40282346639E+38 3.40282346639E+38 FORMAT "%.6" ECU_ADDRESS 0x400506bc READ_WRITE
 /begin IF_DATA XCP
  /begin DAQ_EVENT VARIABLE /begin DEFAULT_EVENT_LIST EVENT 3 /end DEFAULT_EVENT_LIST /end DAQ_EVENT
 /end IF_DATA
/end MEASUREMENT
/begin MEASUREMENT U_I_E_BRAKE_RIGHT_NEG_raw "" UWORD NO_COMPU_METHOD 0 0 0 65535 FORMAT "%.0" ECU_ADDRESS 0x400506c0 READ_WRITE
 /begin IF_DATA XCP
  /begin DAQ_EVENT VARIABLE /begin DEFAULT_EVENT_LIST EVENT 3 /end DEFAULT_EVENT_LIST /end DAQ_EVENT
 /end IF_DATA
/end MEASUREMENT
/begin MEASUREMENT U_I_E_BRAKE_LEFT_POS "" FLOAT32_IEEE NO_COMPU_METHOD 0 0 -3.40282346639E+38 3.40282346639E+38 FORMAT "%.6" ECU_ADDRESS 0x400506c4 READ_WRITE
 /begin IF_DATA XCP
  /begin DAQ_EVENT VARIABLE /begin DEFAULT_EVENT_LIST EVENT 3 /end DEFAULT_EVENT_LIST /end DAQ_EVENT
 /end IF_DATA
/end MEASUREMENT
/begin MEASUREMENT U_I_E_BRAKE_RIGHT_POS_raw "" UWORD NO_COMPU_METHOD 0 0 0 65535 FORMAT "%.0" ECU_ADDRESS 0x400506ce READ_WRITE
 /begin IF_DATA XCP
  /begin DAQ_EVENT VARIABLE /begin DEFAULT_EVENT_LIST EVENT 3 /end DEFAULT_EVENT_LIST /end DAQ_EVENT
 /end IF_DATA
/end MEASUREMENT
/begin MEASUREMENT I_E_BRAKE_LEFT_NEG "" SWORD tAmpere_100_S16 0 0 0.0 10000.0 ECU_ADDRESS 0x400506d0 READ_WRITE
 /begin IF_DATA XCP
  /begin DAQ_EVENT VARIABLE /begin DEFAULT_EVENT_LIST EVENT 3 /end DEFAULT_EVENT_LIST /end DAQ_EVENT
 /end IF_DATA
/end MEASUREMENT
/begin MEASUREMENT U_I_E_BRAKE_LEFT_NEG "" FLOAT32_IEEE NO_COMPU_METHOD 0 0 -3.40282346639E+38 3.40282346639E+38 FORMAT "%.6" ECU_ADDRESS 0x400506d8 READ_WRITE
 /begin IF_DATA XCP
  /begin DAQ_EVENT VARIABLE /begin DEFAULT_EVENT_LIST EVENT 3 /end DEFAULT_EVENT_LIST /end DAQ_EVENT
 /end IF_DATA
/end MEASUREMENT
/begin MEASUREMENT CDisengageEbrakes "" UBYTE NO_COMPU_METHOD 0 0 0 1 FORMAT "%.2" ECU_ADDRESS 0x400506dc READ_WRITE
 /begin IF_DATA XCP
  /begin DAQ_EVENT VARIABLE /begin DEFAULT_EVENT_LIST EVENT 3 /end DEFAULT_EVENT_LIST /end DAQ_EVENT
 /end IF_DATA
/end MEASUREMENT
/begin MEASUREMENT U_I_E_BRAKE_RIGHT_POS "" FLOAT32_IEEE NO_COMPU_METHOD 0 0 -3.40282346639E+38 3.40282346639E+38 FORMAT "%.6" ECU_ADDRESS 0x400506e0 READ_WRITE
 /begin IF_DATA XCP
  /begin DAQ_EVENT VARIABLE /begin DEFAULT_EVENT_LIST EVENT 3 /end DEFAULT_EVENT_LIST /end DAQ_EVENT
 /end IF_DATA
/end MEASUREMENT
/begin MEASUREMENT U_I_E_BRAKE_LEFT_NEG_raw "" UWORD NO_COMPU_METHOD 0 0 0 65535 FORMAT "%.0" ECU_ADDRESS 0x400506e4 READ_WRITE
 /begin IF_DATA XCP
  /begin DAQ_EVENT VARIABLE /begin DEFAULT_EVENT_LIST EVENT 3 /end DEFAULT_EVENT_LIST /end DAQ_EVENT
 /end IF_DATA
/end MEASUREMENT
/begin MEASUREMENT I_E_BRAKE_RIGHT_POS "" SWORD tAmpere_100_S16 0 0 0.0 10000.0 ECU_ADDRESS 0x400506e6 READ_WRITE
 /begin IF_DATA XCP
  /begin DAQ_EVENT VARIABLE /begin DEFAULT_EVENT_LIST EVENT 3 /end DEFAULT_EVENT_LIST /end DAQ_EVENT
 /end IF_DATA
/end MEASUREMENT
/begin MEASUREMENT CEngageEbrakes "" UBYTE NO_COMPU_METHOD 0 0 0 1 FORMAT "%.2" ECU_ADDRESS 0x400506ea READ_WRITE
 /begin IF_DATA XCP
  /begin DAQ_EVENT VARIABLE /begin DEFAULT_EVENT_LIST EVENT 3 /end DEFAULT_EVENT_LIST /end DAQ_EVENT
 /end IF_DATA
/end MEASUREMENT
/begin MEASUREMENT I_E_BRAKE_RIGHT_NEG "" SWORD tAmpere_100_S16 0 0 0.0 10000.0 ECU_ADDRESS 0x400506ec READ_WRITE
 /begin IF_DATA XCP
  /begin DAQ_EVENT VARIABLE /begin DEFAULT_EVENT_LIST EVENT 3 /end DEFAULT_EVENT_LIST /end DAQ_EVENT
 /end IF_DATA
/end MEASUREMENT
/begin MEASUREMENT U_I_E_BRAKE_LEFT_POS_raw "" UWORD NO_COMPU_METHOD 0 0 0 65535 FORMAT "%.0" ECU_ADDRESS 0x400506ee READ_WRITE
 /begin IF_DATA XCP
  /begin DAQ_EVENT VARIABLE /begin DEFAULT_EVENT_LIST EVENT 3 /end DEFAULT_EVENT_LIST /end DAQ_EVENT
 /end IF_DATA
/end MEASUREMENT
/begin MEASUREMENT I_E_BRAKE_LEFT_POS "" SWORD tAmpere_100_S16 0 0 0.0 10000.0 ECU_ADDRESS 0x400506f0 READ_WRITE
 /begin IF_DATA XCP
  /begin DAQ_EVENT VARIABLE /begin DEFAULT_EVENT_LIST EVENT 3 /end DEFAULT_EVENT_LIST /end DAQ_EVENT
 /end IF_DATA
/end MEASUREMENT
/begin MEASUREMENT lnchCtrlReqAllwdMask "" UBYTE NO_COMPU_METHOD 0 0 0 255 FORMAT "%.0" ECU_ADDRESS 0x400506f8 READ_WRITE
 /begin IF_DATA XCP
  /begin DAQ_EVENT VARIABLE /begin DEFAULT_EVENT_LIST EVENT 3 /end DEFAULT_EVENT_LIST /end DAQ_EVENT
 /end IF_DATA
/end MEASUREMENT
/begin MEASUREMENT lnchCtrlAbortMask "" UWORD NO_COMPU_METHOD 0 0 0 65535 FORMAT "%.0" ECU_ADDRESS 0x400506fa READ_WRITE
 /begin IF_DATA XCP
  /begin DAQ_EVENT VARIABLE /begin DEFAULT_EVENT_LIST EVENT 3 /end DEFAULT_EVENT_LIST /end DAQ_EVENT
 /end IF_DATA
/end MEASUREMENT
/begin MEASUREMENT autDrvrCtrlOffRsnMask "" UWORD NO_COMPU_METHOD 0 0 0 65535 FORMAT "%.0" ECU_ADDRESS 0x400506fc READ_WRITE
 /begin IF_DATA XCP
  /begin DAQ_EVENT VARIABLE /begin DEFAULT_EVENT_LIST EVENT 3 /end DEFAULT_EVENT_LIST /end DAQ_EVENT
 /end IF_DATA
/end MEASUREMENT
/begin MEASUREMENT adpvCrsCtrlStbyInhbMask "" UWORD NO_COMPU_METHOD 0 0 0 65535 FORMAT "%.0" ECU_ADDRESS 0x400506fe READ_WRITE
 /begin IF_DATA XCP
  /begin DAQ_EVENT VARIABLE /begin DEFAULT_EVENT_LIST EVENT 3 /end DEFAULT_EVENT_LIST /end DAQ_EVENT
 /end IF_DATA
/end MEASUREMENT
/begin MEASUREMENT adpvCrsCtrlFolCtrlActvInhbMask "" UWORD NO_COMPU_METHOD 0 0 0 65535 FORMAT "%.0" ECU_ADDRESS 0x40050700 READ_WRITE
 /begin IF_DATA XCP
  /begin DAQ_EVENT VARIABLE /begin DEFAULT_EVENT_LIST EVENT 3 /end DEFAULT_EVENT_LIST /end DAQ_EVENT
 /end IF_DATA
/end MEASUREMENT
/begin MEASUREMENT adpvCrsCtrlVelCtrlActvInhbMask "" UWORD NO_COMPU_METHOD 0 0 0 65535 FORMAT "%.0" ECU_ADDRESS 0x40050702 READ_WRITE
 /begin IF_DATA XCP
  /begin DAQ_EVENT VARIABLE /begin DEFAULT_EVENT_LIST EVENT 3 /end DEFAULT_EVENT_LIST /end DAQ_EVENT
 /end IF_DATA
/end MEASUREMENT
/begin MEASUREMENT adpvCrsCtrlEyeqBlkdRsnMask "" UWORD NO_COMPU_METHOD 0 0 0 65535 FORMAT "%.0" ECU_ADDRESS 0x40050704 READ_WRITE
 /begin IF_DATA XCP
  /begin DAQ_EVENT VARIABLE /begin DEFAULT_EVENT_LIST EVENT 3 /end DEFAULT_EVENT_LIST /end DAQ_EVENT
 /end IF_DATA
/end MEASUREMENT
/begin MEASUREMENT spdLimMask "" UWORD NO_COMPU_METHOD 0 0 0 65535 FORMAT "%.0" ECU_ADDRESS 0x40050706 READ_WRITE
 /begin IF_DATA XCP
  /begin DAQ_EVENT VARIABLE /begin DEFAULT_EVENT_LIST EVENT 3 /end DEFAULT_EVENT_LIST /end DAQ_EVENT
 /end IF_DATA
/end MEASUREMENT
/begin MEASUREMENT tpmsTirePSt "" UBYTE NO_COMPU_METHOD 0 0 0 255 FORMAT "%.0" ECU_ADDRESS 0x40050708 READ_WRITE
 /begin IF_DATA XCP
  /begin DAQ_EVENT VARIABLE /begin DEFAULT_EVENT_LIST EVENT 3 /end DEFAULT_EVENT_LIST /end DAQ_EVENT
 /end IF_DATA
/end MEASUREMENT
/begin MEASUREMENT tpmsWarnLampRsn "" UBYTE NO_COMPU_METHOD 0 0 0 255 FORMAT "%.0" ECU_ADDRESS 0x40050709 READ_WRITE
 /begin IF_DATA XCP
  /begin DAQ_EVENT VARIABLE /begin DEFAULT_EVENT_LIST EVENT 3 /end DEFAULT_EVENT_LIST /end DAQ_EVENT
 /end IF_DATA
/end MEASUREMENT
/begin MEASUREMENT tpmsTireValQ "" UBYTE NO_COMPU_METHOD 0 0 0 255 MATRIX_DIM 4 FORMAT "%.0" ECU_ADDRESS 0x4005070c READ_WRITE
 /begin IF_DATA XCP
  /begin DAQ_EVENT VARIABLE /begin DEFAULT_EVENT_LIST EVENT 3 /end DEFAULT_EVENT_LIST /end DAQ_EVENT
 /end IF_DATA
/end MEASUREMENT
/begin MEASUREMENT tpmsTireP "" SWORD NO_COMPU_METHOD 0 0 -32768 32767 MATRIX_DIM 4 FORMAT "%.0" ECU_ADDRESS 0x40050710 READ_WRITE
 /begin IF_DATA XCP
  /begin DAQ_EVENT VARIABLE /begin DEFAULT_EVENT_LIST EVENT 3 /end DEFAULT_EVENT_LIST /end DAQ_EVENT
 /end IF_DATA
/end MEASUREMENT
/begin MEASUREMENT tpmsTireT "" SWORD NO_COMPU_METHOD 0 0 -32768 32767 MATRIX_DIM 4 FORMAT "%.0" ECU_ADDRESS 0x40050718 READ_WRITE
 /begin IF_DATA XCP
  /begin DAQ_EVENT VARIABLE /begin DEFAULT_EVENT_LIST EVENT 3 /end DEFAULT_EVENT_LIST /end DAQ_EVENT
 /end IF_DATA
/end MEASUREMENT
/begin MEASUREMENT tpmsMinPFrnt "" SWORD NO_COMPU_METHOD 0 0 -32768 32767 FORMAT "%.0" ECU_ADDRESS 0x40050720 READ_WRITE
 /begin IF_DATA XCP
  /begin DAQ_EVENT VARIABLE /begin DEFAULT_EVENT_LIST EVENT 3 /end DEFAULT_EVENT_LIST /end DAQ_EVENT
 /end IF_DATA
/end MEASUREMENT
/begin MEASUREMENT tpmsMinPRe "" SWORD NO_COMPU_METHOD 0 0 -32768 32767 FORMAT "%.0" ECU_ADDRESS 0x40050722 READ_WRITE
 /begin IF_DATA XCP
  /begin DAQ_EVENT VARIABLE /begin DEFAULT_EVENT_LIST EVENT 3 /end DEFAULT_EVENT_LIST /end DAQ_EVENT
 /end IF_DATA
/end MEASUREMENT
/begin MEASUREMENT tpmsBattLvl "" UBYTE NO_COMPU_METHOD 0 0 0 255 MATRIX_DIM 4 FORMAT "%.0" ECU_ADDRESS 0x40050724 READ_WRITE
 /begin IF_DATA XCP
  /begin DAQ_EVENT VARIABLE /begin DEFAULT_EVENT_LIST EVENT 3 /end DEFAULT_EVENT_LIST /end DAQ_EVENT
 /end IF_DATA
/end MEASUREMENT
/begin MEASUREMENT tpmsRssi "" SBYTE NO_COMPU_METHOD 0 0 -128 127 MATRIX_DIM 4 FORMAT "%.0" ECU_ADDRESS 0x40050728 READ_WRITE
 /begin IF_DATA XCP
  /begin DAQ_EVENT VARIABLE /begin DEFAULT_EVENT_LIST EVENT 3 /end DEFAULT_EVENT_LIST /end DAQ_EVENT
 /end IF_DATA
/end MEASUREMENT
/begin MEASUREMENT tpmsEcuFltMask "" UBYTE NO_COMPU_METHOD 0 0 0 255 MATRIX_DIM 4 FORMAT "%.0" ECU_ADDRESS 0x4005072c READ_WRITE
 /begin IF_DATA XCP
  /begin DAQ_EVENT VARIABLE /begin DEFAULT_EVENT_LIST EVENT 3 /end DEFAULT_EVENT_LIST /end DAQ_EVENT
 /end IF_DATA
/end MEASUREMENT
/begin MEASUREMENT tpmsSnsrFltMask "" UBYTE NO_COMPU_METHOD 0 0 0 255 MATRIX_DIM 4 FORMAT "%.0" ECU_ADDRESS 0x40050730 READ_WRITE
 /begin IF_DATA XCP
  /begin DAQ_EVENT VARIABLE /begin DEFAULT_EVENT_LIST EVENT 3 /end DEFAULT_EVENT_LIST /end DAQ_EVENT
 /end IF_DATA
/end MEASUREMENT
/begin MEASUREMENT imuRotCalTrig "" UBYTE NO_COMPU_METHOD 0 0 0 1 FORMAT "%.2" ECU_ADDRESS 0x40050734 READ_WRITE
 /begin IF_DATA XCP
  /begin DAQ_EVENT VARIABLE /begin DEFAULT_EVENT_LIST EVENT 3 /end DEFAULT_EVENT_LIST /end DAQ_EVENT
 /end IF_DATA
/end MEASUREMENT
/begin MEASUREMENT runCalibSlipringCentering "" UBYTE NO_COMPU_METHOD 0 0 0 1 FORMAT "%.2" ECU_ADDRESS 0x40050735 READ_WRITE
 /begin IF_DATA XCP
  /begin DAQ_EVENT VARIABLE /begin DEFAULT_EVENT_LIST EVENT 3 /end DEFAULT_EVENT_LIST /end DAQ_EVENT
 /end IF_DATA
/end MEASUREMENT
/begin MEASUREMENT centerLeftFanSts "" UBYTE NO_COMPU_METHOD 0 0 0 255 FORMAT "%.0" ECU_ADDRESS 0x40050740 READ_WRITE
 /begin IF_DATA XCP
  /begin DAQ_EVENT VARIABLE /begin DEFAULT_EVENT_LIST EVENT 3 /end DEFAULT_EVENT_LIST /end DAQ_EVENT
 /end IF_DATA
/end MEASUREMENT
/begin MEASUREMENT thermalDiagSts "" UBYTE NO_COMPU_METHOD 0 0 0 255 FORMAT "%.0" ECU_ADDRESS 0x40050741 READ_WRITE
 /begin IF_DATA XCP
  /begin DAQ_EVENT VARIABLE /begin DEFAULT_EVENT_LIST EVENT 3 /end DEFAULT_EVENT_LIST /end DAQ_EVENT
 /end IF_DATA
/end MEASUREMENT
/begin MEASUREMENT frontLeftFanSts "" UBYTE NO_COMPU_METHOD 0 0 0 255 FORMAT "%.0" ECU_ADDRESS 0x40050742 READ_WRITE
 /begin IF_DATA XCP
  /begin DAQ_EVENT VARIABLE /begin DEFAULT_EVENT_LIST EVENT 3 /end DEFAULT_EVENT_LIST /end DAQ_EVENT
 /end IF_DATA
/end MEASUREMENT
/begin MEASUREMENT rearRighFanSts "" UBYTE NO_COMPU_METHOD 0 0 0 255 FORMAT "%.0" ECU_ADDRESS 0x40050743 READ_WRITE
 /begin IF_DATA XCP
  /begin DAQ_EVENT VARIABLE /begin DEFAULT_EVENT_LIST EVENT 3 /end DEFAULT_EVENT_LIST /end DAQ_EVENT
 /end IF_DATA
/end MEASUREMENT
/begin MEASUREMENT centerRightFanSts "" UBYTE NO_COMPU_METHOD 0 0 0 255 FORMAT "%.0" ECU_ADDRESS 0x40050744 READ_WRITE
 /begin IF_DATA XCP
  /begin DAQ_EVENT VARIABLE /begin DEFAULT_EVENT_LIST EVENT 3 /end DEFAULT_EVENT_LIST /end DAQ_EVENT
 /end IF_DATA
/end MEASUREMENT
/begin MEASUREMENT emotPumpSts "" UBYTE NO_COMPU_METHOD 0 0 0 255 FORMAT "%.0" ECU_ADDRESS 0x40050745 READ_WRITE
 /begin IF_DATA XCP
  /begin DAQ_EVENT VARIABLE /begin DEFAULT_EVENT_LIST EVENT 3 /end DEFAULT_EVENT_LIST /end DAQ_EVENT
 /end IF_DATA
/end MEASUREMENT
/begin MEASUREMENT hvBatPump2Sts "" UBYTE NO_COMPU_METHOD 0 0 0 255 FORMAT "%.0" ECU_ADDRESS 0x40050746 READ_WRITE
 /begin IF_DATA XCP
  /begin DAQ_EVENT VARIABLE /begin DEFAULT_EVENT_LIST EVENT 3 /end DEFAULT_EVENT_LIST /end DAQ_EVENT
 /end IF_DATA
/end MEASUREMENT
/begin MEASUREMENT frontRightFanSts "" UBYTE NO_COMPU_METHOD 0 0 0 255 FORMAT "%.0" ECU_ADDRESS 0x40050747 READ_WRITE
 /begin IF_DATA XCP
  /begin DAQ_EVENT VARIABLE /begin DEFAULT_EVENT_LIST EVENT 3 /end DEFAULT_EVENT_LIST /end DAQ_EVENT
 /end IF_DATA
/end MEASUREMENT
/begin MEASUREMENT rearLeftFanSts "" UBYTE NO_COMPU_METHOD 0 0 0 255 FORMAT "%.0" ECU_ADDRESS 0x40050748 READ_WRITE
 /begin IF_DATA XCP
  /begin DAQ_EVENT VARIABLE /begin DEFAULT_EVENT_LIST EVENT 3 /end DEFAULT_EVENT_LIST /end DAQ_EVENT
 /end IF_DATA
/end MEASUREMENT
/begin MEASUREMENT hvacPumpSts "" UBYTE NO_COMPU_METHOD 0 0 0 255 FORMAT "%.0" ECU_ADDRESS 0x40050749 READ_WRITE
 /begin IF_DATA XCP
  /begin DAQ_EVENT VARIABLE /begin DEFAULT_EVENT_LIST EVENT 3 /end DEFAULT_EVENT_LIST /end DAQ_EVENT
 /end IF_DATA
/end MEASUREMENT
/begin MEASUREMENT thermalFactoryTestPassed "" UBYTE NO_COMPU_METHOD 0 0 0 1 FORMAT "%.2" ECU_ADDRESS 0x4005074a READ_WRITE
 /begin IF_DATA XCP
  /begin DAQ_EVENT VARIABLE /begin DEFAULT_EVENT_LIST EVENT 3 /end DEFAULT_EVENT_LIST /end DAQ_EVENT
 /end IF_DATA
/end MEASUREMENT
/begin MEASUREMENT invPumpSts "" UBYTE NO_COMPU_METHOD 0 0 0 255 FORMAT "%.0" ECU_ADDRESS 0x4005074b READ_WRITE
 /begin IF_DATA XCP
  /begin DAQ_EVENT VARIABLE /begin DEFAULT_EVENT_LIST EVENT 3 /end DEFAULT_EVENT_LIST /end DAQ_EVENT
 /end IF_DATA
/end MEASUREMENT
/begin MEASUREMENT middleLeftFanSts "" UBYTE NO_COMPU_METHOD 0 0 0 255 FORMAT "%.0" ECU_ADDRESS 0x4005074c READ_WRITE
 /begin IF_DATA XCP
  /begin DAQ_EVENT VARIABLE /begin DEFAULT_EVENT_LIST EVENT 3 /end DEFAULT_EVENT_LIST /end DAQ_EVENT
 /end IF_DATA
/end MEASUREMENT
/begin MEASUREMENT thermalFactoryTestDone "" UBYTE NO_COMPU_METHOD 0 0 0 1 FORMAT "%.2" ECU_ADDRESS 0x4005074d READ_WRITE
 /begin IF_DATA XCP
  /begin DAQ_EVENT VARIABLE /begin DEFAULT_EVENT_LIST EVENT 3 /end DEFAULT_EVENT_LIST /end DAQ_EVENT
 /end IF_DATA
/end MEASUREMENT
/begin MEASUREMENT icRighPumpSts "" UBYTE NO_COMPU_METHOD 0 0 0 255 FORMAT "%.0" ECU_ADDRESS 0x4005074e READ_WRITE
 /begin IF_DATA XCP
  /begin DAQ_EVENT VARIABLE /begin DEFAULT_EVENT_LIST EVENT 3 /end DEFAULT_EVENT_LIST /end DAQ_EVENT
 /end IF_DATA
/end MEASUREMENT
/begin MEASUREMENT hvBatPump1Sts "" UBYTE NO_COMPU_METHOD 0 0 0 255 FORMAT "%.0" ECU_ADDRESS 0x4005074f READ_WRITE
 /begin IF_DATA XCP
  /begin DAQ_EVENT VARIABLE /begin DEFAULT_EVENT_LIST EVENT 3 /end DEFAULT_EVENT_LIST /end DAQ_EVENT
 /end IF_DATA
/end MEASUREMENT
/begin MEASUREMENT icLeftPumpSts "" UBYTE NO_COMPU_METHOD 0 0 0 255 FORMAT "%.0" ECU_ADDRESS 0x40050750 READ_WRITE
 /begin IF_DATA XCP
  /begin DAQ_EVENT VARIABLE /begin DEFAULT_EVENT_LIST EVENT 3 /end DEFAULT_EVENT_LIST /end DAQ_EVENT
 /end IF_DATA
/end MEASUREMENT
/begin MEASUREMENT middleRightFanSts "" UBYTE NO_COMPU_METHOD 0 0 0 255 FORMAT "%.0" ECU_ADDRESS 0x40050751 READ_WRITE
 /begin IF_DATA XCP
  /begin DAQ_EVENT VARIABLE /begin DEFAULT_EVENT_LIST EVENT 3 /end DEFAULT_EVENT_LIST /end DAQ_EVENT
 /end IF_DATA
/end MEASUREMENT
/begin MEASUREMENT acceleratorPedalMask "" UWORD NO_COMPU_METHOD 0 0 0 65535 FORMAT "%.0" ECU_ADDRESS 0x40050bb4 READ_WRITE
 /begin IF_DATA XCP
  /begin DAQ_EVENT VARIABLE /begin DEFAULT_EVENT_LIST EVENT 3 /end DEFAULT_EVENT_LIST /end DAQ_EVENT
 /end IF_DATA
/end MEASUREMENT
/begin MEASUREMENT mainDiagnosticsMask "" UWORD NO_COMPU_METHOD 0 0 0 65535 FORMAT "%.0" ECU_ADDRESS 0x40050bb6 READ_WRITE
 /begin IF_DATA XCP
  /begin DAQ_EVENT VARIABLE /begin DEFAULT_EVENT_LIST EVENT 3 /end DEFAULT_EVENT_LIST /end DAQ_EVENT
 /end IF_DATA
/end MEASUREMENT
/begin MEASUREMENT asfMask "" UWORD NO_COMPU_METHOD 0 0 0 65535 FORMAT "%.0" ECU_ADDRESS 0x40050bb8 READ_WRITE
 /begin IF_DATA XCP
  /begin DAQ_EVENT VARIABLE /begin DEFAULT_EVENT_LIST EVENT 3 /end DEFAULT_EVENT_LIST /end DAQ_EVENT
 /end IF_DATA
/end MEASUREMENT
/begin MEASUREMENT liftSensorDiagMask "" ULONG NO_COMPU_METHOD 0 0 0 4294967295 FORMAT "%.0" ECU_ADDRESS 0x40050bbc READ_WRITE
 /begin IF_DATA XCP
  /begin DAQ_EVENT VARIABLE /begin DEFAULT_EVENT_LIST EVENT 3 /end DEFAULT_EVENT_LIST /end DAQ_EVENT
 /end IF_DATA
/end MEASUREMENT
/begin MEASUREMENT ovrdInfoMsgVehicleSpeedAsf "" UBYTE NO_COMPU_METHOD 0 0 0 1 FORMAT "%.2" ECU_ADDRESS 0x40050bc0 READ_WRITE
 /begin IF_DATA XCP
  /begin DAQ_EVENT VARIABLE /begin DEFAULT_EVENT_LIST EVENT 3 /end DEFAULT_EVENT_LIST /end DAQ_EVENT
 /end IF_DATA
/end MEASUREMENT
/begin MEASUREMENT ovrdInfoMsgImuAsf "" UBYTE NO_COMPU_METHOD 0 0 0 1 FORMAT "%.2" ECU_ADDRESS 0x40050bc1 READ_WRITE
 /begin IF_DATA XCP
  /begin DAQ_EVENT VARIABLE /begin DEFAULT_EVENT_LIST EVENT 3 /end DEFAULT_EVENT_LIST /end DAQ_EVENT
 /end IF_DATA
/end MEASUREMENT
/begin MEASUREMENT ovrdInfoMsgRideHeightAsf "" UBYTE NO_COMPU_METHOD 0 0 0 1 FORMAT "%.2" ECU_ADDRESS 0x40050bc2 READ_WRITE
 /begin IF_DATA XCP
  /begin DAQ_EVENT VARIABLE /begin DEFAULT_EVENT_LIST EVENT 3 /end DEFAULT_EVENT_LIST /end DAQ_EVENT
 /end IF_DATA
/end MEASUREMENT
/begin MEASUREMENT ovrdInfoMsgTpmsAsf "" UBYTE NO_COMPU_METHOD 0 0 0 1 FORMAT "%.2" ECU_ADDRESS 0x40050bc3 READ_WRITE
 /begin IF_DATA XCP
  /begin DAQ_EVENT VARIABLE /begin DEFAULT_EVENT_LIST EVENT 3 /end DEFAULT_EVENT_LIST /end DAQ_EVENT
 /end IF_DATA
/end MEASUREMENT
/begin MEASUREMENT ovrdInfoMsgSteeringAsf "" UBYTE NO_COMPU_METHOD 0 0 0 1 FORMAT "%.2" ECU_ADDRESS 0x40050bc4 READ_WRITE
 /begin IF_DATA XCP
  /begin DAQ_EVENT VARIABLE /begin DEFAULT_EVENT_LIST EVENT 3 /end DEFAULT_EVENT_LIST /end DAQ_EVENT
 /end IF_DATA
/end MEASUREMENT
/begin MEASUREMENT ovrdInfoMsgAdaptiveCruiseControl "" UBYTE NO_COMPU_METHOD 0 0 0 1 FORMAT "%.2" ECU_ADDRESS 0x40050bc5 READ_WRITE
 /begin IF_DATA XCP
  /begin DAQ_EVENT VARIABLE /begin DEFAULT_EVENT_LIST EVENT 3 /end DEFAULT_EVENT_LIST /end DAQ_EVENT
 /end IF_DATA
/end MEASUREMENT
/begin MEASUREMENT ovrdInfoMsgBrkFldLvlLow "" UBYTE NO_COMPU_METHOD 0 0 0 1 FORMAT "%.2" ECU_ADDRESS 0x40050bc6 READ_WRITE
 /begin IF_DATA XCP
  /begin DAQ_EVENT VARIABLE /begin DEFAULT_EVENT_LIST EVENT 3 /end DEFAULT_EVENT_LIST /end DAQ_EVENT
 /end IF_DATA
/end MEASUREMENT
/begin MEASUREMENT ovrdInfoMsgCruiseControl "" UBYTE NO_COMPU_METHOD 0 0 0 1 FORMAT "%.2" ECU_ADDRESS 0x40050bc7 READ_WRITE
 /begin IF_DATA XCP
  /begin DAQ_EVENT VARIABLE /begin DEFAULT_EVENT_LIST EVENT 3 /end DEFAULT_EVENT_LIST /end DAQ_EVENT
 /end IF_DATA
/end MEASUREMENT
/begin MEASUREMENT ovrdInfoMsgDamperAsf "" UBYTE NO_COMPU_METHOD 0 0 0 1 FORMAT "%.2" ECU_ADDRESS 0x40050bc8 READ_WRITE
 /begin IF_DATA XCP
  /begin DAQ_EVENT VARIABLE /begin DEFAULT_EVENT_LIST EVENT 3 /end DEFAULT_EVENT_LIST /end DAQ_EVENT
 /end IF_DATA
/end MEASUREMENT
/begin MEASUREMENT ovrdInfoMsgHydraulicPressAsf "" UBYTE NO_COMPU_METHOD 0 0 0 1 FORMAT "%.2" ECU_ADDRESS 0x40050bc9 READ_WRITE
 /begin IF_DATA XCP
  /begin DAQ_EVENT VARIABLE /begin DEFAULT_EVENT_LIST EVENT 3 /end DEFAULT_EVENT_LIST /end DAQ_EVENT
 /end IF_DATA
/end MEASUREMENT
/begin MEASUREMENT ovrdInfoMsgSpeedLimitReached "" UBYTE NO_COMPU_METHOD 0 0 0 1 FORMAT "%.2" ECU_ADDRESS 0x40050bca READ_WRITE
 /begin IF_DATA XCP
  /begin DAQ_EVENT VARIABLE /begin DEFAULT_EVENT_LIST EVENT 3 /end DEFAULT_EVENT_LIST /end DAQ_EVENT
 /end IF_DATA
/end MEASUREMENT
/begin MEASUREMENT ovrdInfoMsgBrakeAsf "" UBYTE NO_COMPU_METHOD 0 0 0 1 FORMAT "%.2" ECU_ADDRESS 0x40050bcb READ_WRITE
 /begin IF_DATA XCP
  /begin DAQ_EVENT VARIABLE /begin DEFAULT_EVENT_LIST EVENT 3 /end DEFAULT_EVENT_LIST /end DAQ_EVENT
 /end IF_DATA
/end MEASUREMENT
/begin MEASUREMENT VX1000If_ErrorCount "" UBYTE NO_COMPU_METHOD 0 0 0 255 FORMAT "%.0" ECU_ADDRESS 0x40051d5c READ_WRITE
 /begin IF_DATA XCP
  /begin DAQ_EVENT VARIABLE /begin DEFAULT_EVENT_LIST EVENT 3 /end DEFAULT_EVENT_LIST /end DAQ_EVENT
 /end IF_DATA
/end MEASUREMENT
/begin MEASUREMENT VX1000If_State "" UBYTE NO_COMPU_METHOD 0 0 0 255 FORMAT "%.0" ECU_ADDRESS 0x40051d5d READ_WRITE
 /begin IF_DATA XCP
  /begin DAQ_EVENT VARIABLE /begin DEFAULT_EVENT_LIST EVENT 3 /end DEFAULT_EVENT_LIST /end DAQ_EVENT
 /end IF_DATA
/end MEASUREMENT
/begin MEASUREMENT vx1000_DetectStartTime "" ULONG NO_COMPU_METHOD 0 0 0 4294967295 FORMAT "%.0" ECU_ADDRESS 0x40051d60 READ_WRITE
 /begin IF_DATA XCP
  /begin DAQ_EVENT VARIABLE /begin DEFAULT_EVENT_LIST EVENT 3 /end DEFAULT_EVENT_LIST /end DAQ_EVENT
 /end IF_DATA
/end MEASUREMENT
/begin MEASUREMENT calTest "" UBYTE NO_COMPU_METHOD 0 0 0 255 FORMAT "%.0" ECU_ADDRESS 0x40020218 READ_WRITE
 /begin IF_DATA XCP
  /begin DAQ_EVENT VARIABLE /begin DEFAULT_EVENT_LIST EVENT 3 /end DEFAULT_EVENT_LIST /end DAQ_EVENT
 /end IF_DATA
/end MEASUREMENT
/begin MEASUREMENT CTestLvChargingEnable "" UBYTE NO_COMPU_METHOD 0 0 0 1 FORMAT "%.2" ECU_ADDRESS 0x40020219 READ_WRITE
 /begin IF_DATA XCP
  /begin DAQ_EVENT VARIABLE /begin DEFAULT_EVENT_LIST EVENT 3 /end DEFAULT_EVENT_LIST /end DAQ_EVENT
 /end IF_DATA
/end MEASUREMENT
/begin MEASUREMENT CTestPostCoolReq "" UBYTE NO_COMPU_METHOD 0 0 0 1 FORMAT "%.2" ECU_ADDRESS 0x4002021a READ_WRITE
 /begin IF_DATA XCP
  /begin DAQ_EVENT VARIABLE /begin DEFAULT_EVENT_LIST EVENT 3 /end DEFAULT_EVENT_LIST /end DAQ_EVENT
 /end IF_DATA
/end MEASUREMENT
/begin MEASUREMENT CTestNewTorqueLimitCalEn "" UBYTE NO_COMPU_METHOD 0 0 0 1 FORMAT "%.2" ECU_ADDRESS 0x4002021b READ_WRITE
 /begin IF_DATA XCP
  /begin DAQ_EVENT VARIABLE /begin DEFAULT_EVENT_LIST EVENT 3 /end DEFAULT_EVENT_LIST /end DAQ_EVENT
 /end IF_DATA
/end MEASUREMENT
/begin MEASUREMENT CTestUseEMotEffMap "" UBYTE NO_COMPU_METHOD 0 0 0 1 FORMAT "%.2" ECU_ADDRESS 0x4002021c READ_WRITE
 /begin IF_DATA XCP
  /begin DAQ_EVENT VARIABLE /begin DEFAULT_EVENT_LIST EVENT 3 /end DEFAULT_EVENT_LIST /end DAQ_EVENT
 /end IF_DATA
/end MEASUREMENT
/begin MEASUREMENT CTestUseSocCorrnFLt "" UBYTE NO_COMPU_METHOD 0 0 0 1 FORMAT "%.2" ECU_ADDRESS 0x40020220 READ_WRITE
 /begin IF_DATA XCP
  /begin DAQ_EVENT VARIABLE /begin DEFAULT_EVENT_LIST EVENT 3 /end DEFAULT_EVENT_LIST /end DAQ_EVENT
 /end IF_DATA
/end MEASUREMENT
/begin MEASUREMENT CTestUseDeplePid "" UBYTE NO_COMPU_METHOD 0 0 0 1 FORMAT "%.2" ECU_ADDRESS 0x40020221 READ_WRITE
 /begin IF_DATA XCP
  /begin DAQ_EVENT VARIABLE /begin DEFAULT_EVENT_LIST EVENT 3 /end DEFAULT_EVENT_LIST /end DAQ_EVENT
 /end IF_DATA
/end MEASUREMENT
/begin MEASUREMENT CResetEgyMgrCal "" UBYTE NO_COMPU_METHOD 0 0 0 1 FORMAT "%.2" ECU_ADDRESS 0x40020222 READ_WRITE
 /begin IF_DATA XCP
  /begin DAQ_EVENT VARIABLE /begin DEFAULT_EVENT_LIST EVENT 3 /end DEFAULT_EVENT_LIST /end DAQ_EVENT
 /end IF_DATA
/end MEASUREMENT
/begin MEASUREMENT CTestUseReservedPwrLosses "" UBYTE NO_COMPU_METHOD 0 0 0 1 FORMAT "%.2" ECU_ADDRESS 0x40020223 READ_WRITE
 /begin IF_DATA XCP
  /begin DAQ_EVENT VARIABLE /begin DEFAULT_EVENT_LIST EVENT 3 /end DEFAULT_EVENT_LIST /end DAQ_EVENT
 /end IF_DATA
/end MEASUREMENT
/begin MEASUREMENT CTestReservedPwrLosses "" FLOAT32_IEEE tKilowatt 0 0 -10000 10000 ECU_ADDRESS 0x40020224 READ_WRITE
 /begin IF_DATA XCP
  /begin DAQ_EVENT VARIABLE /begin DEFAULT_EVENT_LIST EVENT 3 /end DEFAULT_EVENT_LIST /end DAQ_EVENT
 /end IF_DATA
/end MEASUREMENT
/begin MEASUREMENT CTestUseReservedPwrForAux "" UBYTE NO_COMPU_METHOD 0 0 0 1 FORMAT "%.2" ECU_ADDRESS 0x40020228 READ_WRITE
 /begin IF_DATA XCP
  /begin DAQ_EVENT VARIABLE /begin DEFAULT_EVENT_LIST EVENT 3 /end DEFAULT_EVENT_LIST /end DAQ_EVENT
 /end IF_DATA
/end MEASUREMENT
/begin MEASUREMENT CTestReservedPwrForAux "" FLOAT32_IEEE tKilowatt 0 0 -10000 10000 ECU_ADDRESS 0x4002022c READ_WRITE
 /begin IF_DATA XCP
  /begin DAQ_EVENT VARIABLE /begin DEFAULT_EVENT_LIST EVENT 3 /end DEFAULT_EVENT_LIST /end DAQ_EVENT
 /end IF_DATA
/end MEASUREMENT
/begin MEASUREMENT CTestEgyMgmSustainStgy "" UBYTE NO_COMPU_METHOD 0 0 0 1 FORMAT "%.2" ECU_ADDRESS 0x40020230 READ_WRITE
 /begin IF_DATA XCP
  /begin DAQ_EVENT VARIABLE /begin DEFAULT_EVENT_LIST EVENT 3 /end DEFAULT_EVENT_LIST /end DAQ_EVENT
 /end IF_DATA
/end MEASUREMENT
/begin MEASUREMENT CTestForceEVPlantMode "" UBYTE NO_COMPU_METHOD 0 0 0 1 FORMAT "%.2" ECU_ADDRESS 0x40020231 READ_WRITE
 /begin IF_DATA XCP
  /begin DAQ_EVENT VARIABLE /begin DEFAULT_EVENT_LIST EVENT 3 /end DEFAULT_EVENT_LIST /end DAQ_EVENT
 /end IF_DATA
/end MEASUREMENT
/begin MEASUREMENT CTestEgyMgmChrgReq "" UBYTE NO_COMPU_METHOD 0 0 0 1 FORMAT "%.2" ECU_ADDRESS 0x40020232 READ_WRITE
 /begin IF_DATA XCP
  /begin DAQ_EVENT VARIABLE /begin DEFAULT_EVENT_LIST EVENT 3 /end DEFAULT_EVENT_LIST /end DAQ_EVENT
 /end IF_DATA
/end MEASUREMENT
/begin MEASUREMENT CTqLimIceLimSelector "" UBYTE NO_COMPU_METHOD 0 0 0 255 FORMAT "%.0" ECU_ADDRESS 0x40020233 READ_WRITE
 /begin IF_DATA XCP
  /begin DAQ_EVENT VARIABLE /begin DEFAULT_EVENT_LIST EVENT 3 /end DEFAULT_EVENT_LIST /end DAQ_EVENT
 /end IF_DATA
/end MEASUREMENT
/begin MEASUREMENT CTestHvBat1PumpReq "" SBYTE tPercent_S8 0 0 0 100 ECU_ADDRESS 0x40020234 READ_WRITE
 /begin IF_DATA XCP
  /begin DAQ_EVENT VARIABLE /begin DEFAULT_EVENT_LIST EVENT 3 /end DEFAULT_EVENT_LIST /end DAQ_EVENT
 /end IF_DATA
/end MEASUREMENT
/begin MEASUREMENT CTestHvBat2PumpReq "" SBYTE tPercent_S8 0 0 0 100 ECU_ADDRESS 0x40020235 READ_WRITE
 /begin IF_DATA XCP
  /begin DAQ_EVENT VARIABLE /begin DEFAULT_EVENT_LIST EVENT 3 /end DEFAULT_EVENT_LIST /end DAQ_EVENT
 /end IF_DATA
/end MEASUREMENT
/begin MEASUREMENT dummy2 "" ULONG NO_COMPU_METHOD 0 0 0 4294967295 FORMAT "%.0" ECU_ADDRESS 0x400200d0 READ_WRITE
 /begin IF_DATA XCP
  /begin DAQ_EVENT VARIABLE /begin DEFAULT_EVENT_LIST EVENT 3 /end DEFAULT_EVENT_LIST /end DAQ_EVENT
 /end IF_DATA
/end MEASUREMENT
/begin MEASUREMENT dummy1 "" ULONG NO_COMPU_METHOD 0 0 0 4294967295 FORMAT "%.0" ECU_ADDRESS 0x400200d4 READ_WRITE
 /begin IF_DATA XCP
  /begin DAQ_EVENT VARIABLE /begin DEFAULT_EVENT_LIST EVENT 3 /end DEFAULT_EVENT_LIST /end DAQ_EVENT
 /end IF_DATA
/end MEASUREMENT
/begin GROUP caldata_VALUE ""
 /begin REF_CHARACTERISTIC CWhlTqReLimLowrAbsActv CWhlTqSplLongNeg CWhlTqSplLongPos CWishboneAgSnsrVoltDeltaFrnt CWishboneAgSnsrVoltDeltaRe CWishboneSnsrOutpVoltMax CWishboneSnsrOutpVoltMin CYawRefGenAyMaxScalingCoeff CYawRefGenBlendFacVx0 CYawRefGenBlendFacVxMax CYawRefGenCsiTarget CYawRefGenKinSngTrackYawRateScalingFac CYawRefGenKOmegan CYawRefGenMinUndersteerGain CYawRefGenPacejkaRby1FacFrnt CYawRefGenPacejkaRby1FacRe CYawRefGenPacejkaRby2FacFrnt CYawRefGenPacejkaRby2FacRe CYawRefGenPsidotStarCoeff CYawRefGenSecantInitWidth CYawRefGenSecantMaxIter CYawRefGenSecantTol CYawRefGenYawRateTarMax CYtrYawTqLimFrnt /end REF_CHARACTERISTIC
/end GROUP
/begin GROUP caldata_gemera_PAR ""
 /begin SUB_GROUP caldata_gemera_AXIS_PTS caldata_gemera_CURVE caldata_gemera_MAP caldata_gemera_VALUE /end SUB_GROUP
/end GROUP
/begin GROUP caldata_gemera_AXIS_PTS "" /begin REF_CHARACTERISTIC /end REF_CHARACTERISTIC /end GROUP
/begin GROUP caldata_gemera_CURVE ""
 /begin REF_CHARACTERISTIC CBatSoCPowerDemandMaxTab CPFricBrkMaxDegStTab CStatyCrkGearTab CTsmStateEnableMask /end REF_CHARACTERISTIC
/end GROUP
/begin GROUP caldata_gemera_MAP "" /begin REF_CHARACTERISTIC /end REF_CHARACTERISTIC /end GROUP
/begin GROUP caldata_gemera_VALUE ""
 /begin REF_CHARACTERISTIC CAvasModSwt CCluDtTqHyst CEnaColdRigMode CRatBevelFrnt CRatBevelRe CRatPropshDropGear CRatSideGbx CTestSpeedLimiter CTestSuppgMod CTestTsmDrvCfg CTestTsmIceDebugMode CTrsmRvsgEna CVsoTireMdlPureLgtSlipStfnCon CVsoWhlLoadEnaSwt /end REF_CHARACTERISTIC
/end GROUP
/begin GROUP globals ""
 /begin SUB_GROUP adaption_handler app_dids automated_driver_control can_a_db can_b_db can_c_db can_d_db can_e_db can_f_db can_flexcan_fifo config_nvm_data_interface cruise_control ebrake_ctrl ebrakes etpu_awac_main fault_masks_manager info_message inverter_state_machine lib_energy_manager lib_hybrid_sm lib_hybrid_torque lib_inverter_ctrl lib_thermal_manager lnch_ctrl obd obd_calid_cvn pedal_torque_request perf_mod platform_setup setup speed_limiter task_can_b task_can_f task_hwio_1ms task_hybrid_sm task_inverter_ctrl task_ride_height task_thermal_manager task_tracing task_uds_timeout_handler tpms tpms_sensors tq_limits user_common_nvm_data_interface vso_imu vso_steer vso_vehicle_motion_observer VX1000 VX1000If /end SUB_GROUP
/end GROUP
/begin GROUP adaption_handler "" /begin REF_MEASUREMENT availableAdaptionFlashDebug dummy1 dummy2 /end REF_MEASUREMENT /end GROUP
/begin GROUP app_dids "" /begin REF_MEASUREMENT gEcuName /end REF_MEASUREMENT /end GROUP
/begin GROUP automated_driver_control "" /begin REF_MEASUREMENT autDrvrCtrlOffRsnMask /end REF_MEASUREMENT /end GROUP
/begin GROUP can_a_db ""
 /begin REF_MEASUREMENT canADebugInv canADiagAccPhysRespFvcmG1 canADiagRespEpsAG1 canADiagRespEpsBG1 canADiagRespIebG1 canADiagRespImuG1 canADiagRespInverterG1 canAGvcuAdaptiveCruiseControl canAGvcuAutDrvr canAGvcuCogImu canAGvcuCruiseControlMasks canAGvcuFrontCoolingControl canAGvcuHvControl canAGvcuNodesEnableHold canAGvcuOdometer canAGvcuPerfMod canAGvcuRearCoolingControl canAGvcuSleep canAGvcuVehState1 canAGvcuVehState2 canAGvcuVehState3 canALiftCmd canAPowertrainInformationMessages canAPowertrainTelltales1 canAPowertrainTelltales2 canATpmsCarData /end REF_MEASUREMENT
/end GROUP
/begin GROUP can_b_db ""
 /begin REF_MEASUREMENT canBDiagDs1FuncReqG2 canBDiagFuncreqEpsG2 canBDiagReqEpsAG2 canBDiagReqEpsBG2 canBNmRequestGvcuDs1 canBOdometerValueDs1 canBPwrSteerDs1 canBStabilityInfoDs1 canBSystemTimeDs1 canBVehicleSpeedDs1 canBVehicleStatusDs1 canBWhlTqActFrontDs1 canBWhlTqActRearDs1 canBXcpCmdEpsA canBXcpCmdEpsB /end REF_MEASUREMENT
/end GROUP
/begin GROUP can_c_db ""
 /begin REF_MEASUREMENT canCGvcuLstReq canCGvcuSts1 canCGvcuSts2 canCGvcuThermalSensor /end REF_MEASUREMENT
/end GROUP
/begin GROUP can_d_db ""
 /begin REF_MEASUREMENT canDAcu01G2 canDAcu03G2 canDDiagReqInverterG2 canDInvCmd canDInvMotionCmd /end REF_MEASUREMENT
/end GROUP
/begin GROUP can_e_db "" /begin REF_MEASUREMENT canEDummyMessage0001 /end REF_MEASUREMENT /end GROUP
/begin GROUP can_f_db ""
 /begin REF_MEASUREMENT canFAccGvcuRequest canFAccVehicleStatus canFBrakePressureRequest canFDiagAccPhysReqFvcmG2 canFDiagDs2FuncReqG2 canFDiagReqIebG2 canFDiagReqImuG2 canFDriverAssistance01 canFNmRequestGvcuDs2 canFOdometerValue canFPwrSteerInfoDs2 canFRegen02 canFRotronicsWhlBrkTq canFStabilityInfoDs2 canFSysPwrMode canFSystemTimeDs2 canFVehicleMode canFVehicleStatusDs2 canFWheelTorqueActFront canFWheelTorqueActRear canFXcpCmdIeb /end REF_MEASUREMENT
/end GROUP
/begin GROUP can_flexcan_fifo "" /begin REF_MEASUREMENT gDebugCanEcrErrorCount /end REF_MEASUREMENT /end GROUP
/begin GROUP config_nvm_data_interface "" /begin REF_MEASUREMENT gConfigNvmDataStatus instance /end REF_MEASUREMENT /end GROUP
/begin GROUP cruise_control ""
 /begin REF_MEASUREMENT adpvCrsCtrlEyeqBlkdRsnMask adpvCrsCtrlFolCtrlActvInhbMask adpvCrsCtrlStbyInhbMask adpvCrsCtrlVelCtrlActvInhbMask /end REF_MEASUREMENT
/end GROUP
/begin GROUP ebrake_ctrl ""
 /begin REF_MEASUREMENT BResetEbrakesOCTrigger CDisengageEbrakes CEngageEbrakes CRunEBrakeStateM I_E_BRAKE_LEFT_NEG I_E_BRAKE_LEFT_POS I_E_BRAKE_RIGHT_NEG I_E_BRAKE_RIGHT_POS U_I_E_BRAKE_LEFT_NEG U_I_E_BRAKE_LEFT_NEG_raw U_I_E_BRAKE_LEFT_POS U_I_E_BRAKE_LEFT_POS_raw U_I_E_BRAKE_RIGHT_NEG U_I_E_BRAKE_RIGHT_NEG_raw U_I_E_BRAKE_RIGHT_POS U_I_E_BRAKE_RIGHT_POS_raw /end REF_MEASUREMENT
/end GROUP
/begin GROUP ebrakes ""
 /begin REF_MEASUREMENT CEBrakeServiceMode CTest_EBrakeOLCheck EBrakeSMCommandOverwrite /end REF_MEASUREMENT
/end GROUP
/begin GROUP etpu_awac_main ""
 /begin REF_MEASUREMENT _global_mem_init _SCM_code_mem_array etpu_c_config etpu_config eTPU_engine_A eTPU_engine_B eTPU_engine_C /end REF_MEASUREMENT
/end GROUP
/begin GROUP fault_masks_manager ""
 /begin REF_MEASUREMENT acceleratorPedalMask asfMask liftSensorDiagMask mainDiagnosticsMask /end REF_MEASUREMENT
/end GROUP
/begin GROUP info_message ""
 /begin REF_MEASUREMENT ovrdInfoMsgAdaptiveCruiseControl ovrdInfoMsgBrakeAsf ovrdInfoMsgBrkFldLvlLow ovrdInfoMsgCruiseControl ovrdInfoMsgDamperAsf ovrdInfoMsgHydraulicPressAsf ovrdInfoMsgImuAsf ovrdInfoMsgRideHeightAsf ovrdInfoMsgSpeedLimitReached ovrdInfoMsgSteeringAsf ovrdInfoMsgTpmsAsf ovrdInfoMsgVehicleSpeedAsf /end REF_MEASUREMENT
/end GROUP
/begin GROUP inverter_state_machine "" /begin REF_MEASUREMENT CTestInvStateMachineRun /end REF_MEASUREMENT /end GROUP
/begin GROUP lib_energy_manager ""
 /begin REF_MEASUREMENT CResetEgyMgrCal CTestEgyMgmChrgReq CTestEgyMgmSustainStgy CTestForceEVPlantMode CTestReservedPwrForAux CTestReservedPwrLosses CTestUseDeplePid CTestUseReservedPwrForAux CTestUseReservedPwrLosses CTestUseSocCorrnFLt /end REF_MEASUREMENT
/end GROUP
/begin GROUP lib_hybrid_sm ""
 /begin REF_MEASUREMENT CTestLvChargingEnable hvOnRequest hvOnRequestReason hybState /end REF_MEASUREMENT
/end GROUP
/begin GROUP lib_hybrid_torque "" /begin REF_MEASUREMENT CTestNewTorqueLimitCalEn CTestUseEMotEffMap /end REF_MEASUREMENT /end GROUP
/begin GROUP lib_inverter_ctrl ""
 /begin REF_MEASUREMENT CTestEmotorTorque CTestInvCtrlMode CTestManualInvCtrl CTestMaxNegTorque CTestMaxPosTorque CTestMotorSpeedReq /end REF_MEASUREMENT
/end GROUP
/begin GROUP lib_thermal_manager ""
 /begin REF_MEASUREMENT centerLeftFanSts centerRightFanSts emotPumpSts frontLeftFanSts frontRightFanSts hvacPumpSts hvBatPump1Sts hvBatPump2Sts icLeftPumpSts icRighPumpSts invPumpSts middleLeftFanSts middleRightFanSts rearLeftFanSts rearRighFanSts thermalDiagSts thermalFactoryTestDone thermalFactoryTestPassed /end REF_MEASUREMENT
/end GROUP
/begin GROUP lnch_ctrl "" /begin REF_MEASUREMENT lnchCtrlAbortMask lnchCtrlReqAllwdMask /end REF_MEASUREMENT /end GROUP
/begin GROUP obd ""
 /begin REF_MEASUREMENT B_DenominatorConditionsMet B_OutsideDrivingCycle b_WarmUpCycleDone CTestReadiness dCond_load dCond_rpm dCond_tmot driveCycleCounter drivingCycleCnt80 DTCList DTCListD DTCListToggle FrameSize FreezeDTC freezeFrameDTC FreezeFrames l_DistSinceFaultsCleared Last_ReportFault Last_ReportOk max_DTCs_to_debug max_FreezeFrames_to_debug MIL_Distance mil_status n_WarmUpCycles N_WarmUpCyclesSinceFaultsCleared NrOfFaults OBD_MonitorStatusSinceClearDTC overrideDTCstuff PermanentDTC SecurityLevel SERVICE_09_0A_ECUNAME warmUpCycleCnt40 /end REF_MEASUREMENT
/end GROUP
/begin GROUP obd_calid_cvn "" /begin REF_MEASUREMENT gCalCvn gCalDataCrc gCalId /end REF_MEASUREMENT /end GROUP
/begin GROUP pedal_torque_request "" /begin REF_MEASUREMENT CPedlCurveLookupTab CPedlCurveLookupXsp /end REF_MEASUREMENT /end GROUP
/begin GROUP perf_mod "" /begin REF_MEASUREMENT CPerfModCalTab /end REF_MEASUREMENT /end GROUP
/begin GROUP platform_setup "" /begin REF_MEASUREMENT calTest crcAscii /end REF_MEASUREMENT /end GROUP
/begin GROUP setup "" /begin REF_MEASUREMENT CTestIsEcuResetAllowed /end REF_MEASUREMENT /end GROUP
/begin GROUP speed_limiter "" /begin REF_MEASUREMENT spdLimMask /end REF_MEASUREMENT /end GROUP
/begin GROUP task_can_b "" /begin REF_MEASUREMENT gCanBDisableTx /end REF_MEASUREMENT /end GROUP
/begin GROUP task_can_f "" /begin REF_MEASUREMENT gCanFDisableTx /end REF_MEASUREMENT /end GROUP
/begin GROUP task_hwio_1ms ""
 /begin REF_MEASUREMENT drvrAccrPedlFaults drvrAccrPedlPerc drvrAccrPedlPercQ drvrAccrPedlSts drvrAccrPedlU1 drvrAccrPedlU2 /end REF_MEASUREMENT
/end GROUP
/begin GROUP task_hybrid_sm "" /begin REF_MEASUREMENT CTestNoHybridFaults CTestPostCoolReq /end REF_MEASUREMENT /end GROUP
/begin GROUP task_inverter_ctrl "" /begin REF_MEASUREMENT CTestEnaInvCtrlGainSet CTestInvCtrlGainSet /end REF_MEASUREMENT /end GROUP
/begin GROUP task_ride_height ""
 /begin REF_MEASUREMENT RhcLiftCalibEnable RhcLiftCalibState RhcLiftCylVFL RhcLiftCylVFR RhcLiftCylVRL RhcLiftCylVRR RhcWishboneSnsrVFL RhcWishboneSnsrVFR RhcWishboneSnsrVRL RhcWishboneSnsrVRR /end REF_MEASUREMENT
/end GROUP
/begin GROUP task_thermal_manager "" /begin REF_MEASUREMENT CTestHvBat1PumpReq CTestHvBat2PumpReq /end REF_MEASUREMENT /end GROUP
/begin GROUP task_tracing "" /begin REF_MEASUREMENT activeTask vx1000EventRunningInKernel /end REF_MEASUREMENT /end GROUP
/begin GROUP task_uds_timeout_handler "" /begin REF_MEASUREMENT SeedUpdated /end REF_MEASUREMENT /end GROUP
/begin GROUP tpms ""
 /begin REF_MEASUREMENT tpmsMinPFrnt tpmsMinPRe tpmsTireP tpmsTirePSt tpmsTireT tpmsTireValQ tpmsWarnLampRsn tpmsWarnLampSts /end REF_MEASUREMENT
/end GROUP
/begin GROUP tpms_sensors "" /begin REF_MEASUREMENT tpmsBattLvl tpmsEcuFltMask tpmsRssi tpmsSnsrFltMask /end REF_MEASUREMENT /end GROUP
/begin GROUP tq_limits "" /begin REF_MEASUREMENT CTqLimIceLimSelector /end REF_MEASUREMENT /end GROUP
/begin GROUP user_common_nvm_data_interface "" /begin REF_MEASUREMENT gUserCommonNvmDataStatus /end REF_MEASUREMENT /end GROUP
/begin GROUP vso_imu "" /begin REF_MEASUREMENT imuRotCalTrig /end REF_MEASUREMENT /end GROUP
/begin GROUP vso_steer "" /begin REF_MEASUREMENT runCalibSlipringCentering /end REF_MEASUREMENT /end GROUP
/begin GROUP vso_vehicle_motion_observer "" /begin REF_MEASUREMENT CTestDsoCf CTestDsoCr /end REF_MEASUREMENT /end GROUP
/begin GROUP VX1000 "" /begin REF_MEASUREMENT vx1000_DetectStartTime /end REF_MEASUREMENT /end GROUP
/begin GROUP VX1000If "" /begin REF_MEASUREMENT VX1000If_ErrorCount VX1000If_State /end REF_MEASUREMENT /end GROUP
/begin GROUP setup "" /begin REF_MEASUREMENT CTestIsEcuResetAllowed /end REF_MEASUREMENT /end GROUP
/begin GROUP task_tracing "" /begin REF_MEASUREMENT activeTask vx1000EventRunningInKernel /end REF_MEASUREMENT /end GROUP
/end MODULE
/end PROJECT
