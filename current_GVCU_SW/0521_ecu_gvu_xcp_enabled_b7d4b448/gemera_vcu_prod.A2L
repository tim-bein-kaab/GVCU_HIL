ASAP2_VERSION 1 71
/begin PROJECT GEMERA ""
/begin MODULE GVCU ""
/begin MOD_COMMON "" BYTE_ORDER MSB_FIRST ALIGNMENT_BYTE 1 ALIGNMENT_WORD 2 ALIGNMENT_LONG 4 ALIGNMENT_FLOAT16_IEEE 2 ALIGNMENT_FLOAT32_IEEE 4 ALIGNMENT_FLOAT64_IEEE 8 ALIGNMENT_INT64 8 /end MOD_COMMON
/begin TYPEDEF_MEASUREMENT tIceSystemState "" ULONG tIceSystemState 0 0 0 4 /end TYPEDEF_MEASUREMENT
/begin TYPEDEF_MEASUREMENT tBar_10_S16 "" SWORD tBar_10_S16 0 0 -1.0 1000.0 /end TYPEDEF_MEASUREMENT
/begin TYPEDEF_MEASUREMENT tGear "" ULONG tGear 0 0 0 10 /end TYPEDEF_MEASUREMENT
/begin TYPEDEF_MEASUREMENT tSensorCalibration "" ULONG tSensorCalibration 0 0 0 2 /end TYPEDEF_MEASUREMENT
/begin TYPEDEF_MEASUREMENT tPaddlePressSt "" ULONG tPaddlePressSt 0 0 0 3 /end TYPEDEF_MEASUREMENT
/begin TYPEDEF_MEASUREMENT tAmpereHour "" FLOAT32_IEEE tAmpereHour 0 0 0 1000 /end TYPEDEF_MEASUREMENT
/begin TYPEDEF_MEASUREMENT tAutoHillHoldDirection "" ULONG tAutoHillHoldDirection 0 0 0 9 /end TYPEDEF_MEASUREMENT
/begin TYPEDEF_MEASUREMENT tRadianPerSecond "" FLOAT32_IEEE tRadianPerSecond 0 0 -1000 1000 /end TYPEDEF_MEASUREMENT
/begin TYPEDEF_MEASUREMENT tPercent_S8 "" SBYTE tPercent_S8 0 0 0 100 /end TYPEDEF_MEASUREMENT
/begin TYPEDEF_MEASUREMENT tDegree_10_S16 "" SWORD tDegree_10_S16 0 0 -720.0 720.0 /end TYPEDEF_MEASUREMENT
/begin TYPEDEF_MEASUREMENT tPercent "" FLOAT32_IEEE tPercent 0 0 0 100 /end TYPEDEF_MEASUREMENT
/begin TYPEDEF_MEASUREMENT tLitre "" FLOAT32_IEEE tLitre 0 0 0 1000 /end TYPEDEF_MEASUREMENT
/begin TYPEDEF_MEASUREMENT tPerformanceModeEPS "" ULONG tPerformanceModeEPS 0 0 0 3 /end TYPEDEF_MEASUREMENT
/begin TYPEDEF_MEASUREMENT tSteeringSystemStatus "" ULONG tSteeringSystemStatus 0 0 0 3 /end TYPEDEF_MEASUREMENT
/begin TYPEDEF_MEASUREMENT tFrictionBrakeTorqueArbitrationMode "" ULONG tFrictionBrakeTorqueArbitrationMode 0 0 0 5 /end TYPEDEF_MEASUREMENT
/begin TYPEDEF_MEASUREMENT uint32_t_0x400 "" ULONG NO_COMPU_METHOD 0 0 0 1 BIT_MASK 0x400 /end TYPEDEF_MEASUREMENT
/begin TYPEDEF_MEASUREMENT tRadianPerSecond_100_U16 "" UWORD tRadianPerSecond_100_U16 0 0 -10.0 10.0 /end TYPEDEF_MEASUREMENT
/begin TYPEDEF_MEASUREMENT tCanFTimeoutIndex "" ULONG tCanFTimeoutIndex 0 0 0 36 /end TYPEDEF_MEASUREMENT
/begin TYPEDEF_MEASUREMENT uint8_t_0x2 "" UBYTE NO_COMPU_METHOD 0 0 0 1 BIT_MASK 0x2 /end TYPEDEF_MEASUREMENT
/begin TYPEDEF_MEASUREMENT tPerformanceModeSpeedLimiter "" ULONG tPerformanceModeSpeedLimiter 0 0 0 6 /end TYPEDEF_MEASUREMENT
/begin TYPEDEF_MEASUREMENT tAccSetVelOrDist "" ULONG tAccSetVelOrDist 0 0 0 4 /end TYPEDEF_MEASUREMENT
/begin TYPEDEF_MEASUREMENT tMillimetre_10_S16 "" SWORD tMillimetre_10_S16 0 0 -1000.0 1000.0 /end TYPEDEF_MEASUREMENT
/begin TYPEDEF_MEASUREMENT tPropulsionMode "" ULONG tPropulsionMode 0 0 0 4 /end TYPEDEF_MEASUREMENT
/begin TYPEDEF_MEASUREMENT tNewtonMetre "" FLOAT32_IEEE tNewtonMetre 0 0 -100000 100000 /end TYPEDEF_MEASUREMENT
/begin TYPEDEF_MEASUREMENT tPropshaftDrivingCrankState "" ULONG tPropshaftDrivingCrankState 0 0 0 3 /end TYPEDEF_MEASUREMENT
/begin TYPEDEF_MEASUREMENT uint8_t_0x10 "" UBYTE NO_COMPU_METHOD 0 0 0 1 BIT_MASK 0x10 /end TYPEDEF_MEASUREMENT
/begin TYPEDEF_MEASUREMENT tAdasDriverTakeoverRequest "" ULONG tAdasDriverTakeoverRequest 0 0 0 3 /end TYPEDEF_MEASUREMENT
/begin TYPEDEF_MEASUREMENT tAutoHillHoldState "" ULONG tAutoHillHoldState 0 0 0 7 /end TYPEDEF_MEASUREMENT
/begin TYPEDEF_MEASUREMENT uint32_t_0x10000 "" ULONG NO_COMPU_METHOD 0 0 0 1 BIT_MASK 0x10000 /end TYPEDEF_MEASUREMENT
/begin TYPEDEF_MEASUREMENT tBar "" FLOAT32_IEEE tBar 0 0 -1 1000 /end TYPEDEF_MEASUREMENT
/begin TYPEDEF_MEASUREMENT tSign "" SLONG tSign 0 0 -1 1 /end TYPEDEF_MEASUREMENT
/begin TYPEDEF_MEASUREMENT uint32_t_0x100000 "" ULONG NO_COMPU_METHOD 0 0 0 1 BIT_MASK 0x100000 /end TYPEDEF_MEASUREMENT
/begin TYPEDEF_MEASUREMENT tPanelStatus "" ULONG tPanelStatus 0 0 0 6 /end TYPEDEF_MEASUREMENT
/begin TYPEDEF_MEASUREMENT tIceStartCmd "" ULONG tIceStartCmd 0 0 0 2 /end TYPEDEF_MEASUREMENT
/begin TYPEDEF_MEASUREMENT tAdaptiveCruiseControlState "" ULONG tAdaptiveCruiseControlState 0 0 0 8 /end TYPEDEF_MEASUREMENT
/begin TYPEDEF_MEASUREMENT uint8_t_0x80 "" UBYTE NO_COMPU_METHOD 0 0 0 1 BIT_MASK 0x80 /end TYPEDEF_MEASUREMENT
/begin TYPEDEF_MEASUREMENT tShiftRequest "" ULONG tShiftRequest 0 0 0 2 /end TYPEDEF_MEASUREMENT
/begin TYPEDEF_MEASUREMENT tCanATimeoutIndex "" ULONG tCanATimeoutIndex 0 0 0 44 /end TYPEDEF_MEASUREMENT
/begin TYPEDEF_MEASUREMENT tDegree "" FLOAT32_IEEE tDegree 0 0 -720 720 /end TYPEDEF_MEASUREMENT
/begin TYPEDEF_MEASUREMENT tPerformanceModeVDC "" ULONG tPerformanceModeVDC 0 0 0 4 /end TYPEDEF_MEASUREMENT
/begin TYPEDEF_MEASUREMENT tHertz "" FLOAT32_IEEE tHertz 0 0 0 30000 /end TYPEDEF_MEASUREMENT
/begin TYPEDEF_MEASUREMENT tAdasDriverTakeoffRequest "" ULONG tAdasDriverTakeoffRequest 0 0 0 2 /end TYPEDEF_MEASUREMENT
/begin TYPEDEF_MEASUREMENT tLiftMovement "" ULONG tLiftMovement 0 0 0 2 /end TYPEDEF_MEASUREMENT
/begin TYPEDEF_MEASUREMENT tChargePortStatus "" ULONG tChargePortStatus 0 0 0 3 /end TYPEDEF_MEASUREMENT
/begin TYPEDEF_MEASUREMENT tAccDistanceLevel "" ULONG tAccDistanceLevel 0 0 0 4 /end TYPEDEF_MEASUREMENT
/begin TYPEDEF_MEASUREMENT uint16_t_0x4 "" UWORD NO_COMPU_METHOD 0 0 0 1 BIT_MASK 0x4 /end TYPEDEF_MEASUREMENT
/begin TYPEDEF_MEASUREMENT tPerformanceModeRequestInhibitReason "" ULONG tPerformanceModeRequestInhibitReason 0 0 0 8 /end TYPEDEF_MEASUREMENT
/begin TYPEDEF_MEASUREMENT tPercent_100_S32 "" SLONG tPercent_100_S32 0 0 0.0 100.0 /end TYPEDEF_MEASUREMENT
/begin TYPEDEF_MEASUREMENT tLeakage "" ULONG tLeakage 0 0 0 3 /end TYPEDEF_MEASUREMENT
/begin TYPEDEF_MEASUREMENT tHex_U8 "" UBYTE tHex_U8 0 0 0 255 /end TYPEDEF_MEASUREMENT
/begin TYPEDEF_MEASUREMENT tImmobilizerState "" ULONG tImmobilizerState 0 0 0 2 /end TYPEDEF_MEASUREMENT
/begin TYPEDEF_MEASUREMENT tSecond "" FLOAT32_IEEE tSecond 0 0 0 3600 /end TYPEDEF_MEASUREMENT
/begin TYPEDEF_MEASUREMENT tHybSmState "" ULONG tHybSmState 0 0 0 6 /end TYPEDEF_MEASUREMENT
/begin TYPEDEF_MEASUREMENT uint16_t_0x8 "" UWORD NO_COMPU_METHOD 0 0 0 1 BIT_MASK 0x8 /end TYPEDEF_MEASUREMENT
/begin TYPEDEF_MEASUREMENT tQualifier "" ULONG tQualifier 0 0 0 3 /end TYPEDEF_MEASUREMENT
/begin TYPEDEF_MEASUREMENT tHillHoldSts "" ULONG tHillHoldSts 0 0 0 4 /end TYPEDEF_MEASUREMENT
/begin TYPEDEF_MEASUREMENT uint32_t "" ULONG NO_COMPU_METHOD 0 0 0 4294967295 /end TYPEDEF_MEASUREMENT
/begin TYPEDEF_MEASUREMENT tAbsStatus "" ULONG tAbsStatus 0 0 0 4 /end TYPEDEF_MEASUREMENT
/begin TYPEDEF_MEASUREMENT tTractionControlMode "" ULONG tTractionControlMode 0 0 0 6 /end TYPEDEF_MEASUREMENT
/begin TYPEDEF_MEASUREMENT tBar_100_S16 "" SWORD tBar_100_S16 0 0 -1.0 1000.0 /end TYPEDEF_MEASUREMENT
/begin TYPEDEF_MEASUREMENT tBrakeFluidLevel "" ULONG tBrakeFluidLevel 0 0 0 3 /end TYPEDEF_MEASUREMENT
/begin TYPEDEF_MEASUREMENT uint32_t_0x8000 "" ULONG NO_COMPU_METHOD 0 0 0 1 BIT_MASK 0x8000 /end TYPEDEF_MEASUREMENT
/begin TYPEDEF_MEASUREMENT tCanCTimeoutIndex "" ULONG tCanCTimeoutIndex 0 0 0 12 /end TYPEDEF_MEASUREMENT
/begin TYPEDEF_MEASUREMENT tElectricalSystemState "" ULONG tElectricalSystemState 0 0 0 5 /end TYPEDEF_MEASUREMENT
/begin TYPEDEF_MEASUREMENT tHandlingAttitudeMode "" ULONG tHandlingAttitudeMode 0 0 0 7 /end TYPEDEF_MEASUREMENT
/begin TYPEDEF_MEASUREMENT tAccVehicleDetection "" ULONG tAccVehicleDetection 0 0 0 2 /end TYPEDEF_MEASUREMENT
/begin TYPEDEF_MEASUREMENT tCombustionEngineControlState "" ULONG tCombustionEngineControlState 0 0 0 6 /end TYPEDEF_MEASUREMENT
/begin TYPEDEF_MEASUREMENT tEnableState "" ULONG tEnableState 0 0 0 3 /end TYPEDEF_MEASUREMENT
/begin TYPEDEF_MEASUREMENT tPedalMapMode "" ULONG tPedalMapMode 0 0 0 6 /end TYPEDEF_MEASUREMENT
/begin TYPEDEF_MEASUREMENT uint32_t_0x8 "" ULONG NO_COMPU_METHOD 0 0 0 1 BIT_MASK 0x8 /end TYPEDEF_MEASUREMENT
/begin TYPEDEF_MEASUREMENT uint16_t_0x80 "" UWORD NO_COMPU_METHOD 0 0 0 1 BIT_MASK 0x80 /end TYPEDEF_MEASUREMENT
/begin TYPEDEF_MEASUREMENT tTakeoffState "" ULONG tTakeoffState 0 0 0 4 /end TYPEDEF_MEASUREMENT
/begin TYPEDEF_MEASUREMENT uint32_t_0x10 "" ULONG NO_COMPU_METHOD 0 0 0 1 BIT_MASK 0x10 /end TYPEDEF_MEASUREMENT
/begin TYPEDEF_MEASUREMENT tMillimetre "" FLOAT32_IEEE tMillimetre 0 0 -1000 1000 /end TYPEDEF_MEASUREMENT
/begin TYPEDEF_MEASUREMENT uint8_t_0x8 "" UBYTE NO_COMPU_METHOD 0 0 0 1 BIT_MASK 0x8 /end TYPEDEF_MEASUREMENT
/begin TYPEDEF_MEASUREMENT tAutomatedDriverCycleState "" ULONG tAutomatedDriverCycleState 0 0 0 5 /end TYPEDEF_MEASUREMENT
/begin TYPEDEF_MEASUREMENT tSpeedLimiterState "" ULONG tSpeedLimiterState 0 0 0 3 /end TYPEDEF_MEASUREMENT
/begin TYPEDEF_MEASUREMENT uint16_t_0x800 "" UWORD NO_COMPU_METHOD 0 0 0 1 BIT_MASK 0x800 /end TYPEDEF_MEASUREMENT
/begin TYPEDEF_MEASUREMENT uint8_t_0x20 "" UBYTE NO_COMPU_METHOD 0 0 0 1 BIT_MASK 0x20 /end TYPEDEF_MEASUREMENT
/begin TYPEDEF_MEASUREMENT tBMSState "" ULONG tBMSState 0 0 0 6 /end TYPEDEF_MEASUREMENT
/begin TYPEDEF_MEASUREMENT tTorqueSystemState "" ULONG tTorqueSystemState 0 0 0 5 /end TYPEDEF_MEASUREMENT
/begin TYPEDEF_MEASUREMENT tParkingBrakeRequest "" ULONG tParkingBrakeRequest 0 0 0 2 /end TYPEDEF_MEASUREMENT
/begin TYPEDEF_MEASUREMENT tPerformanceModeDDC "" ULONG tPerformanceModeDDC 0 0 0 6 /end TYPEDEF_MEASUREMENT
/begin TYPEDEF_MEASUREMENT uint32_t_0x4000 "" ULONG NO_COMPU_METHOD 0 0 0 1 BIT_MASK 0x4000 /end TYPEDEF_MEASUREMENT
/begin TYPEDEF_MEASUREMENT tPerformanceModeRHC "" ULONG tPerformanceModeRHC 0 0 0 3 /end TYPEDEF_MEASUREMENT
/begin TYPEDEF_MEASUREMENT tFactor_1000_S16 "" SWORD tFactor_1000_S16 0 0 -32.768 32.767 /end TYPEDEF_MEASUREMENT
/begin TYPEDEF_MEASUREMENT tInvSmStatus "" ULONG tInvSmStatus 0 0 0 5 /end TYPEDEF_MEASUREMENT
/begin TYPEDEF_MEASUREMENT uint16_t_0x40 "" UWORD NO_COMPU_METHOD 0 0 0 1 BIT_MASK 0x40 /end TYPEDEF_MEASUREMENT
/begin TYPEDEF_MEASUREMENT tInvCtrlMode "" ULONG tInvCtrlMode 0 0 0 3 /end TYPEDEF_MEASUREMENT
/begin TYPEDEF_MEASUREMENT int8_t "" SBYTE NO_COMPU_METHOD 0 0 -128 127 /end TYPEDEF_MEASUREMENT
/begin TYPEDEF_MEASUREMENT tVolt "" FLOAT32_IEEE tVolt 0 0 0 1000 /end TYPEDEF_MEASUREMENT
/begin TYPEDEF_MEASUREMENT tTpmsSpdLimHit "" ULONG tTpmsSpdLimHit 0 0 0 2 /end TYPEDEF_MEASUREMENT
/begin TYPEDEF_MEASUREMENT tRegenStatus "" ULONG tRegenStatus 0 0 0 2 /end TYPEDEF_MEASUREMENT
/begin TYPEDEF_MEASUREMENT tLaunchControlMode "" ULONG tLaunchControlMode 0 0 0 3 /end TYPEDEF_MEASUREMENT
/begin TYPEDEF_MEASUREMENT tRotDir "" ULONG tRotDir 0 0 0 1 /end TYPEDEF_MEASUREMENT
/begin TYPEDEF_MEASUREMENT uint8_t_0x1 "" UBYTE NO_COMPU_METHOD 0 0 0 1 BIT_MASK 0x1 /end TYPEDEF_MEASUREMENT
/begin TYPEDEF_MEASUREMENT uint8_t_0x4 "" UBYTE NO_COMPU_METHOD 0 0 0 1 BIT_MASK 0x4 /end TYPEDEF_MEASUREMENT
/begin TYPEDEF_MEASUREMENT uint32_t_0x20 "" ULONG NO_COMPU_METHOD 0 0 0 1 BIT_MASK 0x20 /end TYPEDEF_MEASUREMENT
/begin TYPEDEF_MEASUREMENT UBaseType_t "" ULONG NO_COMPU_METHOD 0 0 0 4294967295 /end TYPEDEF_MEASUREMENT
/begin TYPEDEF_MEASUREMENT tVelocityIndicationType "" ULONG tVelocityIndicationType 0 0 0 1 /end TYPEDEF_MEASUREMENT
/begin TYPEDEF_MEASUREMENT tIEBDegState "" ULONG tIEBDegState 0 0 0 4 /end TYPEDEF_MEASUREMENT
/begin TYPEDEF_MEASUREMENT tPowerState "" ULONG tPowerState 0 0 0 15 /end TYPEDEF_MEASUREMENT
/begin TYPEDEF_MEASUREMENT tPerformanceModeTPMS "" ULONG tPerformanceModeTPMS 0 0 0 2 /end TYPEDEF_MEASUREMENT
/begin TYPEDEF_MEASUREMENT tLiftState "" ULONG tLiftState 0 0 0 6 /end TYPEDEF_MEASUREMENT
/begin TYPEDEF_MEASUREMENT uint16_t_0x400 "" UWORD NO_COMPU_METHOD 0 0 0 1 BIT_MASK 0x400 /end TYPEDEF_MEASUREMENT
/begin TYPEDEF_MEASUREMENT _float "" FLOAT32_IEEE NO_COMPU_METHOD 0 0 -3.40282346639E+38 3.40282346639E+38 /end TYPEDEF_MEASUREMENT
/begin TYPEDEF_MEASUREMENT tChangeModeEnableIEB "" ULONG tChangeModeEnableIEB 0 0 0 2 /end TYPEDEF_MEASUREMENT
/begin TYPEDEF_MEASUREMENT tWheelSpeedSensorStatus "" ULONG tWheelSpeedSensorStatus 0 0 0 6 /end TYPEDEF_MEASUREMENT
/begin TYPEDEF_MEASUREMENT tPaddleComb "" ULONG tPaddleComb 0 0 0 4 /end TYPEDEF_MEASUREMENT
/begin TYPEDEF_MEASUREMENT uint8_t "" UBYTE NO_COMPU_METHOD 0 0 0 255 /end TYPEDEF_MEASUREMENT
/begin TYPEDEF_MEASUREMENT tKilometrePerHour "" FLOAT32_IEEE tKilometrePerHour 0 0 -600 600 /end TYPEDEF_MEASUREMENT
/begin TYPEDEF_MEASUREMENT tCanDTimeoutIndex "" ULONG tCanDTimeoutIndex 0 0 0 8 /end TYPEDEF_MEASUREMENT
/begin TYPEDEF_MEASUREMENT tDiagnos_IEB "" ULONG tDiagnos_IEB 0 0 0 3 /end TYPEDEF_MEASUREMENT
/begin TYPEDEF_MEASUREMENT tRadian "" FLOAT32_IEEE tRadian 0 0 -20 20 /end TYPEDEF_MEASUREMENT
/begin TYPEDEF_MEASUREMENT tRegenMode "" ULONG tRegenMode 0 0 0 3 /end TYPEDEF_MEASUREMENT
/begin TYPEDEF_MEASUREMENT tCanETimeoutIndex "" ULONG tCanETimeoutIndex 0 0 0 1 /end TYPEDEF_MEASUREMENT
/begin TYPEDEF_MEASUREMENT tAutomatedDriverControlState "" ULONG tAutomatedDriverControlState 0 0 0 5 /end TYPEDEF_MEASUREMENT
/begin TYPEDEF_MEASUREMENT tBrakeActiveStatus "" ULONG tBrakeActiveStatus 0 0 0 5 /end TYPEDEF_MEASUREMENT
/begin TYPEDEF_MEASUREMENT tAmpere "" FLOAT32_IEEE tAmpere 0 0 0 10000 /end TYPEDEF_MEASUREMENT
/begin TYPEDEF_MEASUREMENT tCelsius "" FLOAT32_IEEE tCelsius 0 0 -400 10000 /end TYPEDEF_MEASUREMENT
/begin TYPEDEF_MEASUREMENT tNewtonMetre_100_S32 "" SLONG tNewtonMetre_100_S32 0 0 -100000.0 100000.0 /end TYPEDEF_MEASUREMENT
/begin TYPEDEF_MEASUREMENT tClutchState "" ULONG tClutchState 0 0 0 7 /end TYPEDEF_MEASUREMENT
/begin TYPEDEF_MEASUREMENT tSupportingMode "" ULONG tSupportingMode 0 0 0 6 /end TYPEDEF_MEASUREMENT
/begin TYPEDEF_MEASUREMENT tTpmsWhlMovgDetd "" ULONG tTpmsWhlMovgDetd 0 0 0 2 /end TYPEDEF_MEASUREMENT
/begin TYPEDEF_MEASUREMENT tFunctionStatus "" ULONG tFunctionStatus 0 0 0 3 /end TYPEDEF_MEASUREMENT
/begin TYPEDEF_MEASUREMENT uint16_t_0x1 "" UWORD NO_COMPU_METHOD 0 0 0 1 BIT_MASK 0x1 /end TYPEDEF_MEASUREMENT
/begin TYPEDEF_MEASUREMENT tPerformanceMode "" ULONG tPerformanceMode 0 0 0 7 /end TYPEDEF_MEASUREMENT
/begin TYPEDEF_MEASUREMENT tKilogram "" FLOAT32_IEEE tKilogram 0 0 0 10000 /end TYPEDEF_MEASUREMENT
/begin TYPEDEF_MEASUREMENT tLvBatteryStatus "" ULONG tLvBatteryStatus 0 0 0 3 /end TYPEDEF_MEASUREMENT
/begin TYPEDEF_MEASUREMENT tPressureReqRsn "" ULONG tPressureReqRsn 0 0 0 5 /end TYPEDEF_MEASUREMENT
/begin TYPEDEF_MEASUREMENT tBar_1000_S16 "" SWORD tBar_1000_S16 0 0 -0.1 100.0 /end TYPEDEF_MEASUREMENT
/begin TYPEDEF_MEASUREMENT tRevolutionPerMinute_S16 "" SWORD tRevolutionPerMinute_S16 0 0 -32768 32767 /end TYPEDEF_MEASUREMENT
/begin TYPEDEF_MEASUREMENT tAscii "" UBYTE tAscii 0 0 0 255 /end TYPEDEF_MEASUREMENT
/begin TYPEDEF_MEASUREMENT tAccActuatorResponse "" ULONG tAccActuatorResponse 0 0 0 5 /end TYPEDEF_MEASUREMENT
/begin TYPEDEF_MEASUREMENT uint8_t_0xC0 "" UBYTE NO_COMPU_METHOD 0 0 0 3 BIT_MASK 0xC0 /end TYPEDEF_MEASUREMENT
/begin TYPEDEF_MEASUREMENT tMetrePerSquareSecond "" FLOAT32_IEEE tMetrePerSquareSecond 0 0 -50 50 /end TYPEDEF_MEASUREMENT
/begin TYPEDEF_MEASUREMENT tDegreePerSecond "" FLOAT32_IEEE tDegreePerSecond 0 0 -50000 50000 /end TYPEDEF_MEASUREMENT
/begin TYPEDEF_MEASUREMENT uint16_t_0x10 "" UWORD NO_COMPU_METHOD 0 0 0 1 BIT_MASK 0x10 /end TYPEDEF_MEASUREMENT
/begin TYPEDEF_MEASUREMENT uint32_t_0x40 "" ULONG NO_COMPU_METHOD 0 0 0 1 BIT_MASK 0x40 /end TYPEDEF_MEASUREMENT
/begin TYPEDEF_MEASUREMENT tMarket "" ULONG tMarket 0 0 0 1 /end TYPEDEF_MEASUREMENT
/begin TYPEDEF_MEASUREMENT tKilowatt "" FLOAT32_IEEE tKilowatt 0 0 -10000 10000 /end TYPEDEF_MEASUREMENT
/begin TYPEDEF_MEASUREMENT uint32_t_0x2000 "" ULONG NO_COMPU_METHOD 0 0 0 1 BIT_MASK 0x2000 /end TYPEDEF_MEASUREMENT
/begin TYPEDEF_MEASUREMENT tMillisecond_U32 "" ULONG tMillisecond_U32 0 0 0 3600000 /end TYPEDEF_MEASUREMENT
/begin TYPEDEF_MEASUREMENT uint16_t_0x20 "" UWORD NO_COMPU_METHOD 0 0 0 1 BIT_MASK 0x20 /end TYPEDEF_MEASUREMENT
/begin TYPEDEF_MEASUREMENT tInvSpdCtrlGainSet "" ULONG tInvSpdCtrlGainSet 0 0 0 7 /end TYPEDEF_MEASUREMENT
/begin TYPEDEF_MEASUREMENT uint32_t_0x800 "" ULONG NO_COMPU_METHOD 0 0 0 1 BIT_MASK 0x800 /end TYPEDEF_MEASUREMENT
/begin TYPEDEF_MEASUREMENT tKilometrePerHour_10_S16 "" SWORD tKilometrePerHour_10_S16 0 0 -600.0 600.0 /end TYPEDEF_MEASUREMENT
/begin TYPEDEF_MEASUREMENT tAccTakeoverRequest "" ULONG tAccTakeoverRequest 0 0 0 2 /end TYPEDEF_MEASUREMENT
/begin TYPEDEF_MEASUREMENT uint16_t_0x200 "" UWORD NO_COMPU_METHOD 0 0 0 1 BIT_MASK 0x200 /end TYPEDEF_MEASUREMENT
/begin TYPEDEF_MEASUREMENT uint32_t_0x2 "" ULONG NO_COMPU_METHOD 0 0 0 1 BIT_MASK 0x2 /end TYPEDEF_MEASUREMENT
/begin TYPEDEF_MEASUREMENT tPercent_100_S16 "" SWORD tPercent_100_S16 0 0 0.0 100.0 /end TYPEDEF_MEASUREMENT
/begin TYPEDEF_MEASUREMENT uint32_t_0x200 "" ULONG NO_COMPU_METHOD 0 0 0 1 BIT_MASK 0x200 /end TYPEDEF_MEASUREMENT
/begin TYPEDEF_MEASUREMENT tFactor "" FLOAT32_IEEE tFactor 0 0 -3.40282346639E+38 3.40282346639E+38 /end TYPEDEF_MEASUREMENT
/begin TYPEDEF_MEASUREMENT tTireModel "" ULONG tTireModel 0 0 0 4 /end TYPEDEF_MEASUREMENT
/begin TYPEDEF_MEASUREMENT tMetre "" FLOAT32_IEEE tMetre 0 0 -1000 1000 /end TYPEDEF_MEASUREMENT
/begin TYPEDEF_MEASUREMENT tCelsius_10_S16 "" SWORD tCelsius_10_S16 0 0 -400.0 10000.0 /end TYPEDEF_MEASUREMENT
/begin TYPEDEF_MEASUREMENT uint32_t_0x100 "" ULONG NO_COMPU_METHOD 0 0 0 1 BIT_MASK 0x100 /end TYPEDEF_MEASUREMENT
/begin TYPEDEF_MEASUREMENT uint32_t_0xFFFFFFFC "" ULONG NO_COMPU_METHOD 0 0 0 1073741823 BIT_MASK 0xFFFFFFFC /end TYPEDEF_MEASUREMENT
/begin TYPEDEF_MEASUREMENT tCanBTimeoutIndex "" ULONG tCanBTimeoutIndex 0 0 0 12 /end TYPEDEF_MEASUREMENT
/begin TYPEDEF_MEASUREMENT tOccupancyStatus "" ULONG tOccupancyStatus 0 0 0 3 /end TYPEDEF_MEASUREMENT
/begin TYPEDEF_MEASUREMENT uint32_t_0x80 "" ULONG NO_COMPU_METHOD 0 0 0 1 BIT_MASK 0x80 /end TYPEDEF_MEASUREMENT
/begin TYPEDEF_MEASUREMENT tHapticFeedbackSteering "" ULONG tHapticFeedbackSteering 0 0 0 4 /end TYPEDEF_MEASUREMENT
/begin TYPEDEF_MEASUREMENT tEBrakeState "" ULONG tEBrakeState 0 0 0 5 /end TYPEDEF_MEASUREMENT
/begin TYPEDEF_MEASUREMENT tDriveMode "" ULONG tDriveMode 0 0 0 5 /end TYPEDEF_MEASUREMENT
/begin TYPEDEF_MEASUREMENT tAccFvcmSystemError "" ULONG tAccFvcmSystemError 0 0 0 3 /end TYPEDEF_MEASUREMENT
/begin TYPEDEF_MEASUREMENT uint32_t_0x1 "" ULONG NO_COMPU_METHOD 0 0 0 1 BIT_MASK 0x1 /end TYPEDEF_MEASUREMENT
/begin TYPEDEF_MEASUREMENT uint16_t_0x2 "" UWORD NO_COMPU_METHOD 0 0 0 1 BIT_MASK 0x2 /end TYPEDEF_MEASUREMENT
/begin TYPEDEF_MEASUREMENT tLiftBtnSt "" ULONG tLiftBtnSt 0 0 0 2 /end TYPEDEF_MEASUREMENT
/begin TYPEDEF_MEASUREMENT tAdasRequest "" ULONG tAdasRequest 0 0 0 2 /end TYPEDEF_MEASUREMENT
/begin TYPEDEF_MEASUREMENT tHex_U32 "" ULONG tHex_U32 0 0 0 4294967295 /end TYPEDEF_MEASUREMENT
/begin TYPEDEF_MEASUREMENT tNewton "" FLOAT32_IEEE tNewton 0 0 -100000 100000 /end TYPEDEF_MEASUREMENT
/begin TYPEDEF_MEASUREMENT TickType_t "" ULONG NO_COMPU_METHOD 0 0 0 4294967295 /end TYPEDEF_MEASUREMENT
/begin TYPEDEF_MEASUREMENT tBrakeLightRequest "" ULONG tBrakeLightRequest 0 0 0 3 /end TYPEDEF_MEASUREMENT
/begin TYPEDEF_MEASUREMENT tYawTorqueRequestMode "" ULONG tYawTorqueRequestMode 0 0 0 7 /end TYPEDEF_MEASUREMENT
/begin TYPEDEF_MEASUREMENT uint32_t_0x40000 "" ULONG NO_COMPU_METHOD 0 0 0 1 BIT_MASK 0x40000 /end TYPEDEF_MEASUREMENT
/begin TYPEDEF_MEASUREMENT uint32_t_0x80000 "" ULONG NO_COMPU_METHOD 0 0 0 1 BIT_MASK 0x80000 /end TYPEDEF_MEASUREMENT
/begin TYPEDEF_MEASUREMENT uint32_t_0x4 "" ULONG NO_COMPU_METHOD 0 0 0 1 BIT_MASK 0x4 /end TYPEDEF_MEASUREMENT
/begin TYPEDEF_MEASUREMENT uint32_t_0x1000 "" ULONG NO_COMPU_METHOD 0 0 0 1 BIT_MASK 0x1000 /end TYPEDEF_MEASUREMENT
/begin TYPEDEF_MEASUREMENT tAccStationaryRequest "" ULONG tAccStationaryRequest 0 0 0 2 /end TYPEDEF_MEASUREMENT
/begin TYPEDEF_MEASUREMENT tLaunchControlStMac "" ULONG tLaunchControlStMac 0 0 0 7 /end TYPEDEF_MEASUREMENT
/begin TYPEDEF_MEASUREMENT _Bool "" UBYTE NO_COMPU_METHOD 0 0 0 1 /end TYPEDEF_MEASUREMENT
/begin TYPEDEF_MEASUREMENT uint8_t_0x40 "" UBYTE NO_COMPU_METHOD 0 0 0 1 BIT_MASK 0x40 /end TYPEDEF_MEASUREMENT
/begin TYPEDEF_MEASUREMENT tPropshaftStationaryCrankState "" ULONG tPropshaftStationaryCrankState 0 0 0 5 /end TYPEDEF_MEASUREMENT
/begin TYPEDEF_MEASUREMENT tEngineRunning "" ULONG tEngineRunning 0 0 0 3 /end TYPEDEF_MEASUREMENT
/begin TYPEDEF_MEASUREMENT tMetrePerSecond "" FLOAT32_IEEE tMetrePerSecond 0 0 -200 200 /end TYPEDEF_MEASUREMENT
/begin TYPEDEF_MEASUREMENT tLiftIndication "" ULONG tLiftIndication 0 0 0 5 /end TYPEDEF_MEASUREMENT
/begin TYPEDEF_MEASUREMENT tSensorStatusAdv "" ULONG tSensorStatusAdv 0 0 0 4 /end TYPEDEF_MEASUREMENT
/begin TYPEDEF_MEASUREMENT tPerformanceStrategy "" ULONG tPerformanceStrategy 0 0 0 3 /end TYPEDEF_MEASUREMENT
/begin TYPEDEF_MEASUREMENT tDriveConfiguration "" ULONG tDriveConfiguration 0 0 0 3 /end TYPEDEF_MEASUREMENT
/begin TYPEDEF_MEASUREMENT tButtonState "" ULONG tButtonState 0 0 0 3 /end TYPEDEF_MEASUREMENT
/begin TYPEDEF_MEASUREMENT tRollingState "" ULONG tRollingState 0 0 0 4 /end TYPEDEF_MEASUREMENT
/begin TYPEDEF_MEASUREMENT uint32_t_0xFFE00000 "" ULONG NO_COMPU_METHOD 0 0 0 2047 BIT_MASK 0xFFE00000 /end TYPEDEF_MEASUREMENT
/begin TYPEDEF_MEASUREMENT tAutoShiftMode "" ULONG tAutoShiftMode 0 0 0 3 /end TYPEDEF_MEASUREMENT
/begin TYPEDEF_MEASUREMENT uint32_t_0x200000 "" ULONG NO_COMPU_METHOD 0 0 0 1 BIT_MASK 0x200000 /end TYPEDEF_MEASUREMENT
/begin TYPEDEF_MEASUREMENT tKilometre "" FLOAT32_IEEE tKilometre 0 0 0 2147483 /end TYPEDEF_MEASUREMENT
/begin TYPEDEF_MEASUREMENT tTpmsWarnLamp "" ULONG tTpmsWarnLamp 0 0 0 3 /end TYPEDEF_MEASUREMENT
/begin TYPEDEF_MEASUREMENT tTqMacSt "" ULONG tTqMacSt 0 0 0 20 /end TYPEDEF_MEASUREMENT
/begin TYPEDEF_MEASUREMENT tTelltale "" ULONG tTelltale 0 0 0 2 /end TYPEDEF_MEASUREMENT
/begin TYPEDEF_MEASUREMENT uint16_t "" UWORD NO_COMPU_METHOD 0 0 0 65535 /end TYPEDEF_MEASUREMENT
/begin TYPEDEF_MEASUREMENT tCluCtrlState "" ULONG tCluCtrlState 0 0 0 6 /end TYPEDEF_MEASUREMENT
/begin TYPEDEF_MEASUREMENT tRevolutionPerMinute "" FLOAT32_IEEE tRevolutionPerMinute 0 0 -10000 10000 /end TYPEDEF_MEASUREMENT
/begin TYPEDEF_MEASUREMENT tAxleSystemState "" ULONG tAxleSystemState 0 0 0 3 /end TYPEDEF_MEASUREMENT
/begin TYPEDEF_MEASUREMENT tPerformanceModeSwitchState "" ULONG tPerformanceModeSwitchState 0 0 0 2 /end TYPEDEF_MEASUREMENT
/begin TYPEDEF_MEASUREMENT uint32_t_0x20000 "" ULONG NO_COMPU_METHOD 0 0 0 1 BIT_MASK 0x20000 /end TYPEDEF_MEASUREMENT
/begin TYPEDEF_MEASUREMENT uint32_t_0x3 "" ULONG NO_COMPU_METHOD 0 0 0 3 BIT_MASK 0x3 /end TYPEDEF_MEASUREMENT
/begin TYPEDEF_MEASUREMENT uint16_t_0x100 "" UWORD NO_COMPU_METHOD 0 0 0 1 BIT_MASK 0x100 /end TYPEDEF_MEASUREMENT
/begin TYPEDEF_STRUCTURE TaskDynamicsDmr "" 0x2BC SYMBOL_TYPE_LINK "TaskDynamicsDmr" /begin STRUCTURE_COMPONENT stepSize tSecond 4 SYMBOL_TYPE_LINK "stepSize" /end STRUCTURE_COMPONENT
 /begin STRUCTURE_COMPONENT dmrLocals DriverModeReqLocals 8 SYMBOL_TYPE_LINK "dmrLocals" /end STRUCTURE_COMPONENT
/end TYPEDEF_STRUCTURE
/begin TYPEDEF_STRUCTURE TaskDiagManager100ms "" 0x4 SYMBOL_TYPE_LINK "TaskDiagManager100ms" /end TYPEDEF_STRUCTURE
/begin TYPEDEF_STRUCTURE DriverModeReqLocals "" 0x2B4 SYMBOL_TYPE_LINK "DriverModeReqLocals" /begin STRUCTURE_COMPONENT bAccrReld _Bool 0 SYMBOL_TYPE_LINK "bAccrReld" /end STRUCTURE_COMPONENT /begin STRUCTURE_COMPONENT bAnyPanelOpen _Bool 1 SYMBOL_TYPE_LINK "bAnyPanelOpen" /end STRUCTURE_COMPONENT /begin STRUCTURE_COMPONENT bAutoMod _Bool 2 SYMBOL_TYPE_LINK "bAutoMod" /end STRUCTURE_COMPONENT
 /begin STRUCTURE_COMPONENT bDrvrDoorOpening _Bool 3 SYMBOL_TYPE_LINK "bDrvrDoorOpening" /end STRUCTURE_COMPONENT
 /begin STRUCTURE_COMPONENT bEngRunngFallEdge _Bool 4 SYMBOL_TYPE_LINK "bEngRunngFallEdge" /end STRUCTURE_COMPONENT
 /begin STRUCTURE_COMPONENT bHoldIgnOnReq _Bool 5 SYMBOL_TYPE_LINK "bHoldIgnOnReq" /end STRUCTURE_COMPONENT
 /begin STRUCTURE_COMPONENT bIgnBtnRisngEdge _Bool 6 SYMBOL_TYPE_LINK "bIgnBtnRisngEdge" /end STRUCTURE_COMPONENT
 /begin STRUCTURE_COMPONENT bIgnStFallEdge _Bool 7 SYMBOL_TYPE_LINK "bIgnStFallEdge" /end STRUCTURE_COMPONENT
 /begin STRUCTURE_COMPONENT bIgnStRisngEdge _Bool 8 SYMBOL_TYPE_LINK "bIgnStRisngEdge" /end STRUCTURE_COMPONENT
 /begin STRUCTURE_COMPONENT bPwrStSleepFallEdge _Bool 9 SYMBOL_TYPE_LINK "bPwrStSleepFallEdge" /end STRUCTURE_COMPONENT
 /begin STRUCTURE_COMPONENT bPwrStSleepRisngEdge _Bool 10 SYMBOL_TYPE_LINK "bPwrStSleepRisngEdge" /end STRUCTURE_COMPONENT
 /begin STRUCTURE_COMPONENT bInitDone _Bool 11 SYMBOL_TYPE_LINK "bInitDone" /end STRUCTURE_COMPONENT
 /begin STRUCTURE_COMPONENT bManMod _Bool 12 SYMBOL_TYPE_LINK "bManMod" /end STRUCTURE_COMPONENT
 /begin STRUCTURE_COMPONENT bParkBtnRisngEdge _Bool 13 SYMBOL_TYPE_LINK "bParkBtnRisngEdge" /end STRUCTURE_COMPONENT
 /begin STRUCTURE_COMPONENT drvrDoorClsd _Bool 14 SYMBOL_TYPE_LINK "drvrDoorClsd" /end STRUCTURE_COMPONENT
 /begin STRUCTURE_COMPONENT drvrDoorClsdPrev _Bool 15 SYMBOL_TYPE_LINK "drvrDoorClsdPrev" /end STRUCTURE_COMPONENT
 /begin STRUCTURE_COMPONENT accBtnStruct BtnShoLongPsd 16 SYMBOL_TYPE_LINK "accBtnStruct" /end STRUCTURE_COMPONENT
 /begin STRUCTURE_COMPONENT accScrollBtnStruct BtnShoLongPsd 48 SYMBOL_TYPE_LINK "accScrollBtnStruct" /end STRUCTURE_COMPONENT
 /begin STRUCTURE_COMPONENT drvCfgReq tDriveConfiguration 80 SYMBOL_TYPE_LINK "drvCfgReq" /end STRUCTURE_COMPONENT
 /begin STRUCTURE_COMPONENT drvCfgReqInpMonr tDriveConfiguration 84 SYMBOL_TYPE_LINK "drvCfgReqInpMonr" /end STRUCTURE_COMPONENT
 /begin STRUCTURE_COMPONENT drvCfgSwt tDriveConfiguration 88 SYMBOL_TYPE_LINK "drvCfgSwt" /end STRUCTURE_COMPONENT
 /begin STRUCTURE_COMPONENT drvCfgSwtReqPrev tDriveConfiguration 92 SYMBOL_TYPE_LINK "drvCfgSwtReqPrev" /end STRUCTURE_COMPONENT
 /begin STRUCTURE_COMPONENT ignBtnStPrev tEnableState 96 SYMBOL_TYPE_LINK "ignBtnStPrev" /end STRUCTURE_COMPONENT
 /begin STRUCTURE_COMPONENT parkBtnStPrev tEnableState 100 SYMBOL_TYPE_LINK "parkBtnStPrev" /end STRUCTURE_COMPONENT
 /begin STRUCTURE_COMPONENT engRunngPrev tEngineRunning 104 SYMBOL_TYPE_LINK "engRunngPrev" /end STRUCTURE_COMPONENT
 /begin STRUCTURE_COMPONENT hndlgAttdModReqKnob tHandlingAttitudeMode 108 SYMBOL_TYPE_LINK "hndlgAttdModReqKnob" /end STRUCTURE_COMPONENT
 /begin STRUCTURE_COMPONENT liftBtn LiftBtn 112 SYMBOL_TYPE_LINK "liftBtn" /end STRUCTURE_COMPONENT
 /begin STRUCTURE_COMPONENT dmrRuntimeMsLocal tMillisecond_U32 124 SYMBOL_TYPE_LINK "dmrRuntimeMsLocal" /end STRUCTURE_COMPONENT
 /begin STRUCTURE_COMPONENT holdIgnitionTmr tMillisecond_U32 128 SYMBOL_TYPE_LINK "holdIgnitionTmr" /end STRUCTURE_COMPONENT
 /begin STRUCTURE_COMPONENT manualOverrideStamp tMillisecond_U32 132 SYMBOL_TYPE_LINK "manualOverrideStamp" /end STRUCTURE_COMPONENT
 /begin STRUCTURE_COMPONENT tsmDrvCfgMonrTmr tMillisecond_U32 136 SYMBOL_TYPE_LINK "tsmDrvCfgMonrTmr" /end STRUCTURE_COMPONENT
 /begin STRUCTURE_COMPONENT prkgBrkReq tParkingBrakeRequest 140 SYMBOL_TYPE_LINK "prkgBrkReq" /end STRUCTURE_COMPONENT
 /begin STRUCTURE_COMPONENT perfModCptFbLocalCtx PerfModCptCtx 144 SYMBOL_TYPE_LINK "perfModCptFbLocalCtx" /end STRUCTURE_COMPONENT
 /begin STRUCTURE_COMPONENT perfModSwtReqKnob tPerformanceMode 188 SYMBOL_TYPE_LINK "perfModSwtReqKnob" /end STRUCTURE_COMPONENT
 /begin STRUCTURE_COMPONENT steerWhlKnobPosnLePrev uint8_t 192 SYMBOL_TYPE_LINK "steerWhlKnobPosnLePrev" /end STRUCTURE_COMPONENT
 /begin STRUCTURE_COMPONENT steerWhlKnobPosnRiPrev uint8_t 193 SYMBOL_TYPE_LINK "steerWhlKnobPosnRiPrev" /end STRUCTURE_COMPONENT
 /begin STRUCTURE_COMPONENT pwrStPrev tPowerState 196 SYMBOL_TYPE_LINK "pwrStPrev" /end STRUCTURE_COMPONENT
 /begin STRUCTURE_COMPONENT suppgMod tSupportingMode 200 SYMBOL_TYPE_LINK "suppgMod" /end STRUCTURE_COMPONENT
 /begin STRUCTURE_COMPONENT tireMdl tTireModel 204 SYMBOL_TYPE_LINK "tireMdl" /end STRUCTURE_COMPONENT
 /begin STRUCTURE_COMPONENT dmrDrvModLocals DriveModeLocals 208 SYMBOL_TYPE_LINK "dmrDrvModLocals" /end STRUCTURE_COMPONENT
 /begin STRUCTURE_COMPONENT dmrAutoHillHoldLocals AutoHillHoldLocals 248 SYMBOL_TYPE_LINK "dmrAutoHillHoldLocals" /end STRUCTURE_COMPONENT
 /begin STRUCTURE_COMPONENT dmrPerfModLocals PerformanceModeLocals 384 SYMBOL_TYPE_LINK "dmrPerfModLocals" /end STRUCTURE_COMPONENT
 /begin STRUCTURE_COMPONENT dmrPrplModLocals PropulsionModeLocals 532 SYMBOL_TYPE_LINK "dmrPrplModLocals" /end STRUCTURE_COMPONENT
 /begin STRUCTURE_COMPONENT dmrLnchCtrlReqLocals LaunchControlReqLocals 568 SYMBOL_TYPE_LINK "dmrLnchCtrlReqLocals" /end STRUCTURE_COMPONENT
 /begin STRUCTURE_COMPONENT dmrBrkLiReqLocals BrkLiReqLocals 620 SYMBOL_TYPE_LINK "dmrBrkLiReqLocals" /end STRUCTURE_COMPONENT
 /begin STRUCTURE_COMPONENT dmrHndlgAttdModHdlLocals HndlgAttdModLocals 640 SYMBOL_TYPE_LINK "dmrHndlgAttdModHdlLocals" /end STRUCTURE_COMPONENT
/end TYPEDEF_STRUCTURE
/begin TYPEDEF_STRUCTURE AutoHillHoldLocals "" 0x88 SYMBOL_TYPE_LINK "AutoHillHoldLocals" /begin STRUCTURE_COMPONENT bAhhBrkPReqEna _Bool 0 SYMBOL_TYPE_LINK "bAhhBrkPReqEna" /end STRUCTURE_COMPONENT /begin STRUCTURE_COMPONENT bAhhPrkgBrkReq _Bool 1 SYMBOL_TYPE_LINK "bAhhPrkgBrkReq" /end STRUCTURE_COMPONENT
 /begin STRUCTURE_COMPONENT bFricBrkDistbnPrkgBrkReq _Bool 2 SYMBOL_TYPE_LINK "bFricBrkDistbnPrkgBrkReq" /end STRUCTURE_COMPONENT
 /begin STRUCTURE_COMPONENT bHhcIebInhbReq _Bool 3 SYMBOL_TYPE_LINK "bHhcIebInhbReq" /end STRUCTURE_COMPONENT
 /begin STRUCTURE_COMPONENT bInitDone _Bool 4 SYMBOL_TYPE_LINK "bInitDone" /end STRUCTURE_COMPONENT
 /begin STRUCTURE_COMPONENT bIsVehTakeoffDirOk _Bool 5 SYMBOL_TYPE_LINK "bIsVehTakeoffDirOk" /end STRUCTURE_COMPONENT
 /begin STRUCTURE_COMPONENT bWhlTarBrkPFrntOk _Bool 6 SYMBOL_TYPE_LINK "bWhlTarBrkPFrntOk" /end STRUCTURE_COMPONENT
 /begin STRUCTURE_COMPONENT bWhlTarBrkPReOk _Bool 7 SYMBOL_TYPE_LINK "bWhlTarBrkPReOk" /end STRUCTURE_COMPONENT
 /begin STRUCTURE_COMPONENT bWhlBrkCoeffFrntOk _Bool 8 SYMBOL_TYPE_LINK "bWhlBrkCoeffFrntOk" /end STRUCTURE_COMPONENT
 /begin STRUCTURE_COMPONENT bWhlBrkCoeffReOk _Bool 9 SYMBOL_TYPE_LINK "bWhlBrkCoeffReOk" /end STRUCTURE_COMPONENT
 /begin STRUCTURE_COMPONENT bWhlBrkTqFrntOk _Bool 10 SYMBOL_TYPE_LINK "bWhlBrkTqFrntOk" /end STRUCTURE_COMPONENT
 /begin STRUCTURE_COMPONENT bWhlBrkTqReOk _Bool 11 SYMBOL_TYPE_LINK "bWhlBrkTqReOk" /end STRUCTURE_COMPONENT
 /begin STRUCTURE_COMPONENT ahhDir tAutoHillHoldDirection 12 SYMBOL_TYPE_LINK "ahhDir" /end STRUCTURE_COMPONENT
 /begin STRUCTURE_COMPONENT ahhSt tAutoHillHoldState 16 SYMBOL_TYPE_LINK "ahhSt" /end STRUCTURE_COMPONENT
 /begin STRUCTURE_COMPONENT ahhStPrev tAutoHillHoldState 20 SYMBOL_TYPE_LINK "ahhStPrev" /end STRUCTURE_COMPONENT
 /begin STRUCTURE_COMPONENT ahhTarBrkPAdj tBar 24 SYMBOL_TYPE_LINK "ahhTarBrkPAdj" /end STRUCTURE_COMPONENT
 /begin STRUCTURE_COMPONENT ahhTarBrkPAdjRampd tBar 28 SYMBOL_TYPE_LINK "ahhTarBrkPAdjRampd" /end STRUCTURE_COMPONENT
 /begin STRUCTURE_COMPONENT ahhBrkPReq tBar_10_S16 32 MATRIX_DIM 4 SYMBOL_TYPE_LINK "ahhBrkPReq" /end STRUCTURE_COMPONENT
 /begin STRUCTURE_COMPONENT ahhTarBrkPMax tBar_10_S16 40 SYMBOL_TYPE_LINK "ahhTarBrkPMax" /end STRUCTURE_COMPONENT
 /begin STRUCTURE_COMPONENT ahhStSwtReqFb tEnableState 44 SYMBOL_TYPE_LINK "ahhStSwtReqFb" /end STRUCTURE_COMPONENT
 /begin STRUCTURE_COMPONENT ahhWhlTqBrkCoeffSum tFactor 48 SYMBOL_TYPE_LINK "ahhWhlTqBrkCoeffSum" /end STRUCTURE_COMPONENT
 /begin STRUCTURE_COMPONENT hhcStsPrev tHillHoldSts 52 SYMBOL_TYPE_LINK "hhcStsPrev" /end STRUCTURE_COMPONENT
 /begin STRUCTURE_COMPONENT vehVelAbsKph tKilometrePerHour_10_S16 56 SYMBOL_TYPE_LINK "vehVelAbsKph" /end STRUCTURE_COMPONENT
 /begin STRUCTURE_COMPONENT ahhPrkgBrkReqWaitPerd tMillisecond_U32 60 SYMBOL_TYPE_LINK "ahhPrkgBrkReqWaitPerd" /end STRUCTURE_COMPONENT
 /begin STRUCTURE_COMPONENT ahhBrkTqTakeoff tNewtonMetre 64 SYMBOL_TYPE_LINK "ahhBrkTqTakeoff" /end STRUCTURE_COMPONENT
 /begin STRUCTURE_COMPONENT ahhTotTarBrkTqAbs tNewtonMetre 68 SYMBOL_TYPE_LINK "ahhTotTarBrkTqAbs" /end STRUCTURE_COMPONENT
 /begin STRUCTURE_COMPONENT ahhTotStatyBrkAbsTq tNewtonMetre 72 SYMBOL_TYPE_LINK "ahhTotStatyBrkAbsTq" /end STRUCTURE_COMPONENT
 /begin STRUCTURE_COMPONENT ahhTarBrkWhlTq tNewtonMetre 76 MATRIX_DIM 4 SYMBOL_TYPE_LINK "ahhTarBrkWhlTq" /end STRUCTURE_COMPONENT
 /begin STRUCTURE_COMPONENT ahhWhlTqTakeOff tNewtonMetre 92 SYMBOL_TYPE_LINK "ahhWhlTqTakeOff" /end STRUCTURE_COMPONENT
 /begin STRUCTURE_COMPONENT drvgWhlTqTot tNewtonMetre 96 SYMBOL_TYPE_LINK "drvgWhlTqTot" /end STRUCTURE_COMPONENT
 /begin STRUCTURE_COMPONENT whlTqRoadGrad tNewtonMetre 100 SYMBOL_TYPE_LINK "whlTqRoadGrad" /end STRUCTURE_COMPONENT
 /begin STRUCTURE_COMPONENT drvrBrkPedlPercAtStop tPercent_100_S16 104 SYMBOL_TYPE_LINK "drvrBrkPedlPercAtStop" /end STRUCTURE_COMPONENT
 /begin STRUCTURE_COMPONENT ahhBrkPReqQ tQualifier 108 MATRIX_DIM 4 SYMBOL_TYPE_LINK "ahhBrkPReqQ" /end STRUCTURE_COMPONENT
 /begin STRUCTURE_COMPONENT ahhRampdTarBrkPStruct RampLimitCtx 124 SYMBOL_TYPE_LINK "ahhRampdTarBrkPStruct" /end STRUCTURE_COMPONENT
 /begin STRUCTURE_COMPONENT vehRollgStPrev tRollingState 132 SYMBOL_TYPE_LINK "vehRollgStPrev" /end STRUCTURE_COMPONENT
/end TYPEDEF_STRUCTURE
/begin TYPEDEF_STRUCTURE TaskDynamicsGateway "" 0x4 SYMBOL_TYPE_LINK "TaskDynamicsGateway" /end TYPEDEF_STRUCTURE
/begin TYPEDEF_STRUCTURE LiftBtn "" 0xC SYMBOL_TYPE_LINK "LiftBtn" /begin STRUCTURE_COMPONENT liftBtnSt tLiftBtnSt 0 SYMBOL_TYPE_LINK "liftBtnSt" /end STRUCTURE_COMPONENT /begin STRUCTURE_COMPONENT liftBtnPsdCnt uint8_t 4 SYMBOL_TYPE_LINK "liftBtnPsdCnt" /end STRUCTURE_COMPONENT
 /begin STRUCTURE_COMPONENT liftBtnTmr tMillisecond_U32 8 SYMBOL_TYPE_LINK "liftBtnTmr" /end STRUCTURE_COMPONENT
/end TYPEDEF_STRUCTURE
/begin TYPEDEF_STRUCTURE PropulsionModeLocals "" 0x24 SYMBOL_TYPE_LINK "PropulsionModeLocals" /begin STRUCTURE_COMPONENT bInitDone _Bool 0 SYMBOL_TYPE_LINK "bInitDone" /end STRUCTURE_COMPONENT
 /begin STRUCTURE_COMPONENT bTqStateCrkLtchd _Bool 1 SYMBOL_TYPE_LINK "bTqStateCrkLtchd" /end STRUCTURE_COMPONENT
 /begin STRUCTURE_COMPONENT bDrvrElecDrvDesired _Bool 2 SYMBOL_TYPE_LINK "bDrvrElecDrvDesired" /end STRUCTURE_COMPONENT
 /begin STRUCTURE_COMPONENT drvrReqPrplModTmr tMillisecond_U32 4 SYMBOL_TYPE_LINK "drvrReqPrplModTmr" /end STRUCTURE_COMPONENT
 /begin STRUCTURE_COMPONENT tqStateCrkLtchdTmr tMillisecond_U32 8 SYMBOL_TYPE_LINK "tqStateCrkLtchdTmr" /end STRUCTURE_COMPONENT
 /begin STRUCTURE_COMPONENT tsmPrplModMonrTmr tMillisecond_U32 12 SYMBOL_TYPE_LINK "tsmPrplModMonrTmr" /end STRUCTURE_COMPONENT
 /begin STRUCTURE_COMPONENT prplModInpMonr tPropulsionMode 16 SYMBOL_TYPE_LINK "prplModInpMonr" /end STRUCTURE_COMPONENT
 /begin STRUCTURE_COMPONENT prplModReq tPropulsionMode 20 SYMBOL_TYPE_LINK "prplModReq" /end STRUCTURE_COMPONENT
 /begin STRUCTURE_COMPONENT prplModSwt tPropulsionMode 24 SYMBOL_TYPE_LINK "prplModSwt" /end STRUCTURE_COMPONENT
 /begin STRUCTURE_COMPONENT prplModSwtReq tPropulsionMode 28 SYMBOL_TYPE_LINK "prplModSwtReq" /end STRUCTURE_COMPONENT
 /begin STRUCTURE_COMPONENT prplModSwtReqPrev tPropulsionMode 32 SYMBOL_TYPE_LINK "prplModSwtReqPrev" /end STRUCTURE_COMPONENT
/end TYPEDEF_STRUCTURE
/begin TYPEDEF_STRUCTURE HndlgAttdModLocals "" 0x34 SYMBOL_TYPE_LINK "HndlgAttdModLocals" /begin STRUCTURE_COMPONENT bInitDone _Bool 0 SYMBOL_TYPE_LINK "bInitDone" /end STRUCTURE_COMPONENT
 /begin STRUCTURE_COMPONENT vdcChgModEnaReq tChangeModeEnableIEB 4 SYMBOL_TYPE_LINK "vdcChgModEnaReq" /end STRUCTURE_COMPONENT
 /begin STRUCTURE_COMPONENT driftModSt tEnableState 8 SYMBOL_TYPE_LINK "driftModSt" /end STRUCTURE_COMPONENT
 /begin STRUCTURE_COMPONENT tireMdlFricCoeffEstimnEna tEnableState 12 SYMBOL_TYPE_LINK "tireMdlFricCoeffEstimnEna" /end STRUCTURE_COMPONENT
 /begin STRUCTURE_COMPONENT tireMdlTireMaxFRednFacEna tEnableState 16 SYMBOL_TYPE_LINK "tireMdlTireMaxFRednFacEna" /end STRUCTURE_COMPONENT
 /begin STRUCTURE_COMPONENT hndlgAttdMod tHandlingAttitudeMode 20 SYMBOL_TYPE_LINK "hndlgAttdMod" /end STRUCTURE_COMPONENT
 /begin STRUCTURE_COMPONENT hndlgAttdModPrev tHandlingAttitudeMode 24 SYMBOL_TYPE_LINK "hndlgAttdModPrev" /end STRUCTURE_COMPONENT
 /begin STRUCTURE_COMPONENT hndlgAttdModCfmd tHandlingAttitudeMode 28 SYMBOL_TYPE_LINK "hndlgAttdModCfmd" /end STRUCTURE_COMPONENT
 /begin STRUCTURE_COMPONENT hndlgAttdModReqKnob tHandlingAttitudeMode 32 SYMBOL_TYPE_LINK "hndlgAttdModReqKnob" /end STRUCTURE_COMPONENT
 /begin STRUCTURE_COMPONENT hndlgAttdModReqPndStTmr tMillisecond_U32 36 SYMBOL_TYPE_LINK "hndlgAttdModReqPndStTmr" /end STRUCTURE_COMPONENT
 /begin STRUCTURE_COMPONENT vdcPerfModReq tPerformanceModeVDC 40 SYMBOL_TYPE_LINK "vdcPerfModReq" /end STRUCTURE_COMPONENT
 /begin STRUCTURE_COMPONENT tracCtrlMod tTractionControlMode 44 SYMBOL_TYPE_LINK "tracCtrlMod" /end STRUCTURE_COMPONENT
 /begin STRUCTURE_COMPONENT yawTqReqMod tYawTorqueRequestMode 48 SYMBOL_TYPE_LINK "yawTqReqMod" /end STRUCTURE_COMPONENT
/end TYPEDEF_STRUCTURE
/begin TYPEDEF_STRUCTURE DriveModeLocals "" 0x28 SYMBOL_TYPE_LINK "DriveModeLocals"
 /begin STRUCTURE_COMPONENT allwdDrvModTran _Bool 0 MATRIX_DIM 5 SYMBOL_TYPE_LINK "allwdDrvModTran" /end STRUCTURE_COMPONENT
 /begin STRUCTURE_COMPONENT bInitDone _Bool 5 SYMBOL_TYPE_LINK "bInitDone" /end STRUCTURE_COMPONENT
 /begin STRUCTURE_COMPONENT bParkBtnReq _Bool 6 SYMBOL_TYPE_LINK "bParkBtnReq" /end STRUCTURE_COMPONENT
 /begin STRUCTURE_COMPONENT bTqMacThrowOutDrvMod _Bool 7 SYMBOL_TYPE_LINK "bTqMacThrowOutDrvMod" /end STRUCTURE_COMPONENT
 /begin STRUCTURE_COMPONENT drvMod tDriveMode 8 SYMBOL_TYPE_LINK "drvMod" /end STRUCTURE_COMPONENT
 /begin STRUCTURE_COMPONENT drvModReq tDriveMode 12 SYMBOL_TYPE_LINK "drvModReq" /end STRUCTURE_COMPONENT
 /begin STRUCTURE_COMPONENT paddleReq tDriveMode 16 SYMBOL_TYPE_LINK "paddleReq" /end STRUCTURE_COMPONENT
 /begin STRUCTURE_COMPONENT paddlePressStLnchReqTmr tMillisecond_U32 20 SYMBOL_TYPE_LINK "paddlePressStLnchReqTmr" /end STRUCTURE_COMPONENT
 /begin STRUCTURE_COMPONENT timestampParkPaddleReq tMillisecond_U32 24 SYMBOL_TYPE_LINK "timestampParkPaddleReq" /end STRUCTURE_COMPONENT
 /begin STRUCTURE_COMPONENT timestampPrkgBrkButtonCooldown tMillisecond_U32 28 SYMBOL_TYPE_LINK "timestampPrkgBrkButtonCooldown" /end STRUCTURE_COMPONENT
 /begin STRUCTURE_COMPONENT paddleCombPrev tPaddleComb 32 SYMBOL_TYPE_LINK "paddleCombPrev" /end STRUCTURE_COMPONENT
 /begin STRUCTURE_COMPONENT paddlePressSt tPaddlePressSt 36 SYMBOL_TYPE_LINK "paddlePressSt" /end STRUCTURE_COMPONENT
/end TYPEDEF_STRUCTURE
/begin TYPEDEF_STRUCTURE BtnShoLongPsd "" 0x20 SYMBOL_TYPE_LINK "BtnShoLongPsd" /begin STRUCTURE_COMPONENT btnSt tEnableState 0 SYMBOL_TYPE_LINK "btnSt" /end STRUCTURE_COMPONENT /begin STRUCTURE_COMPONENT bBtnUnavl _Bool 4 SYMBOL_TYPE_LINK "bBtnUnavl" /end STRUCTURE_COMPONENT /begin STRUCTURE_COMPONENT bBtnInhb _Bool 5 SYMBOL_TYPE_LINK "bBtnInhb" /end STRUCTURE_COMPONENT /begin STRUCTURE_COMPONENT bBtnDebdPsdDetd _Bool 6 SYMBOL_TYPE_LINK "bBtnDebdPsdDetd" /end STRUCTURE_COMPONENT /begin STRUCTURE_COMPONENT bBtnShoPsd _Bool 7 SYMBOL_TYPE_LINK "bBtnShoPsd" /end STRUCTURE_COMPONENT /begin STRUCTURE_COMPONENT bBtnLongPsd _Bool 8 SYMBOL_TYPE_LINK "bBtnLongPsd" /end STRUCTURE_COMPONENT /begin STRUCTURE_COMPONENT runtimeMs tMillisecond_U32 12 SYMBOL_TYPE_LINK "runtimeMs" /end STRUCTURE_COMPONENT /begin STRUCTURE_COMPONENT btnDebTmr tMillisecond_U32 16 SYMBOL_TYPE_LINK "btnDebTmr" /end STRUCTURE_COMPONENT
 /begin STRUCTURE_COMPONENT btnLongPsdTmr tMillisecond_U32 20 SYMBOL_TYPE_LINK "btnLongPsdTmr" /end STRUCTURE_COMPONENT
 /begin STRUCTURE_COMPONENT btnDebPerd tMillisecond_U32 24 SYMBOL_TYPE_LINK "btnDebPerd" /end STRUCTURE_COMPONENT
 /begin STRUCTURE_COMPONENT btnLongPsdPerd tMillisecond_U32 28 SYMBOL_TYPE_LINK "btnLongPsdPerd" /end STRUCTURE_COMPONENT
/end TYPEDEF_STRUCTURE
/begin TYPEDEF_STRUCTURE _unnamed_union_00 "" 0x4 SYMBOL_TYPE_LINK "_unnamed_union_00" /begin STRUCTURE_COMPONENT uxDummy2 UBaseType_t 0 SYMBOL_TYPE_LINK "uxDummy2" /end STRUCTURE_COMPONENT /end TYPEDEF_STRUCTURE
/begin TYPEDEF_STRUCTURE PerfModCptCtx "" 0x2C SYMBOL_TYPE_LINK "PerfModCptCtx"
 /begin STRUCTURE_COMPONENT autoShiftMod tAutoShiftMode 0 SYMBOL_TYPE_LINK "autoShiftMod" /end STRUCTURE_COMPONENT
 /begin STRUCTURE_COMPONENT launchCtrl tLaunchControlMode 4 SYMBOL_TYPE_LINK "launchCtrl" /end STRUCTURE_COMPONENT
 /begin STRUCTURE_COMPONENT pedlMap tPedalMapMode 8 SYMBOL_TYPE_LINK "pedlMap" /end STRUCTURE_COMPONENT
 /begin STRUCTURE_COMPONENT ddc tPerformanceModeDDC 12 SYMBOL_TYPE_LINK "ddc" /end STRUCTURE_COMPONENT
 /begin STRUCTURE_COMPONENT eps tPerformanceModeEPS 16 SYMBOL_TYPE_LINK "eps" /end STRUCTURE_COMPONENT
 /begin STRUCTURE_COMPONENT rhc tPerformanceModeRHC 20 SYMBOL_TYPE_LINK "rhc" /end STRUCTURE_COMPONENT
 /begin STRUCTURE_COMPONENT spdLim tPerformanceModeSpeedLimiter 24 SYMBOL_TYPE_LINK "spdLim" /end STRUCTURE_COMPONENT
 /begin STRUCTURE_COMPONENT tpms tPerformanceModeTPMS 28 SYMBOL_TYPE_LINK "tpms" /end STRUCTURE_COMPONENT
 /begin STRUCTURE_COMPONENT perfStgy tPerformanceStrategy 32 SYMBOL_TYPE_LINK "perfStgy" /end STRUCTURE_COMPONENT
 /begin STRUCTURE_COMPONENT prplMod tPropulsionMode 36 SYMBOL_TYPE_LINK "prplMod" /end STRUCTURE_COMPONENT
 /begin STRUCTURE_COMPONENT rgnMod tRegenMode 40 SYMBOL_TYPE_LINK "rgnMod" /end STRUCTURE_COMPONENT
/end TYPEDEF_STRUCTURE
/begin TYPEDEF_STRUCTURE LaunchControlReqLocals "" 0x34 SYMBOL_TYPE_LINK "LaunchControlReqLocals" /begin STRUCTURE_COMPONENT bInitDone _Bool 0 SYMBOL_TYPE_LINK "bInitDone" /end STRUCTURE_COMPONENT
 /begin STRUCTURE_COMPONENT bLcDrvrReqAbortd _Bool 1 SYMBOL_TYPE_LINK "bLcDrvrReqAbortd" /end STRUCTURE_COMPONENT
 /begin STRUCTURE_COMPONENT bLcDrvrReqPrsnt _Bool 2 SYMBOL_TYPE_LINK "bLcDrvrReqPrsnt" /end STRUCTURE_COMPONENT
 /begin STRUCTURE_COMPONENT bLcDrvrReqRejctd _Bool 3 SYMBOL_TYPE_LINK "bLcDrvrReqRejctd" /end STRUCTURE_COMPONENT
 /begin STRUCTURE_COMPONENT lcSts tLaunchControlMode 4 SYMBOL_TYPE_LINK "lcSts" /end STRUCTURE_COMPONENT
 /begin STRUCTURE_COMPONENT lcStMac tLaunchControlStMac 8 SYMBOL_TYPE_LINK "lcStMac" /end STRUCTURE_COMPONENT
 /begin STRUCTURE_COMPONENT lcStMacPrev tLaunchControlStMac 12 SYMBOL_TYPE_LINK "lcStMacPrev" /end STRUCTURE_COMPONENT
 /begin STRUCTURE_COMPONENT lcAbortRsnBitfie LaunchCtrlAbortRsnBitfield 16 SYMBOL_TYPE_LINK "lcAbortRsnBitfie" /end STRUCTURE_COMPONENT
 /begin STRUCTURE_COMPONENT lcReqAllwdBitfie LaunchCtrlReqAllwdBitfield 18 SYMBOL_TYPE_LINK "lcReqAllwdBitfie" /end STRUCTURE_COMPONENT
 /begin STRUCTURE_COMPONENT lcAbortTmr tMillisecond_U32 20 SYMBOL_TYPE_LINK "lcAbortTmr" /end STRUCTURE_COMPONENT
 /begin STRUCTURE_COMPONENT lcAbortUsrTmr tMillisecond_U32 24 SYMBOL_TYPE_LINK "lcAbortUsrTmr" /end STRUCTURE_COMPONENT
 /begin STRUCTURE_COMPONENT lcRetryTmr tMillisecond_U32 28 SYMBOL_TYPE_LINK "lcRetryTmr" /end STRUCTURE_COMPONENT
 /begin STRUCTURE_COMPONENT lcInfoMsgTmr tMillisecond_U32 32 SYMBOL_TYPE_LINK "lcInfoMsgTmr" /end STRUCTURE_COMPONENT
 /begin STRUCTURE_COMPONENT lcRegulateStTimeoutTmr tMillisecond_U32 36 SYMBOL_TYPE_LINK "lcRegulateStTimeoutTmr" /end STRUCTURE_COMPONENT
 /begin STRUCTURE_COMPONENT lcTakeoffStTimeoutTmr tMillisecond_U32 40 SYMBOL_TYPE_LINK "lcTakeoffStTimeoutTmr" /end STRUCTURE_COMPONENT
 /begin STRUCTURE_COMPONENT lcReqStTimeoutTmr tMillisecond_U32 44 SYMBOL_TYPE_LINK "lcReqStTimeoutTmr" /end STRUCTURE_COMPONENT
 /begin STRUCTURE_COMPONENT lcReqAllwdInfoMsg uint8_t 48 SYMBOL_TYPE_LINK "lcReqAllwdInfoMsg" /end STRUCTURE_COMPONENT
 /begin STRUCTURE_COMPONENT lcAbortRsnInfoMsg uint16_t 50 SYMBOL_TYPE_LINK "lcAbortRsnInfoMsg" /end STRUCTURE_COMPONENT
/end TYPEDEF_STRUCTURE
/begin TYPEDEF_STRUCTURE SharedDataObject "" 0x10D0 SYMBOL_TYPE_LINK "SharedDataObject" /begin STRUCTURE_COMPONENT adas AdasCtx 4 SYMBOL_TYPE_LINK "adas" /end STRUCTURE_COMPONENT /begin STRUCTURE_COMPONENT body BodyCtx 68 SYMBOL_TYPE_LINK "body" /end STRUCTURE_COMPONENT /begin STRUCTURE_COMPONENT brakes BrakesCtx 276 SYMBOL_TYPE_LINK "brakes" /end STRUCTURE_COMPONENT /begin STRUCTURE_COMPONENT dampers DamperCtx 556 SYMBOL_TYPE_LINK "dampers" /end STRUCTURE_COMPONENT /begin STRUCTURE_COMPONENT diag DiagCtx 672 SYMBOL_TYPE_LINK "diag" /end STRUCTURE_COMPONENT /begin STRUCTURE_COMPONENT driver DriverCtx 780 SYMBOL_TYPE_LINK "driver" /end STRUCTURE_COMPONENT /begin STRUCTURE_COMPONENT drivetrain DrivetrainCtx 896 SYMBOL_TYPE_LINK "drivetrain" /end STRUCTURE_COMPONENT
 /begin STRUCTURE_COMPONENT dynamicsDmr DynamicsDmrCtx 988 SYMBOL_TYPE_LINK "dynamicsDmr" /end STRUCTURE_COMPONENT
 /begin STRUCTURE_COMPONENT dynamicsDtr DynamicsDtrCtx 1156 SYMBOL_TYPE_LINK "dynamicsDtr" /end STRUCTURE_COMPONENT
 /begin STRUCTURE_COMPONENT dynamicsHomlnSfty DynamicsHomlnSftyCtx 1272 SYMBOL_TYPE_LINK "dynamicsHomlnSfty" /end STRUCTURE_COMPONENT
 /begin STRUCTURE_COMPONENT dynamicsRhc DynamicsRhcCtx 1320 SYMBOL_TYPE_LINK "dynamicsRhc" /end STRUCTURE_COMPONENT
 /begin STRUCTURE_COMPONENT dynamicsVso DynamicsVsoCtx 1412 SYMBOL_TYPE_LINK "dynamicsVso" /end STRUCTURE_COMPONENT
 /begin STRUCTURE_COMPONENT engine EngineCtx 2104 SYMBOL_TYPE_LINK "engine" /end STRUCTURE_COMPONENT
 /begin STRUCTURE_COMPONENT canComm CanCommCtx 2232 SYMBOL_TYPE_LINK "canComm" /end STRUCTURE_COMPONENT
 /begin STRUCTURE_COMPONENT hmi HmiCtx 3296 SYMBOL_TYPE_LINK "hmi" /end STRUCTURE_COMPONENT
 /begin STRUCTURE_COMPONENT hwio HwioCtx 3300 SYMBOL_TYPE_LINK "hwio" /end STRUCTURE_COMPONENT
 /begin STRUCTURE_COMPONENT hybrid HybridSharedData 3592 SYMBOL_TYPE_LINK "hybrid" /end STRUCTURE_COMPONENT
 /begin STRUCTURE_COMPONENT steering SteeringCtx 3692 SYMBOL_TYPE_LINK "steering" /end STRUCTURE_COMPONENT
 /begin STRUCTURE_COMPONENT thermal ThermalCtx 3752 SYMBOL_TYPE_LINK "thermal" /end STRUCTURE_COMPONENT
 /begin STRUCTURE_COMPONENT tpms TpmsSysInp 3788 SYMBOL_TYPE_LINK "tpms" /end STRUCTURE_COMPONENT
 /begin STRUCTURE_COMPONENT tqMgr TqMgrCtx 3848 SYMBOL_TYPE_LINK "tqMgr" /end STRUCTURE_COMPONENT
 /begin STRUCTURE_COMPONENT vdcModCtrl VdcModCtrlCtx 4060 SYMBOL_TYPE_LINK "vdcModCtrl" /end STRUCTURE_COMPONENT
 /begin STRUCTURE_COMPONENT tqStruct TqStructCtx 4072 SYMBOL_TYPE_LINK "tqStruct" /end STRUCTURE_COMPONENT
/end TYPEDEF_STRUCTURE
/begin TYPEDEF_STRUCTURE TaskDem "" 0x0 SYMBOL_TYPE_LINK "TaskDem" /end TYPEDEF_STRUCTURE
/begin TYPEDEF_STRUCTURE SteeringCtx "" 0x3C SYMBOL_TYPE_LINK "SteeringCtx" /begin STRUCTURE_COMPONENT eps EpsSteering 0 SYMBOL_TYPE_LINK "eps" /end STRUCTURE_COMPONENT /begin STRUCTURE_COMPONENT slipring AwasSteering 24 SYMBOL_TYPE_LINK "slipring" /end STRUCTURE_COMPONENT /begin STRUCTURE_COMPONENT steerAg tDegree 48 SYMBOL_TYPE_LINK "steerAg" /end STRUCTURE_COMPONENT
 /begin STRUCTURE_COMPONENT steerAgRate tDegreePerSecond 52 SYMBOL_TYPE_LINK "steerAgRate" /end STRUCTURE_COMPONENT
 /begin STRUCTURE_COMPONENT steerSnsrQ tQualifier 56 SYMBOL_TYPE_LINK "steerSnsrQ" /end STRUCTURE_COMPONENT
/end TYPEDEF_STRUCTURE
/begin TYPEDEF_STRUCTURE RampLimitCtx "" 0x8 SYMBOL_TYPE_LINK "RampLimitCtx" /begin STRUCTURE_COMPONENT Value _float 0 SYMBOL_TYPE_LINK "Value" /end STRUCTURE_COMPONENT /begin STRUCTURE_COMPONENT Gradient _float 4 SYMBOL_TYPE_LINK "Gradient" /end STRUCTURE_COMPONENT /end TYPEDEF_STRUCTURE
/begin TYPEDEF_STRUCTURE HybridSharedData "" 0x64 SYMBOL_TYPE_LINK "HybridSharedData" /begin STRUCTURE_COMPONENT bChrgSt _Bool 0 SYMBOL_TYPE_LINK "bChrgSt" /end STRUCTURE_COMPONENT /begin STRUCTURE_COMPONENT bEvForceCharge _Bool 1 SYMBOL_TYPE_LINK "bEvForceCharge" /end STRUCTURE_COMPONENT
 /begin STRUCTURE_COMPONENT elSysSt tElectricalSystemState 4 SYMBOL_TYPE_LINK "elSysSt" /end STRUCTURE_COMPONENT
 /begin STRUCTURE_COMPONENT invCtrlModeFeedback tInvCtrlMode 8 SYMBOL_TYPE_LINK "invCtrlModeFeedback" /end STRUCTURE_COMPONENT
 /begin STRUCTURE_COMPONENT elecMotTqEstimd tNewtonMetre 12 SYMBOL_TYPE_LINK "elecMotTqEstimd" /end STRUCTURE_COMPONENT
 /begin STRUCTURE_COMPONENT elecMotTqMax tNewtonMetre 16 SYMBOL_TYPE_LINK "elecMotTqMax" /end STRUCTURE_COMPONENT
 /begin STRUCTURE_COMPONENT elecMotTqMin tNewtonMetre 20 SYMBOL_TYPE_LINK "elecMotTqMin" /end STRUCTURE_COMPONENT
 /begin STRUCTURE_COMPONENT elecMotFocTqReqFb tNewtonMetre 24 SYMBOL_TYPE_LINK "elecMotFocTqReqFb" /end STRUCTURE_COMPONENT
 /begin STRUCTURE_COMPONENT hvBattSoC tPercent 28 SYMBOL_TYPE_LINK "hvBattSoC" /end STRUCTURE_COMPONENT
 /begin STRUCTURE_COMPONENT elecMotSpd tRevolutionPerMinute_S16 32 SYMBOL_TYPE_LINK "elecMotSpd" /end STRUCTURE_COMPONENT
 /begin STRUCTURE_COMPONENT elecMotSpdQ tQualifier 36 SYMBOL_TYPE_LINK "elecMotSpdQ" /end STRUCTURE_COMPONENT
 /begin STRUCTURE_COMPONENT elecMotTqDmdFromEgyMgr tNewtonMetre 40 SYMBOL_TYPE_LINK "elecMotTqDmdFromEgyMgr" /end STRUCTURE_COMPONENT
 /begin STRUCTURE_COMPONENT elecMotPwrDmd tKilowatt 44 SYMBOL_TYPE_LINK "elecMotPwrDmd" /end STRUCTURE_COMPONENT
 /begin STRUCTURE_COMPONENT bHybDecouplingReq _Bool 48 SYMBOL_TYPE_LINK "bHybDecouplingReq" /end STRUCTURE_COMPONENT
 /begin STRUCTURE_COMPONENT iceStartCmd tIceStartCmd 52 SYMBOL_TYPE_LINK "iceStartCmd" /end STRUCTURE_COMPONENT
 /begin STRUCTURE_COMPONENT chargePortStatus tChargePortStatus 56 SYMBOL_TYPE_LINK "chargePortStatus" /end STRUCTURE_COMPONENT
 /begin STRUCTURE_COMPONENT internal HybridInternalVars 60 SYMBOL_TYPE_LINK "internal" /end STRUCTURE_COMPONENT
/end TYPEDEF_STRUCTURE
/begin TYPEDEF_STRUCTURE BrkLiReqLocals "" 0x14 SYMBOL_TYPE_LINK "BrkLiReqLocals"
 /begin STRUCTURE_COMPONENT decelBrkLiReqMinHldTi tMillisecond_U32 0 SYMBOL_TYPE_LINK "decelBrkLiReqMinHldTi" /end STRUCTURE_COMPONENT
 /begin STRUCTURE_COMPONENT essBrkLiReq tEnableState 4 SYMBOL_TYPE_LINK "essBrkLiReq" /end STRUCTURE_COMPONENT
 /begin STRUCTURE_COMPONENT normBrkLiReq tEnableState 8 SYMBOL_TYPE_LINK "normBrkLiReq" /end STRUCTURE_COMPONENT
 /begin STRUCTURE_COMPONENT decelBrkLiReq tEnableState 12 SYMBOL_TYPE_LINK "decelBrkLiReq" /end STRUCTURE_COMPONENT
 /begin STRUCTURE_COMPONENT brkLiReq tBrakeLightRequest 16 SYMBOL_TYPE_LINK "brkLiReq" /end STRUCTURE_COMPONENT
/end TYPEDEF_STRUCTURE
/begin TYPEDEF_STRUCTURE xSTATIC_QUEUE "" 0x50 SYMBOL_TYPE_LINK "xSTATIC_QUEUE" /begin STRUCTURE_COMPONENT u _unnamed_union_00 12 SYMBOL_TYPE_LINK "u" /end STRUCTURE_COMPONENT
 /begin STRUCTURE_COMPONENT xDummy3 xSTATIC_LIST 16 MATRIX_DIM 2 SYMBOL_TYPE_LINK "xDummy3" /end STRUCTURE_COMPONENT
 /begin STRUCTURE_COMPONENT uxDummy4 UBaseType_t 56 MATRIX_DIM 3 SYMBOL_TYPE_LINK "uxDummy4" /end STRUCTURE_COMPONENT
 /begin STRUCTURE_COMPONENT ucDummy5 uint8_t 68 MATRIX_DIM 2 SYMBOL_TYPE_LINK "ucDummy5" /end STRUCTURE_COMPONENT
 /begin STRUCTURE_COMPONENT uxDummy8 UBaseType_t 72 SYMBOL_TYPE_LINK "uxDummy8" /end STRUCTURE_COMPONENT
 /begin STRUCTURE_COMPONENT ucDummy9 uint8_t 76 SYMBOL_TYPE_LINK "ucDummy9" /end STRUCTURE_COMPONENT
/end TYPEDEF_STRUCTURE
/begin TYPEDEF_STRUCTURE TpmsSysInp "" 0x3C SYMBOL_TYPE_LINK "TpmsSysInp"
 /begin STRUCTURE_COMPONENT tpmsTireP tBar_1000_S16 0 MATRIX_DIM 4 SYMBOL_TYPE_LINK "tpmsTireP" /end STRUCTURE_COMPONENT
 /begin STRUCTURE_COMPONENT tpmsTireT tDegree_10_S16 8 MATRIX_DIM 4 SYMBOL_TYPE_LINK "tpmsTireT" /end STRUCTURE_COMPONENT
 /begin STRUCTURE_COMPONENT tpmsRssi int8_t 16 MATRIX_DIM 4 SYMBOL_TYPE_LINK "tpmsRssi" /end STRUCTURE_COMPONENT
 /begin STRUCTURE_COMPONENT tpmsBattLvl uint8_t 20 MATRIX_DIM 4 SYMBOL_TYPE_LINK "tpmsBattLvl" /end STRUCTURE_COMPONENT
 /begin STRUCTURE_COMPONENT tpmsEcuFltBitfield TpmsEcuFltBitfield 24 MATRIX_DIM 4 SYMBOL_TYPE_LINK "tpmsEcuFltBitfield" /end STRUCTURE_COMPONENT
 /begin STRUCTURE_COMPONENT tpmsSnsrFltBitfield TpmsSnsrFltBitfield 28 MATRIX_DIM 4 SYMBOL_TYPE_LINK "tpmsSnsrFltBitfield" /end STRUCTURE_COMPONENT
 /begin STRUCTURE_COMPONENT vehMovgDetd tTpmsWhlMovgDetd 32 MATRIX_DIM 4 SYMBOL_TYPE_LINK "vehMovgDetd" /end STRUCTURE_COMPONENT
 /begin STRUCTURE_COMPONENT tpmsBattLvlLow _Bool 48 MATRIX_DIM 4 SYMBOL_TYPE_LINK "tpmsBattLvlLow" /end STRUCTURE_COMPONENT
 /begin STRUCTURE_COMPONENT tpmsTiout _Bool 52 MATRIX_DIM 4 SYMBOL_TYPE_LINK "tpmsTiout" /end STRUCTURE_COMPONENT
 /begin STRUCTURE_COMPONENT tpmsValV _Bool 56 MATRIX_DIM 4 SYMBOL_TYPE_LINK "tpmsValV" /end STRUCTURE_COMPONENT
/end TYPEDEF_STRUCTURE
/begin TYPEDEF_STRUCTURE PerformanceModeLocals "" 0x94 SYMBOL_TYPE_LINK "PerformanceModeLocals" /begin STRUCTURE_COMPONENT bInitDone _Bool 0 SYMBOL_TYPE_LINK "bInitDone" /end STRUCTURE_COMPONENT
 /begin STRUCTURE_COMPONENT bIsPerfModReqRejctd _Bool 1 SYMBOL_TYPE_LINK "bIsPerfModReqRejctd" /end STRUCTURE_COMPONENT
 /begin STRUCTURE_COMPONENT bPerfModReqPnd _Bool 2 SYMBOL_TYPE_LINK "bPerfModReqPnd" /end STRUCTURE_COMPONENT
 /begin STRUCTURE_COMPONENT runtimeLocal tMillisecond_U32 4 SYMBOL_TYPE_LINK "runtimeLocal" /end STRUCTURE_COMPONENT
 /begin STRUCTURE_COMPONENT perfModCptReqCtx PerfModCptCtx 8 SYMBOL_TYPE_LINK "perfModCptReqCtx" /end STRUCTURE_COMPONENT
 /begin STRUCTURE_COMPONENT perfModTmrCtx PerfModTmrCtx 52 SYMBOL_TYPE_LINK "perfModTmrCtx" /end STRUCTURE_COMPONENT
 /begin STRUCTURE_COMPONENT perfMod tPerformanceMode 84 SYMBOL_TYPE_LINK "perfMod" /end STRUCTURE_COMPONENT
 /begin STRUCTURE_COMPONENT perfModPrev tPerformanceMode 88 SYMBOL_TYPE_LINK "perfModPrev" /end STRUCTURE_COMPONENT
 /begin STRUCTURE_COMPONENT perfModRejctdBitfield PerfModCptRejctdRsnBitfield 92 SYMBOL_TYPE_LINK "perfModRejctdBitfield" /end STRUCTURE_COMPONENT
 /begin STRUCTURE_COMPONENT perfModReq tPerformanceMode 96 SYMBOL_TYPE_LINK "perfModReq" /end STRUCTURE_COMPONENT
 /begin STRUCTURE_COMPONENT perfModReqCfmd tPerformanceMode 100 SYMBOL_TYPE_LINK "perfModReqCfmd" /end STRUCTURE_COMPONENT
 /begin STRUCTURE_COMPONENT perfModReqPrev tPerformanceMode 104 SYMBOL_TYPE_LINK "perfModReqPrev" /end STRUCTURE_COMPONENT
 /begin STRUCTURE_COMPONENT perfModReqInhbRsn tPerformanceModeRequestInhibitReason 108 SYMBOL_TYPE_LINK "perfModReqInhbRsn" /end STRUCTURE_COMPONENT
 /begin STRUCTURE_COMPONENT perfModCptFbRhcPrev tPerformanceModeRHC 112 SYMBOL_TYPE_LINK "perfModCptFbRhcPrev" /end STRUCTURE_COMPONENT
 /begin STRUCTURE_COMPONENT perfModSt tPerformanceModeSwitchState 116 SYMBOL_TYPE_LINK "perfModSt" /end STRUCTURE_COMPONENT
 /begin STRUCTURE_COMPONENT perfModReqArr uint8_t 120 MATRIX_DIM 13 SYMBOL_TYPE_LINK "perfModReqArr" /end STRUCTURE_COMPONENT
 /begin STRUCTURE_COMPONENT perfModReqArrPrev uint8_t 133 MATRIX_DIM 13 SYMBOL_TYPE_LINK "perfModReqArrPrev" /end STRUCTURE_COMPONENT
/end TYPEDEF_STRUCTURE
/begin TYPEDEF_STRUCTURE DiagCtx "" 0x6C SYMBOL_TYPE_LINK "DiagCtx" /begin STRUCTURE_COMPONENT faults Fault 0 MATRIX_DIM 26 SYMBOL_TYPE_LINK "faults" /end STRUCTURE_COMPONENT /begin STRUCTURE_COMPONENT bAsfPrsnt _Bool 104 SYMBOL_TYPE_LINK "bAsfPrsnt" /end STRUCTURE_COMPONENT /end TYPEDEF_STRUCTURE
/begin TYPEDEF_STRUCTURE HwioCtx "" 0x124 SYMBOL_TYPE_LINK "HwioCtx" /begin STRUCTURE_COMPONENT bForceAdapSave _Bool 0 SYMBOL_TYPE_LINK "bForceAdapSave" /end STRUCTURE_COMPONENT
 /begin STRUCTURE_COMPONENT cluDitherAmpl tAmpere 4 MATRIX_DIM 4 SYMBOL_TYPE_LINK "cluDitherAmpl" /end STRUCTURE_COMPONENT
 /begin STRUCTURE_COMPONENT hiPSysP tBar_100_S16 20 MATRIX_DIM 4 SYMBOL_TYPE_LINK "hiPSysP" /end STRUCTURE_COMPONENT
 /begin STRUCTURE_COMPONENT whlCluPress tBar_100_S16 28 MATRIX_DIM 4 SYMBOL_TYPE_LINK "whlCluPress" /end STRUCTURE_COMPONENT
 /begin STRUCTURE_COMPONENT whlCluPressDelta1ms tBar_100_S16 36 MATRIX_DIM 4 SYMBOL_TYPE_LINK "whlCluPressDelta1ms" /end STRUCTURE_COMPONENT
 /begin STRUCTURE_COMPONENT brkFldLvl tBrakeFluidLevel 44 SYMBOL_TYPE_LINK "brkFldLvl" /end STRUCTURE_COMPONENT
 /begin STRUCTURE_COMPONENT cluOilT tCelsius 48 MATRIX_DIM 4 SYMBOL_TYPE_LINK "cluOilT" /end STRUCTURE_COMPONENT
 /begin STRUCTURE_COMPONENT hiPSysT tCelsius_10_S16 64 MATRIX_DIM 4 SYMBOL_TYPE_LINK "hiPSysT" /end STRUCTURE_COMPONENT
 /begin STRUCTURE_COMPONENT iceCooltRadrT tCelsius_10_S16 72 SYMBOL_TYPE_LINK "iceCooltRadrT" /end STRUCTURE_COMPONENT
 /begin STRUCTURE_COMPONENT vecTqFrntOilT tCelsius_10_S16 74 SYMBOL_TYPE_LINK "vecTqFrntOilT" /end STRUCTURE_COMPONENT
 /begin STRUCTURE_COMPONENT vecTqTRL tCelsius_10_S16 76 SYMBOL_TYPE_LINK "vecTqTRL" /end STRUCTURE_COMPONENT
 /begin STRUCTURE_COMPONENT vecTqTRR tCelsius_10_S16 78 SYMBOL_TYPE_LINK "vecTqTRR" /end STRUCTURE_COMPONENT
 /begin STRUCTURE_COMPONENT cluCtrlState tCluCtrlState 80 MATRIX_DIM 4 SYMBOL_TYPE_LINK "cluCtrlState" /end STRUCTURE_COMPONENT
 /begin STRUCTURE_COMPONENT epbSts tEBrakeState 96 SYMBOL_TYPE_LINK "epbSts" /end STRUCTURE_COMPONENT
 /begin STRUCTURE_COMPONENT drvrAccrPedlSts tEnableState 100 SYMBOL_TYPE_LINK "drvrAccrPedlSts" /end STRUCTURE_COMPONENT
 /begin STRUCTURE_COMPONENT cluDitherFreq tHertz 104 MATRIX_DIM 4 SYMBOL_TYPE_LINK "cluDitherFreq" /end STRUCTURE_COMPONENT
 /begin STRUCTURE_COMPONENT lvBatteryStatus tLvBatteryStatus 120 SYMBOL_TYPE_LINK "lvBatteryStatus" /end STRUCTURE_COMPONENT
 /begin STRUCTURE_COMPONENT cluCmd tPercent_100_S16 124 MATRIX_DIM 4 SYMBOL_TYPE_LINK "cluCmd" /end STRUCTURE_COMPONENT
 /begin STRUCTURE_COMPONENT drvrAccrPedlPerc tPercent_100_S32 132 SYMBOL_TYPE_LINK "drvrAccrPedlPerc" /end STRUCTURE_COMPONENT
 /begin STRUCTURE_COMPONENT drvrAccrPedlPercQ tQualifier 136 SYMBOL_TYPE_LINK "drvrAccrPedlPercQ" /end STRUCTURE_COMPONENT
 /begin STRUCTURE_COMPONENT propshFrntSpdQ tQualifier 140 SYMBOL_TYPE_LINK "propshFrntSpdQ" /end STRUCTURE_COMPONENT
 /begin STRUCTURE_COMPONENT propshRateQ tQualifier 144 SYMBOL_TYPE_LINK "propshRateQ" /end STRUCTURE_COMPONENT
 /begin STRUCTURE_COMPONENT propshRearSpdQ tQualifier 148 SYMBOL_TYPE_LINK "propshRearSpdQ" /end STRUCTURE_COMPONENT
 /begin STRUCTURE_COMPONENT vecTqTRLQ tQualifier 152 SYMBOL_TYPE_LINK "vecTqTRLQ" /end STRUCTURE_COMPONENT
 /begin STRUCTURE_COMPONENT vecTqTRRQ tQualifier 156 SYMBOL_TYPE_LINK "vecTqTRRQ" /end STRUCTURE_COMPONENT
 /begin STRUCTURE_COMPONENT whlCluRateInnerQ tQualifier 160 MATRIX_DIM 4 SYMBOL_TYPE_LINK "whlCluRateInnerQ" /end STRUCTURE_COMPONENT
 /begin STRUCTURE_COMPONENT whlCluRateOuterQ tQualifier 176 MATRIX_DIM 4 SYMBOL_TYPE_LINK "whlCluRateOuterQ" /end STRUCTURE_COMPONENT
 /begin STRUCTURE_COMPONENT whlRateQ tQualifier 192 MATRIX_DIM 4 SYMBOL_TYPE_LINK "whlRateQ" /end STRUCTURE_COMPONENT
 /begin STRUCTURE_COMPONENT propshRate tRadianPerSecond 208 SYMBOL_TYPE_LINK "propshRate" /end STRUCTURE_COMPONENT
 /begin STRUCTURE_COMPONENT whlCluRateInner tRadianPerSecond 212 MATRIX_DIM 4 SYMBOL_TYPE_LINK "whlCluRateInner" /end STRUCTURE_COMPONENT
 /begin STRUCTURE_COMPONENT whlCluRateOuter tRadianPerSecond 228 MATRIX_DIM 4 SYMBOL_TYPE_LINK "whlCluRateOuter" /end STRUCTURE_COMPONENT
 /begin STRUCTURE_COMPONENT whlRate tRadianPerSecond 244 MATRIX_DIM 4 SYMBOL_TYPE_LINK "whlRate" /end STRUCTURE_COMPONENT
 /begin STRUCTURE_COMPONENT propshFrntSpd tRevolutionPerMinute 260 SYMBOL_TYPE_LINK "propshFrntSpd" /end STRUCTURE_COMPONENT
 /begin STRUCTURE_COMPONENT propshRearSpd tRevolutionPerMinute 264 SYMBOL_TYPE_LINK "propshRearSpd" /end STRUCTURE_COMPONENT
 /begin STRUCTURE_COMPONENT whlRateDir tRollingState 268 MATRIX_DIM 4 SYMBOL_TYPE_LINK "whlRateDir" /end STRUCTURE_COMPONENT
 /begin STRUCTURE_COMPONENT whlCluRateOuterCnt uint8_t 284 MATRIX_DIM 4 SYMBOL_TYPE_LINK "whlCluRateOuterCnt" /end STRUCTURE_COMPONENT
 /begin STRUCTURE_COMPONENT kl30Voltage tVolt 288 SYMBOL_TYPE_LINK "kl30Voltage" /end STRUCTURE_COMPONENT
/end TYPEDEF_STRUCTURE
/begin TYPEDEF_STRUCTURE DynamicsDtrCtx "" 0x74 SYMBOL_TYPE_LINK "DynamicsDtrCtx"
 /begin STRUCTURE_COMPONENT brkSwtFusedSt tEnableState 0 SYMBOL_TYPE_LINK "brkSwtFusedSt" /end STRUCTURE_COMPONENT
 /begin STRUCTURE_COMPONENT bAccrReld _Bool 4 SYMBOL_TYPE_LINK "bAccrReld" /end STRUCTURE_COMPONENT
 /begin STRUCTURE_COMPONENT bDrvrAccrPedlPercBto _Bool 5 SYMBOL_TYPE_LINK "bDrvrAccrPedlPercBto" /end STRUCTURE_COMPONENT
 /begin STRUCTURE_COMPONENT bEmgyParkBrkEngd _Bool 6 SYMBOL_TYPE_LINK "bEmgyParkBrkEngd" /end STRUCTURE_COMPONENT
 /begin STRUCTURE_COMPONENT drvrGearReq tGear 8 SYMBOL_TYPE_LINK "drvrGearReq" /end STRUCTURE_COMPONENT
 /begin STRUCTURE_COMPONENT drvrWhlTqReqAccrNegRaw tNewtonMetre 12 SYMBOL_TYPE_LINK "drvrWhlTqReqAccrNegRaw" /end STRUCTURE_COMPONENT
 /begin STRUCTURE_COMPONENT drvrWhlTqReqFinal tNewtonMetre 16 SYMBOL_TYPE_LINK "drvrWhlTqReqFinal" /end STRUCTURE_COMPONENT
 /begin STRUCTURE_COMPONENT paddleComb tPaddleComb 20 SYMBOL_TYPE_LINK "paddleComb" /end STRUCTURE_COMPONENT
 /begin STRUCTURE_COMPONENT drvrWhlTqReqAccrNegRawQ tQualifier 24 SYMBOL_TYPE_LINK "drvrWhlTqReqAccrNegRawQ" /end STRUCTURE_COMPONENT
 /begin STRUCTURE_COMPONENT drvrWhlTqReqFinalQ tQualifier 28 SYMBOL_TYPE_LINK "drvrWhlTqReqFinalQ" /end STRUCTURE_COMPONENT
 /begin STRUCTURE_COMPONENT drvrRevIceSpdReq tRevolutionPerMinute_S16 32 SYMBOL_TYPE_LINK "drvrRevIceSpdReq" /end STRUCTURE_COMPONENT
 /begin STRUCTURE_COMPONENT shiftReq tShiftRequest 36 SYMBOL_TYPE_LINK "shiftReq" /end STRUCTURE_COMPONENT
 /begin STRUCTURE_COMPONENT adpvCrsCtrlActrResp tAccActuatorResponse 40 SYMBOL_TYPE_LINK "adpvCrsCtrlActrResp" /end STRUCTURE_COMPONENT
 /begin STRUCTURE_COMPONENT adpvCrsCtrlDistLvl tAccDistanceLevel 44 SYMBOL_TYPE_LINK "adpvCrsCtrlDistLvl" /end STRUCTURE_COMPONENT
 /begin STRUCTURE_COMPONENT adpvCrsCtrlSetVelOrDistLvl tAccSetVelOrDist 48 SYMBOL_TYPE_LINK "adpvCrsCtrlSetVelOrDistLvl" /end STRUCTURE_COMPONENT
 /begin STRUCTURE_COMPONENT adpvCrsCtrlSt tAdaptiveCruiseControlState 52 SYMBOL_TYPE_LINK "adpvCrsCtrlSt" /end STRUCTURE_COMPONENT
 /begin STRUCTURE_COMPONENT adpvCrsCtrlStFvcm tAdaptiveCruiseControlState 56 SYMBOL_TYPE_LINK "adpvCrsCtrlStFvcm" /end STRUCTURE_COMPONENT
 /begin STRUCTURE_COMPONENT adpvCrsCtrlDrvrTakeOffReq tAdasDriverTakeoffRequest 60 SYMBOL_TYPE_LINK "adpvCrsCtrlDrvrTakeOffReq" /end STRUCTURE_COMPONENT
 /begin STRUCTURE_COMPONENT adpvCrsCtrlDrvrTakeOverReq tAdasDriverTakeoverRequest 64 SYMBOL_TYPE_LINK "adpvCrsCtrlDrvrTakeOverReq" /end STRUCTURE_COMPONENT
 /begin STRUCTURE_COMPONENT brkJerqReq tAdasRequest 68 SYMBOL_TYPE_LINK "brkJerqReq" /end STRUCTURE_COMPONENT
 /begin STRUCTURE_COMPONENT brkPrefillReq tAdasRequest 72 SYMBOL_TYPE_LINK "brkPrefillReq" /end STRUCTURE_COMPONENT
 /begin STRUCTURE_COMPONENT adpvCrsCtrlSetVel tKilometrePerHour_10_S16 76 SYMBOL_TYPE_LINK "adpvCrsCtrlSetVel" /end STRUCTURE_COMPONENT
 /begin STRUCTURE_COMPONENT adpvCrsCtrlTarAccelCorrd tMetrePerSquareSecond 80 SYMBOL_TYPE_LINK "adpvCrsCtrlTarAccelCorrd" /end STRUCTURE_COMPONENT
 /begin STRUCTURE_COMPONENT adpvCrsCtrlSetVelQ tQualifier 84 SYMBOL_TYPE_LINK "adpvCrsCtrlSetVelQ" /end STRUCTURE_COMPONENT
 /begin STRUCTURE_COMPONENT adpvCrsCtrlTarAccelCorrdQ tQualifier 88 SYMBOL_TYPE_LINK "adpvCrsCtrlTarAccelCorrdQ" /end STRUCTURE_COMPONENT
 /begin STRUCTURE_COMPONENT adpvCrsCtrlFolStbyRsnMask uint16_t 92 SYMBOL_TYPE_LINK "adpvCrsCtrlFolStbyRsnMask" /end STRUCTURE_COMPONENT
 /begin STRUCTURE_COMPONENT adpvCrsCtrlOffRsnMask uint16_t 94 SYMBOL_TYPE_LINK "adpvCrsCtrlOffRsnMask" /end STRUCTURE_COMPONENT
 /begin STRUCTURE_COMPONENT adpvCrsCtrlVelStbyRsnMask uint16_t 96 SYMBOL_TYPE_LINK "adpvCrsCtrlVelStbyRsnMask" /end STRUCTURE_COMPONENT
 /begin STRUCTURE_COMPONENT autDrvrCtrlSt tAutomatedDriverControlState 100 SYMBOL_TYPE_LINK "autDrvrCtrlSt" /end STRUCTURE_COMPONENT
 /begin STRUCTURE_COMPONENT autDrvrCtrlDrvModReq tDriveMode 104 SYMBOL_TYPE_LINK "autDrvrCtrlDrvModReq" /end STRUCTURE_COMPONENT
 /begin STRUCTURE_COMPONENT autDrvrCtrlOffMask uint16_t 108 SYMBOL_TYPE_LINK "autDrvrCtrlOffMask" /end STRUCTURE_COMPONENT
 /begin STRUCTURE_COMPONENT spdLimVel tKilometrePerHour_10_S16 110 SYMBOL_TYPE_LINK "spdLimVel" /end STRUCTURE_COMPONENT
 /begin STRUCTURE_COMPONENT spdLimSt tSpeedLimiterState 112 SYMBOL_TYPE_LINK "spdLimSt" /end STRUCTURE_COMPONENT
/end TYPEDEF_STRUCTURE
/begin TYPEDEF_STRUCTURE DamperCtx "" 0x74 SYMBOL_TYPE_LINK "DamperCtx"
 /begin STRUCTURE_COMPONENT perfModDDC tPerformanceModeDDC 0 SYMBOL_TYPE_LINK "perfModDDC" /end STRUCTURE_COMPONENT
 /begin STRUCTURE_COMPONENT suspChassisVelPitch tRadianPerSecond 4 SYMBOL_TYPE_LINK "suspChassisVelPitch" /end STRUCTURE_COMPONENT
 /begin STRUCTURE_COMPONENT suspChassisVelRoll tRadianPerSecond 8 SYMBOL_TYPE_LINK "suspChassisVelRoll" /end STRUCTURE_COMPONENT
 /begin STRUCTURE_COMPONENT suspDamprCmpnCurr tAmpere 12 MATRIX_DIM 4 SYMBOL_TYPE_LINK "suspDamprCmpnCurr" /end STRUCTURE_COMPONENT
 /begin STRUCTURE_COMPONENT suspDamprRbdCurr tAmpere 28 MATRIX_DIM 4 SYMBOL_TYPE_LINK "suspDamprRbdCurr" /end STRUCTURE_COMPONENT
 /begin STRUCTURE_COMPONENT suspDamprVel tMetrePerSecond 44 MATRIX_DIM 4 SYMBOL_TYPE_LINK "suspDamprVel" /end STRUCTURE_COMPONENT
 /begin STRUCTURE_COMPONENT suspChassisVelQ tQualifier 60 SYMBOL_TYPE_LINK "suspChassisVelQ" /end STRUCTURE_COMPONENT
 /begin STRUCTURE_COMPONENT suspDamprCmpnCurrQ tQualifier 64 MATRIX_DIM 4 SYMBOL_TYPE_LINK "suspDamprCmpnCurrQ" /end STRUCTURE_COMPONENT
 /begin STRUCTURE_COMPONENT suspDamprRbdCurrQ tQualifier 80 MATRIX_DIM 4 SYMBOL_TYPE_LINK "suspDamprRbdCurrQ" /end STRUCTURE_COMPONENT
 /begin STRUCTURE_COMPONENT suspDamprVelQ tQualifier 96 MATRIX_DIM 4 SYMBOL_TYPE_LINK "suspDamprVelQ" /end STRUCTURE_COMPONENT
 /begin STRUCTURE_COMPONENT suspFltBitfield SuspFltBitfield 112 SYMBOL_TYPE_LINK "suspFltBitfield" /end STRUCTURE_COMPONENT
/end TYPEDEF_STRUCTURE
/begin TYPEDEF_STRUCTURE ImuData "" 0x20 SYMBOL_TYPE_LINK "ImuData"
 /begin STRUCTURE_COMPONENT accelVector tMetrePerSquareSecond 0 MATRIX_DIM 3 SYMBOL_TYPE_LINK "accelVector" /end STRUCTURE_COMPONENT
 /begin STRUCTURE_COMPONENT gyroVector tRadianPerSecond 12 MATRIX_DIM 3 SYMBOL_TYPE_LINK "gyroVector" /end STRUCTURE_COMPONENT
 /begin STRUCTURE_COMPONENT imuT tCelsius 24 SYMBOL_TYPE_LINK "imuT" /end STRUCTURE_COMPONENT
 /begin STRUCTURE_COMPONENT imuQualifier tQualifier 28 SYMBOL_TYPE_LINK "imuQualifier" /end STRUCTURE_COMPONENT
/end TYPEDEF_STRUCTURE
/begin TYPEDEF_STRUCTURE ThermalCtx "" 0x24 SYMBOL_TYPE_LINK "ThermalCtx" /begin STRUCTURE_COMPONENT motFanReq tPercent 0 SYMBOL_TYPE_LINK "motFanReq" /end STRUCTURE_COMPONENT /begin STRUCTURE_COMPONENT motPumpReq tPercent 4 SYMBOL_TYPE_LINK "motPumpReq" /end STRUCTURE_COMPONENT /begin STRUCTURE_COMPONENT invPumpReq tPercent 8 SYMBOL_TYPE_LINK "invPumpReq" /end STRUCTURE_COMPONENT /begin STRUCTURE_COMPONENT invFanReq tPercent 12 SYMBOL_TYPE_LINK "invFanReq" /end STRUCTURE_COMPONENT
 /begin STRUCTURE_COMPONENT veqTqLeFanReq tPercent_S8 16 SYMBOL_TYPE_LINK "veqTqLeFanReq" /end STRUCTURE_COMPONENT
 /begin STRUCTURE_COMPONENT veqTqRiFanReq tPercent_S8 17 SYMBOL_TYPE_LINK "veqTqRiFanReq" /end STRUCTURE_COMPONENT
 /begin STRUCTURE_COMPONENT powerConsumption48v tKilowatt 20 SYMBOL_TYPE_LINK "powerConsumption48v" /end STRUCTURE_COMPONENT
 /begin STRUCTURE_COMPONENT powerConsumption12v tKilowatt 24 SYMBOL_TYPE_LINK "powerConsumption12v" /end STRUCTURE_COMPONENT
 /begin STRUCTURE_COMPONENT hydraulicPump48VPower tKilowatt 28 SYMBOL_TYPE_LINK "hydraulicPump48VPower" /end STRUCTURE_COMPONENT
 /begin STRUCTURE_COMPONENT hybCoolFaultSetLimp _Bool 32 SYMBOL_TYPE_LINK "hybCoolFaultSetLimp" /end STRUCTURE_COMPONENT
/end TYPEDEF_STRUCTURE
/begin TYPEDEF_STRUCTURE VdcModCtrlCtx "" 0xC SYMBOL_TYPE_LINK "VdcModCtrlCtx" /begin STRUCTURE_COMPONENT absIntFlt _Bool 0 SYMBOL_TYPE_LINK "absIntFlt" /end STRUCTURE_COMPONENT /begin STRUCTURE_COMPONENT espIntFlt _Bool 1 SYMBOL_TYPE_LINK "espIntFlt" /end STRUCTURE_COMPONENT
 /begin STRUCTURE_COMPONENT vdcCghModReqEn tChangeModeEnableIEB 4 SYMBOL_TYPE_LINK "vdcCghModReqEn" /end STRUCTURE_COMPONENT
 /begin STRUCTURE_COMPONENT vdcCghModReq tPerformanceModeVDC 8 SYMBOL_TYPE_LINK "vdcCghModReq" /end STRUCTURE_COMPONENT
/end TYPEDEF_STRUCTURE
/begin TYPEDEF_STRUCTURE DrivetrainCtx "" 0x5C SYMBOL_TYPE_LINK "DrivetrainCtx"
 /begin STRUCTURE_COMPONENT whlCluTEstimd tCelsius_10_S16 0 MATRIX_DIM 4 SYMBOL_TYPE_LINK "whlCluTEstimd" /end STRUCTURE_COMPONENT
 /begin STRUCTURE_COMPONENT cenCluSt tClutchState 8 SYMBOL_TYPE_LINK "cenCluSt" /end STRUCTURE_COMPONENT
 /begin STRUCTURE_COMPONENT whlCluSt tClutchState 12 MATRIX_DIM 4 SYMBOL_TYPE_LINK "whlCluSt" /end STRUCTURE_COMPONENT
 /begin STRUCTURE_COMPONENT whlCluTqEstimd tNewtonMetre 28 MATRIX_DIM 4 SYMBOL_TYPE_LINK "whlCluTqEstimd" /end STRUCTURE_COMPONENT
 /begin STRUCTURE_COMPONENT whlCluTqEstimdAbslt tNewtonMetre 44 MATRIX_DIM 4 SYMBOL_TYPE_LINK "whlCluTqEstimdAbslt" /end STRUCTURE_COMPONENT
 /begin STRUCTURE_COMPONENT whlCluTqMaxAbs tNewtonMetre 60 MATRIX_DIM 4 SYMBOL_TYPE_LINK "whlCluTqMaxAbs" /end STRUCTURE_COMPONENT
 /begin STRUCTURE_COMPONENT whlCluTqEstimdAbsltQ tQualifier 76 MATRIX_DIM 4 SYMBOL_TYPE_LINK "whlCluTqEstimdAbsltQ" /end STRUCTURE_COMPONENT
/end TYPEDEF_STRUCTURE
/begin TYPEDEF_STRUCTURE LaunchCtrlAbortRsnBitfield "" 0x2 SYMBOL_TYPE_LINK "LaunchCtrlAbortRsnBitfield"
 /begin STRUCTURE_COMPONENT lnchCtrlAbortFlg LnchCtrlAbortFlg 0 SYMBOL_TYPE_LINK "lnchCtrlAbortFlg" /end STRUCTURE_COMPONENT
 /begin STRUCTURE_COMPONENT lnchCtrlAbortMask uint16_t 0 SYMBOL_TYPE_LINK "lnchCtrlAbortMask" /end STRUCTURE_COMPONENT
/end TYPEDEF_STRUCTURE
/begin TYPEDEF_STRUCTURE DriverCtx "" 0x74 SYMBOL_TYPE_LINK "DriverCtx" /begin STRUCTURE_COMPONENT liftBtnPsdHu _Bool 0 SYMBOL_TYPE_LINK "liftBtnPsdHu" /end STRUCTURE_COMPONENT
 /begin STRUCTURE_COMPONENT liftBtnPsdSteerWhl _Bool 1 SYMBOL_TYPE_LINK "liftBtnPsdSteerWhl" /end STRUCTURE_COMPONENT
 /begin STRUCTURE_COMPONENT adpvCrsCtrlDftDistLvl tAccDistanceLevel 4 SYMBOL_TYPE_LINK "adpvCrsCtrlDftDistLvl" /end STRUCTURE_COMPONENT
 /begin STRUCTURE_COMPONENT perfModSwtReqAutoShift tAutoShiftMode 8 SYMBOL_TYPE_LINK "perfModSwtReqAutoShift" /end STRUCTURE_COMPONENT
 /begin STRUCTURE_COMPONENT adpvCrsCtrlBtnSt tButtonState 12 SYMBOL_TYPE_LINK "adpvCrsCtrlBtnSt" /end STRUCTURE_COMPONENT
 /begin STRUCTURE_COMPONENT adpvCrsCtrlScrollBtnSt tButtonState 16 SYMBOL_TYPE_LINK "adpvCrsCtrlScrollBtnSt" /end STRUCTURE_COMPONENT
 /begin STRUCTURE_COMPONENT paddleShiftDwnSt tButtonState 20 SYMBOL_TYPE_LINK "paddleShiftDwnSt" /end STRUCTURE_COMPONENT
 /begin STRUCTURE_COMPONENT paddleShiftUpSt tButtonState 24 SYMBOL_TYPE_LINK "paddleShiftUpSt" /end STRUCTURE_COMPONENT
 /begin STRUCTURE_COMPONENT drvCfgSwtReq tDriveConfiguration 28 SYMBOL_TYPE_LINK "drvCfgSwtReq" /end STRUCTURE_COMPONENT
 /begin STRUCTURE_COMPONENT drvModSwtReq tDriveMode 32 SYMBOL_TYPE_LINK "drvModSwtReq" /end STRUCTURE_COMPONENT
 /begin STRUCTURE_COMPONENT adpvCrsCtrlActvDftToFolCtrlBtnSt tEnableState 36 SYMBOL_TYPE_LINK "adpvCrsCtrlActvDftToFolCtrlBtnSt" /end STRUCTURE_COMPONENT
 /begin STRUCTURE_COMPONENT autoHoldStSwtReq tEnableState 40 SYMBOL_TYPE_LINK "autoHoldStSwtReq" /end STRUCTURE_COMPONENT
 /begin STRUCTURE_COMPONENT autoUpshBtnSt tEnableState 44 SYMBOL_TYPE_LINK "autoUpshBtnSt" /end STRUCTURE_COMPONENT
 /begin STRUCTURE_COMPONENT brkLiSwtSt tEnableState 48 SYMBOL_TYPE_LINK "brkLiSwtSt" /end STRUCTURE_COMPONENT
 /begin STRUCTURE_COMPONENT forcedChrgBtnSt tEnableState 52 SYMBOL_TYPE_LINK "forcedChrgBtnSt" /end STRUCTURE_COMPONENT
 /begin STRUCTURE_COMPONENT ignBtnSt tEnableState 56 SYMBOL_TYPE_LINK "ignBtnSt" /end STRUCTURE_COMPONENT
 /begin STRUCTURE_COMPONENT lnchCtrlBtnSt tEnableState 60 SYMBOL_TYPE_LINK "lnchCtrlBtnSt" /end STRUCTURE_COMPONENT
 /begin STRUCTURE_COMPONENT manModBtnSt tEnableState 64 SYMBOL_TYPE_LINK "manModBtnSt" /end STRUCTURE_COMPONENT
 /begin STRUCTURE_COMPONENT parkBtnSt tEnableState 68 SYMBOL_TYPE_LINK "parkBtnSt" /end STRUCTURE_COMPONENT
 /begin STRUCTURE_COMPONENT perfModSwtReqPedlMap tPedalMapMode 72 SYMBOL_TYPE_LINK "perfModSwtReqPedlMap" /end STRUCTURE_COMPONENT
 /begin STRUCTURE_COMPONENT perfModSwtReqHu tPerformanceMode 76 SYMBOL_TYPE_LINK "perfModSwtReqHu" /end STRUCTURE_COMPONENT
 /begin STRUCTURE_COMPONENT perfModSwtReqDDC tPerformanceModeDDC 80 SYMBOL_TYPE_LINK "perfModSwtReqDDC" /end STRUCTURE_COMPONENT
 /begin STRUCTURE_COMPONENT perfModSwtReqEPS tPerformanceModeEPS 84 SYMBOL_TYPE_LINK "perfModSwtReqEPS" /end STRUCTURE_COMPONENT
 /begin STRUCTURE_COMPONENT perfModSwtReqRHC tPerformanceModeRHC 88 SYMBOL_TYPE_LINK "perfModSwtReqRHC" /end STRUCTURE_COMPONENT
 /begin STRUCTURE_COMPONENT perfStgySwtReq tPerformanceStrategy 92 SYMBOL_TYPE_LINK "perfStgySwtReq" /end STRUCTURE_COMPONENT
 /begin STRUCTURE_COMPONENT adpvCrsCtrlScrollBtnPosnQ tQualifier 96 SYMBOL_TYPE_LINK "adpvCrsCtrlScrollBtnPosnQ" /end STRUCTURE_COMPONENT
 /begin STRUCTURE_COMPONENT perfModSwtReqRgn tRegenMode 100 SYMBOL_TYPE_LINK "perfModSwtReqRgn" /end STRUCTURE_COMPONENT
 /begin STRUCTURE_COMPONENT suppgModReq tSupportingMode 104 SYMBOL_TYPE_LINK "suppgModReq" /end STRUCTURE_COMPONENT
 /begin STRUCTURE_COMPONENT tireMdlReq tTireModel 108 SYMBOL_TYPE_LINK "tireMdlReq" /end STRUCTURE_COMPONENT
 /begin STRUCTURE_COMPONENT adpvCrsCtrlScrollBtnPosn uint8_t 112 SYMBOL_TYPE_LINK "adpvCrsCtrlScrollBtnPosn" /end STRUCTURE_COMPONENT
 /begin STRUCTURE_COMPONENT steerWhlKnobPosnLe uint8_t 113 SYMBOL_TYPE_LINK "steerWhlKnobPosnLe" /end STRUCTURE_COMPONENT
 /begin STRUCTURE_COMPONENT steerWhlKnobPosnRi uint8_t 114 SYMBOL_TYPE_LINK "steerWhlKnobPosnRi" /end STRUCTURE_COMPONENT
/end TYPEDEF_STRUCTURE
/begin TYPEDEF_STRUCTURE TireMdlPacejkaParam "" 0x54 SYMBOL_TYPE_LINK "TireMdlPacejkaParam" /begin STRUCTURE_COMPONENT tireMdl tTireModel 0 SYMBOL_TYPE_LINK "tireMdl" /end STRUCTURE_COMPONENT /begin STRUCTURE_COMPONENT B tFactor 4 MATRIX_DIM 2 SYMBOL_TYPE_LINK "B" /end STRUCTURE_COMPONENT /begin STRUCTURE_COMPONENT C tFactor 12 MATRIX_DIM 2 SYMBOL_TYPE_LINK "C" /end STRUCTURE_COMPONENT /begin STRUCTURE_COMPONENT D tFactor 20 MATRIX_DIM 2 SYMBOL_TYPE_LINK "D" /end STRUCTURE_COMPONENT /begin STRUCTURE_COMPONENT E tFactor 28 MATRIX_DIM 2 SYMBOL_TYPE_LINK "E" /end STRUCTURE_COMPONENT /begin STRUCTURE_COMPONENT slipFac tFactor 36 MATRIX_DIM 2 SYMBOL_TYPE_LINK "slipFac" /end STRUCTURE_COMPONENT
 /begin STRUCTURE_COMPONENT slipPeakPosn tFactor 44 MATRIX_DIM 2 SYMBOL_TYPE_LINK "slipPeakPosn" /end STRUCTURE_COMPONENT
 /begin STRUCTURE_COMPONENT slipPeakVal tNewton 52 MATRIX_DIM 2 SYMBOL_TYPE_LINK "slipPeakVal" /end STRUCTURE_COMPONENT
 /begin STRUCTURE_COMPONENT Fz tNewton 60 SYMBOL_TYPE_LINK "Fz" /end STRUCTURE_COMPONENT
 /begin STRUCTURE_COMPONENT Fz0 tNewton 64 SYMBOL_TYPE_LINK "Fz0" /end STRUCTURE_COMPONENT
 /begin STRUCTURE_COMPONENT mu tFactor 68 MATRIX_DIM 2 SYMBOL_TYPE_LINK "mu" /end STRUCTURE_COMPONENT
 /begin STRUCTURE_COMPONENT p tBar 76 SYMBOL_TYPE_LINK "p" /end STRUCTURE_COMPONENT
 /begin STRUCTURE_COMPONENT p0 tBar 80 SYMBOL_TYPE_LINK "p0" /end STRUCTURE_COMPONENT
/end TYPEDEF_STRUCTURE
/begin TYPEDEF_STRUCTURE CanCommCtx "" 0x428 SYMBOL_TYPE_LINK "CanCommCtx"
 /begin STRUCTURE_COMPONENT canAMsgTimeoutCtxArr CanAMsgTimeoutCtx 0 MATRIX_DIM 44 SYMBOL_TYPE_LINK "canAMsgTimeoutCtxArr" /end STRUCTURE_COMPONENT
 /begin STRUCTURE_COMPONENT canBMsgTimeoutCtxArr CanBMsgTimeoutCtx 352 MATRIX_DIM 12 SYMBOL_TYPE_LINK "canBMsgTimeoutCtxArr" /end STRUCTURE_COMPONENT
 /begin STRUCTURE_COMPONENT canCMsgTimeoutCtxArr CanCMsgTimeoutCtx 448 MATRIX_DIM 12 SYMBOL_TYPE_LINK "canCMsgTimeoutCtxArr" /end STRUCTURE_COMPONENT
 /begin STRUCTURE_COMPONENT canDMsgTimeoutCtxArr CanDMsgTimeoutCtx 544 MATRIX_DIM 8 SYMBOL_TYPE_LINK "canDMsgTimeoutCtxArr" /end STRUCTURE_COMPONENT
 /begin STRUCTURE_COMPONENT canEMsgTimeoutCtxArr CanEMsgTimeoutCtx 608 MATRIX_DIM 1 SYMBOL_TYPE_LINK "canEMsgTimeoutCtxArr" /end STRUCTURE_COMPONENT
 /begin STRUCTURE_COMPONENT canFMsgTimeoutCtxArr CanFMsgTimeoutCtx 616 MATRIX_DIM 36 SYMBOL_TYPE_LINK "canFMsgTimeoutCtxArr" /end STRUCTURE_COMPONENT
 /begin STRUCTURE_COMPONENT bCanNodeTimeoutArr _Bool 904 MATRIX_DIM 22 SYMBOL_TYPE_LINK "bCanNodeTimeoutArr" /end STRUCTURE_COMPONENT
 /begin STRUCTURE_COMPONENT canNodeTimeoutHealTmrArr tMillisecond_U32 928 MATRIX_DIM 22 SYMBOL_TYPE_LINK "canNodeTimeoutHealTmrArr" /end STRUCTURE_COMPONENT
 /begin STRUCTURE_COMPONENT nodeTimeoutCnt uint16_t 1016 MATRIX_DIM 22 SYMBOL_TYPE_LINK "nodeTimeoutCnt" /end STRUCTURE_COMPONENT
 /begin STRUCTURE_COMPONENT canNodeTimeoutBitfield CanNodeTimeoutBitfield 1060 SYMBOL_TYPE_LINK "canNodeTimeoutBitfield" /end STRUCTURE_COMPONENT
/end TYPEDEF_STRUCTURE
/begin TYPEDEF_STRUCTURE HmiCtx "" 0x4 SYMBOL_TYPE_LINK "HmiCtx" /begin STRUCTURE_COMPONENT combdPwr tKilowatt 0 SYMBOL_TYPE_LINK "combdPwr" /end STRUCTURE_COMPONENT /end TYPEDEF_STRUCTURE
/begin TYPEDEF_STRUCTURE EpsSteering "" 0x18 SYMBOL_TYPE_LINK "EpsSteering" /begin STRUCTURE_COMPONENT steerAg tDegree 0 SYMBOL_TYPE_LINK "steerAg" /end STRUCTURE_COMPONENT
 /begin STRUCTURE_COMPONENT steerAgRate tDegreePerSecond 4 SYMBOL_TYPE_LINK "steerAgRate" /end STRUCTURE_COMPONENT
 /begin STRUCTURE_COMPONENT perfModEPS tPerformanceModeEPS 8 SYMBOL_TYPE_LINK "perfModEPS" /end STRUCTURE_COMPONENT
 /begin STRUCTURE_COMPONENT steerSnsrQ tQualifier 12 SYMBOL_TYPE_LINK "steerSnsrQ" /end STRUCTURE_COMPONENT
 /begin STRUCTURE_COMPONENT steerCalSts tSensorCalibration 16 SYMBOL_TYPE_LINK "steerCalSts" /end STRUCTURE_COMPONENT
 /begin STRUCTURE_COMPONENT steerSysSts tSteeringSystemStatus 20 SYMBOL_TYPE_LINK "steerSysSts" /end STRUCTURE_COMPONENT
/end TYPEDEF_STRUCTURE
/begin TYPEDEF_STRUCTURE BrakesCtx "" 0x118 SYMBOL_TYPE_LINK "BrakesCtx" /begin STRUCTURE_COMPONENT absSts tAbsStatus 0 SYMBOL_TYPE_LINK "absSts" /end STRUCTURE_COMPONENT /begin STRUCTURE_COMPONENT boosterBrkP tBar 4 SYMBOL_TYPE_LINK "boosterBrkP" /end STRUCTURE_COMPONENT /begin STRUCTURE_COMPONENT drvrBrkPReq tBar 8 SYMBOL_TYPE_LINK "drvrBrkPReq" /end STRUCTURE_COMPONENT /begin STRUCTURE_COMPONENT mstCylP tBar 12 SYMBOL_TYPE_LINK "mstCylP" /end STRUCTURE_COMPONENT
 /begin STRUCTURE_COMPONENT whlTarBrkP tBar 16 MATRIX_DIM 4 SYMBOL_TYPE_LINK "whlTarBrkP" /end STRUCTURE_COMPONENT
 /begin STRUCTURE_COMPONENT brkActvSts tBrakeActiveStatus 32 SYMBOL_TYPE_LINK "brkActvSts" /end STRUCTURE_COMPONENT
 /begin STRUCTURE_COMPONENT chgModEnaIEB tChangeModeEnableIEB 36 SYMBOL_TYPE_LINK "chgModEnaIEB" /end STRUCTURE_COMPONENT
 /begin STRUCTURE_COMPONENT diagCom tDiagnos_IEB 40 SYMBOL_TYPE_LINK "diagCom" /end STRUCTURE_COMPONENT
 /begin STRUCTURE_COMPONENT diagP tDiagnos_IEB 44 SYMBOL_TYPE_LINK "diagP" /end STRUCTURE_COMPONENT
 /begin STRUCTURE_COMPONENT diagSelf tDiagnos_IEB 48 SYMBOL_TYPE_LINK "diagSelf" /end STRUCTURE_COMPONENT
 /begin STRUCTURE_COMPONENT diagT tDiagnos_IEB 52 SYMBOL_TYPE_LINK "diagT" /end STRUCTURE_COMPONENT
 /begin STRUCTURE_COMPONENT diagU tDiagnos_IEB 56 SYMBOL_TYPE_LINK "diagU" /end STRUCTURE_COMPONENT
 /begin STRUCTURE_COMPONENT iebBrkSwtSt tEnableState 60 SYMBOL_TYPE_LINK "iebBrkSwtSt" /end STRUCTURE_COMPONENT
 /begin STRUCTURE_COMPONENT cddSts tFunctionStatus 64 SYMBOL_TYPE_LINK "cddSts" /end STRUCTURE_COMPONENT
 /begin STRUCTURE_COMPONENT ebdSts tFunctionStatus 68 SYMBOL_TYPE_LINK "ebdSts" /end STRUCTURE_COMPONENT
 /begin STRUCTURE_COMPONENT hbaSts tFunctionStatus 72 SYMBOL_TYPE_LINK "hbaSts" /end STRUCTURE_COMPONENT
 /begin STRUCTURE_COMPONENT vdcSts tFunctionStatus 76 SYMBOL_TYPE_LINK "vdcSts" /end STRUCTURE_COMPONENT
 /begin STRUCTURE_COMPONENT hhcSts tHillHoldSts 80 SYMBOL_TYPE_LINK "hhcSts" /end STRUCTURE_COMPONENT
 /begin STRUCTURE_COMPONENT degStateIEB tIEBDegState 84 SYMBOL_TYPE_LINK "degStateIEB" /end STRUCTURE_COMPONENT
 /begin STRUCTURE_COMPONENT lkgSts tLeakage 88 SYMBOL_TYPE_LINK "lkgSts" /end STRUCTURE_COMPONENT
 /begin STRUCTURE_COMPONENT drvrBrkPedlTrvl tMillimetre 92 SYMBOL_TYPE_LINK "drvrBrkPedlTrvl" /end STRUCTURE_COMPONENT
 /begin STRUCTURE_COMPONENT motPosn tMillimetre 96 SYMBOL_TYPE_LINK "motPosn" /end STRUCTURE_COMPONENT
 /begin STRUCTURE_COMPONENT drvrBrkPedlWhlTqReq tNewtonMetre_100_S32 100 SYMBOL_TYPE_LINK "drvrBrkPedlWhlTqReq" /end STRUCTURE_COMPONENT
 /begin STRUCTURE_COMPONENT drvrBrkPedlPerc tPercent_100_S16 104 SYMBOL_TYPE_LINK "drvrBrkPedlPerc" /end STRUCTURE_COMPONENT
 /begin STRUCTURE_COMPONENT perfModVDC tPerformanceModeVDC 108 SYMBOL_TYPE_LINK "perfModVDC" /end STRUCTURE_COMPONENT
 /begin STRUCTURE_COMPONENT boosterBrkPQ tQualifier 112 SYMBOL_TYPE_LINK "boosterBrkPQ" /end STRUCTURE_COMPONENT
 /begin STRUCTURE_COMPONENT drvrBrkPedlPercQ tQualifier 116 SYMBOL_TYPE_LINK "drvrBrkPedlPercQ" /end STRUCTURE_COMPONENT
 /begin STRUCTURE_COMPONENT drvrBrkPedlTrvlQ tQualifier 120 SYMBOL_TYPE_LINK "drvrBrkPedlTrvlQ" /end STRUCTURE_COMPONENT
 /begin STRUCTURE_COMPONENT drvrBrkPedlWhlTqReqQ tQualifier 124 SYMBOL_TYPE_LINK "drvrBrkPedlWhlTqReqQ" /end STRUCTURE_COMPONENT
 /begin STRUCTURE_COMPONENT motPosnQ tQualifier 128 SYMBOL_TYPE_LINK "motPosnQ" /end STRUCTURE_COMPONENT
 /begin STRUCTURE_COMPONENT mstCylPQ tQualifier 132 SYMBOL_TYPE_LINK "mstCylPQ" /end STRUCTURE_COMPONENT
 /begin STRUCTURE_COMPONENT whlRateUQ tQualifier 136 MATRIX_DIM 4 SYMBOL_TYPE_LINK "whlRateUQ" /end STRUCTURE_COMPONENT
 /begin STRUCTURE_COMPONENT whlRotCntrQ tQualifier 152 MATRIX_DIM 4 SYMBOL_TYPE_LINK "whlRotCntrQ" /end STRUCTURE_COMPONENT
 /begin STRUCTURE_COMPONENT whlTarBrkPQ tQualifier 168 MATRIX_DIM 4 SYMBOL_TYPE_LINK "whlTarBrkPQ" /end STRUCTURE_COMPONENT
 /begin STRUCTURE_COMPONENT whlRateU tRadianPerSecond 184 MATRIX_DIM 4 SYMBOL_TYPE_LINK "whlRateU" /end STRUCTURE_COMPONENT
 /begin STRUCTURE_COMPONENT whlRateURaw tRadianPerSecond_100_U16 200 MATRIX_DIM 4 SYMBOL_TYPE_LINK "whlRateURaw" /end STRUCTURE_COMPONENT
 /begin STRUCTURE_COMPONENT regenSts tRegenStatus 208 SYMBOL_TYPE_LINK "regenSts" /end STRUCTURE_COMPONENT
 /begin STRUCTURE_COMPONENT whlRateDir tRollingState 212 MATRIX_DIM 4 SYMBOL_TYPE_LINK "whlRateDir" /end STRUCTURE_COMPONENT
 /begin STRUCTURE_COMPONENT brkPdlTrvlSts tSensorStatusAdv 228 SYMBOL_TYPE_LINK "brkPdlTrvlSts" /end STRUCTURE_COMPONENT
 /begin STRUCTURE_COMPONENT telltlAbs tTelltale 232 SYMBOL_TYPE_LINK "telltlAbs" /end STRUCTURE_COMPONENT
 /begin STRUCTURE_COMPONENT telltlAbsFb tTelltale 236 SYMBOL_TYPE_LINK "telltlAbsFb" /end STRUCTURE_COMPONENT
 /begin STRUCTURE_COMPONENT telltlBrk tTelltale 240 SYMBOL_TYPE_LINK "telltlBrk" /end STRUCTURE_COMPONENT
 /begin STRUCTURE_COMPONENT telltlBrkFb tTelltale 244 SYMBOL_TYPE_LINK "telltlBrkFb" /end STRUCTURE_COMPONENT
 /begin STRUCTURE_COMPONENT telltlVdc tTelltale 248 SYMBOL_TYPE_LINK "telltlVdc" /end STRUCTURE_COMPONENT
 /begin STRUCTURE_COMPONENT telltlVdcFb tTelltale 252 SYMBOL_TYPE_LINK "telltlVdcFb" /end STRUCTURE_COMPONENT
 /begin STRUCTURE_COMPONENT wssSts tWheelSpeedSensorStatus 256 MATRIX_DIM 4 SYMBOL_TYPE_LINK "wssSts" /end STRUCTURE_COMPONENT
 /begin STRUCTURE_COMPONENT whlRotCntr uint16_t 272 MATRIX_DIM 4 SYMBOL_TYPE_LINK "whlRotCntr" /end STRUCTURE_COMPONENT
/end TYPEDEF_STRUCTURE
/begin TYPEDEF_STRUCTURE AdasCtx "" 0x40 SYMBOL_TYPE_LINK "AdasCtx"
 /begin STRUCTURE_COMPONENT accSysErr tAccFvcmSystemError 0 SYMBOL_TYPE_LINK "accSysErr" /end STRUCTURE_COMPONENT
 /begin STRUCTURE_COMPONENT accStatyReq tAccStationaryRequest 4 SYMBOL_TYPE_LINK "accStatyReq" /end STRUCTURE_COMPONENT
 /begin STRUCTURE_COMPONENT accDrvrTakeOverReq tAccTakeoverRequest 8 SYMBOL_TYPE_LINK "accDrvrTakeOverReq" /end STRUCTURE_COMPONENT
 /begin STRUCTURE_COMPONENT accFwdVehDetd tAccVehicleDetection 12 SYMBOL_TYPE_LINK "accFwdVehDetd" /end STRUCTURE_COMPONENT
 /begin STRUCTURE_COMPONENT autDrvrDrvgCycSt tAutomatedDriverCycleState 16 SYMBOL_TYPE_LINK "autDrvrDrvgCycSt" /end STRUCTURE_COMPONENT
 /begin STRUCTURE_COMPONENT autDrvrDrvgCycTarAccel tKilometrePerHour_10_S16 20 SYMBOL_TYPE_LINK "autDrvrDrvgCycTarAccel" /end STRUCTURE_COMPONENT
 /begin STRUCTURE_COMPONENT autDrvrDrvgCycTarVel tKilometrePerHour_10_S16 22 SYMBOL_TYPE_LINK "autDrvrDrvgCycTarVel" /end STRUCTURE_COMPONENT
 /begin STRUCTURE_COMPONENT accFwdVehDistLat tMetre 24 SYMBOL_TYPE_LINK "accFwdVehDistLat" /end STRUCTURE_COMPONENT
 /begin STRUCTURE_COMPONENT accFwdVehDistLgt tMetre 28 SYMBOL_TYPE_LINK "accFwdVehDistLgt" /end STRUCTURE_COMPONENT
 /begin STRUCTURE_COMPONENT accFwdVehRelVel tMetrePerSecond 32 SYMBOL_TYPE_LINK "accFwdVehRelVel" /end STRUCTURE_COMPONENT
 /begin STRUCTURE_COMPONENT accActrReqVal tMetrePerSquareSecond 36 SYMBOL_TYPE_LINK "accActrReqVal" /end STRUCTURE_COMPONENT
 /begin STRUCTURE_COMPONENT accActrReqValQ tQualifier 40 SYMBOL_TYPE_LINK "accActrReqValQ" /end STRUCTURE_COMPONENT
 /begin STRUCTURE_COMPONENT accFwdVehDistQ tQualifier 44 SYMBOL_TYPE_LINK "accFwdVehDistQ" /end STRUCTURE_COMPONENT
 /begin STRUCTURE_COMPONENT accFwdVehRelVelQ tQualifier 48 SYMBOL_TYPE_LINK "accFwdVehRelVelQ" /end STRUCTURE_COMPONENT
 /begin STRUCTURE_COMPONENT autDrvrDrvgCycTarAccelQ tQualifier 52 SYMBOL_TYPE_LINK "autDrvrDrvgCycTarAccelQ" /end STRUCTURE_COMPONENT
 /begin STRUCTURE_COMPONENT autDrvrDrvgCycTarVelQ tQualifier 56 SYMBOL_TYPE_LINK "autDrvrDrvgCycTarVelQ" /end STRUCTURE_COMPONENT
 /begin STRUCTURE_COMPONENT adpvCrsCtrlEyeqBlkdRsnMask uint16_t 60 SYMBOL_TYPE_LINK "adpvCrsCtrlEyeqBlkdRsnMask" /end STRUCTURE_COMPONENT
/end TYPEDEF_STRUCTURE
/begin TYPEDEF_STRUCTURE TpmsEcuFltBitfield "" 0x1 SYMBOL_TYPE_LINK "TpmsEcuFltBitfield"
 /begin STRUCTURE_COMPONENT tpmsEcuFltFlag TpmsEcuFltFlag 0 SYMBOL_TYPE_LINK "tpmsEcuFltFlag" /end STRUCTURE_COMPONENT
 /begin STRUCTURE_COMPONENT tpmsEcuFltMask tHex_U8 0 SYMBOL_TYPE_LINK "tpmsEcuFltMask" /end STRUCTURE_COMPONENT
/end TYPEDEF_STRUCTURE
/begin TYPEDEF_STRUCTURE DynamicsRhcCtx "" 0x5C SYMBOL_TYPE_LINK "DynamicsRhcCtx" /begin STRUCTURE_COMPONENT bLiftInhbMovmt _Bool 0 SYMBOL_TYPE_LINK "bLiftInhbMovmt" /end STRUCTURE_COMPONENT /begin STRUCTURE_COMPONENT bLiftSysMovg _Bool 1 SYMBOL_TYPE_LINK "bLiftSysMovg" /end STRUCTURE_COMPONENT /begin STRUCTURE_COMPONENT rideHeightFault _Bool 2 SYMBOL_TYPE_LINK "rideHeightFault" /end STRUCTURE_COMPONENT
 /begin STRUCTURE_COMPONENT mtnRat tFactor_1000_S16 4 MATRIX_DIM 4 SYMBOL_TYPE_LINK "mtnRat" /end STRUCTURE_COMPONENT
 /begin STRUCTURE_COMPONENT rideHeightLiftCmd tLiftMovement 12 MATRIX_DIM 4 SYMBOL_TYPE_LINK "rideHeightLiftCmd" /end STRUCTURE_COMPONENT
 /begin STRUCTURE_COMPONENT rideHeightLiftIndication tLiftIndication 28 SYMBOL_TYPE_LINK "rideHeightLiftIndication" /end STRUCTURE_COMPONENT
 /begin STRUCTURE_COMPONENT rideHeightLiftSt tLiftState 32 SYMBOL_TYPE_LINK "rideHeightLiftSt" /end STRUCTURE_COMPONENT
 /begin STRUCTURE_COMPONENT sprgTrvl tMillimetre_10_S16 36 MATRIX_DIM 4 SYMBOL_TYPE_LINK "sprgTrvl" /end STRUCTURE_COMPONENT
 /begin STRUCTURE_COMPONENT whlTrvl tMillimetre_10_S16 44 MATRIX_DIM 4 SYMBOL_TYPE_LINK "whlTrvl" /end STRUCTURE_COMPONENT
 /begin STRUCTURE_COMPONENT perfModeAutoCalib tPerformanceMode 52 SYMBOL_TYPE_LINK "perfModeAutoCalib" /end STRUCTURE_COMPONENT
 /begin STRUCTURE_COMPONENT perfModRHC tPerformanceModeRHC 56 SYMBOL_TYPE_LINK "perfModRHC" /end STRUCTURE_COMPONENT
 /begin STRUCTURE_COMPONENT sprgTrvlQ tQualifier 60 MATRIX_DIM 4 SYMBOL_TYPE_LINK "sprgTrvlQ" /end STRUCTURE_COMPONENT
 /begin STRUCTURE_COMPONENT whlTrvlQ tQualifier 76 MATRIX_DIM 4 SYMBOL_TYPE_LINK "whlTrvlQ" /end STRUCTURE_COMPONENT
/end TYPEDEF_STRUCTURE
/begin TYPEDEF_STRUCTURE TqMgrCtx "" 0xD4 SYMBOL_TYPE_LINK "TqMgrCtx"
 /begin STRUCTURE_COMPONENT bPrelCluTqActive _Bool 0 SYMBOL_TYPE_LINK "bPrelCluTqActive" /end STRUCTURE_COMPONENT
 /begin STRUCTURE_COMPONENT bPrelWhlCluReqElec _Bool 1 SYMBOL_TYPE_LINK "bPrelWhlCluReqElec" /end STRUCTURE_COMPONENT
 /begin STRUCTURE_COMPONENT bPrelWhlCluReqHybrid _Bool 2 SYMBOL_TYPE_LINK "bPrelWhlCluReqHybrid" /end STRUCTURE_COMPONENT
 /begin STRUCTURE_COMPONENT bPropshIdleRateAllowed _Bool 3 SYMBOL_TYPE_LINK "bPropshIdleRateAllowed" /end STRUCTURE_COMPONENT
 /begin STRUCTURE_COMPONENT bTrsmTakeoffReq _Bool 4 SYMBOL_TYPE_LINK "bTrsmTakeoffReq" /end STRUCTURE_COMPONENT
 /begin STRUCTURE_COMPONENT bVehLaunchCtrl _Bool 5 SYMBOL_TYPE_LINK "bVehLaunchCtrl" /end STRUCTURE_COMPONENT
 /begin STRUCTURE_COMPONENT bVehTracCtrl _Bool 6 SYMBOL_TYPE_LINK "bVehTracCtrl" /end STRUCTURE_COMPONENT
 /begin STRUCTURE_COMPONENT bWhlTqReqAllowed _Bool 7 SYMBOL_TYPE_LINK "bWhlTqReqAllowed" /end STRUCTURE_COMPONENT
 /begin STRUCTURE_COMPONENT axleSysSt tAxleSystemState 8 SYMBOL_TYPE_LINK "axleSysSt" /end STRUCTURE_COMPONENT
 /begin STRUCTURE_COMPONENT cenCluStTsm tClutchState 12 SYMBOL_TYPE_LINK "cenCluStTsm" /end STRUCTURE_COMPONENT
 /begin STRUCTURE_COMPONENT whlCluStTsm tClutchState 16 MATRIX_DIM 4 SYMBOL_TYPE_LINK "whlCluStTsm" /end STRUCTURE_COMPONENT
 /begin STRUCTURE_COMPONENT drvCfg tDriveConfiguration 32 SYMBOL_TYPE_LINK "drvCfg" /end STRUCTURE_COMPONENT
 /begin STRUCTURE_COMPONENT tireMaxLgtSlip tFactor 36 MATRIX_DIM 4 SYMBOL_TYPE_LINK "tireMaxLgtSlip" /end STRUCTURE_COMPONENT
 /begin STRUCTURE_COMPONENT fricBrkTqArbnSt tFrictionBrakeTorqueArbitrationMode 52 SYMBOL_TYPE_LINK "fricBrkTqArbnSt" /end STRUCTURE_COMPONENT
 /begin STRUCTURE_COMPONENT tcSts tFunctionStatus 56 SYMBOL_TYPE_LINK "tcSts" /end STRUCTURE_COMPONENT
 /begin STRUCTURE_COMPONENT gearReq tGear 60 SYMBOL_TYPE_LINK "gearReq" /end STRUCTURE_COMPONENT
 /begin STRUCTURE_COMPONENT gearStatyCrkReq tGear 64 SYMBOL_TYPE_LINK "gearStatyCrkReq" /end STRUCTURE_COMPONENT
 /begin STRUCTURE_COMPONENT cenCluTqEstimd tNewtonMetre 68 SYMBOL_TYPE_LINK "cenCluTqEstimd" /end STRUCTURE_COMPONENT
 /begin STRUCTURE_COMPONENT drvrWhlTqBrkPedlDtAvl tNewtonMetre 72 SYMBOL_TYPE_LINK "drvrWhlTqBrkPedlDtAvl" /end STRUCTURE_COMPONENT
 /begin STRUCTURE_COMPONENT drvrWhlTqReqCpt tNewtonMetre 76 SYMBOL_TYPE_LINK "drvrWhlTqReqCpt" /end STRUCTURE_COMPONENT
 /begin STRUCTURE_COMPONENT drvrWhlTqReqSlow tNewtonMetre 80 SYMBOL_TYPE_LINK "drvrWhlTqReqSlow" /end STRUCTURE_COMPONENT
 /begin STRUCTURE_COMPONENT elecMotChrgTqDmd tNewtonMetre 84 SYMBOL_TYPE_LINK "elecMotChrgTqDmd" /end STRUCTURE_COMPONENT
 /begin STRUCTURE_COMPONENT elecMotTqMax tNewtonMetre 88 SYMBOL_TYPE_LINK "elecMotTqMax" /end STRUCTURE_COMPONENT
 /begin STRUCTURE_COMPONENT elecMotTqMaxFb tNewtonMetre 92 SYMBOL_TYPE_LINK "elecMotTqMaxFb" /end STRUCTURE_COMPONENT
 /begin STRUCTURE_COMPONENT elecMotTqMin tNewtonMetre 96 SYMBOL_TYPE_LINK "elecMotTqMin" /end STRUCTURE_COMPONENT
 /begin STRUCTURE_COMPONENT elecMotTqMinFb tNewtonMetre 100 SYMBOL_TYPE_LINK "elecMotTqMinFb" /end STRUCTURE_COMPONENT
 /begin STRUCTURE_COMPONENT iceTqMax tNewtonMetre 104 SYMBOL_TYPE_LINK "iceTqMax" /end STRUCTURE_COMPONENT
 /begin STRUCTURE_COMPONENT iceTqMin tNewtonMetre 108 SYMBOL_TYPE_LINK "iceTqMin" /end STRUCTURE_COMPONENT
 /begin STRUCTURE_COMPONENT iceTqReqFastInvSpdRedn tNewtonMetre 112 SYMBOL_TYPE_LINK "iceTqReqFastInvSpdRedn" /end STRUCTURE_COMPONENT
 /begin STRUCTURE_COMPONENT whlTqActrTotLimLowr tNewtonMetre 116 SYMBOL_TYPE_LINK "whlTqActrTotLimLowr" /end STRUCTURE_COMPONENT
 /begin STRUCTURE_COMPONENT whlTqActrTotLimUppr tNewtonMetre 120 SYMBOL_TYPE_LINK "whlTqActrTotLimUppr" /end STRUCTURE_COMPONENT
 /begin STRUCTURE_COMPONENT whlTqBrkMinTsm tNewtonMetre 124 MATRIX_DIM 4 SYMBOL_TYPE_LINK "whlTqBrkMinTsm" /end STRUCTURE_COMPONENT
 /begin STRUCTURE_COMPONENT whlTqDtLimLowr tNewtonMetre 140 MATRIX_DIM 4 SYMBOL_TYPE_LINK "whlTqDtLimLowr" /end STRUCTURE_COMPONENT
 /begin STRUCTURE_COMPONENT whlTqDtLimUppr tNewtonMetre 156 MATRIX_DIM 4 SYMBOL_TYPE_LINK "whlTqDtLimUppr" /end STRUCTURE_COMPONENT
 /begin STRUCTURE_COMPONENT whlTqReqRaw tNewtonMetre 172 MATRIX_DIM 4 SYMBOL_TYPE_LINK "whlTqReqRaw" /end STRUCTURE_COMPONENT
 /begin STRUCTURE_COMPONENT perfStgy tPerformanceStrategy 188 SYMBOL_TYPE_LINK "perfStgy" /end STRUCTURE_COMPONENT
 /begin STRUCTURE_COMPONENT prplMod tPropulsionMode 192 SYMBOL_TYPE_LINK "prplMod" /end STRUCTURE_COMPONENT
 /begin STRUCTURE_COMPONENT drvrWhlTqBrkPedlDtAvlQ tQualifier 196 SYMBOL_TYPE_LINK "drvrWhlTqBrkPedlDtAvlQ" /end STRUCTURE_COMPONENT
 /begin STRUCTURE_COMPONENT propshSpdMax tRevolutionPerMinute_S16 200 SYMBOL_TYPE_LINK "propshSpdMax" /end STRUCTURE_COMPONENT
 /begin STRUCTURE_COMPONENT tqSysSt tTorqueSystemState 204 SYMBOL_TYPE_LINK "tqSysSt" /end STRUCTURE_COMPONENT
 /begin STRUCTURE_COMPONENT tqSt tTqMacSt 208 SYMBOL_TYPE_LINK "tqSt" /end STRUCTURE_COMPONENT
/end TYPEDEF_STRUCTURE
/begin TYPEDEF_STRUCTURE AwasSteering "" 0x18 SYMBOL_TYPE_LINK "AwasSteering" /begin STRUCTURE_COMPONENT steerAgRaw uint16_t 0 SYMBOL_TYPE_LINK "steerAgRaw" /end STRUCTURE_COMPONENT
 /begin STRUCTURE_COMPONENT steerAgRateRaw uint16_t 2 SYMBOL_TYPE_LINK "steerAgRateRaw" /end STRUCTURE_COMPONENT
 /begin STRUCTURE_COMPONENT steerAgDir tRotDir 4 SYMBOL_TYPE_LINK "steerAgDir" /end STRUCTURE_COMPONENT
 /begin STRUCTURE_COMPONENT steerAgRateDir tRotDir 8 SYMBOL_TYPE_LINK "steerAgRateDir" /end STRUCTURE_COMPONENT
 /begin STRUCTURE_COMPONENT steerAg tDegree 12 SYMBOL_TYPE_LINK "steerAg" /end STRUCTURE_COMPONENT
 /begin STRUCTURE_COMPONENT steerAgRate tDegree 16 SYMBOL_TYPE_LINK "steerAgRate" /end STRUCTURE_COMPONENT
 /begin STRUCTURE_COMPONENT timedOut _Bool 20 SYMBOL_TYPE_LINK "timedOut" /end STRUCTURE_COMPONENT
/end TYPEDEF_STRUCTURE
/begin TYPEDEF_STRUCTURE DynamicsHomlnSftyCtx "" 0x30 SYMBOL_TYPE_LINK "DynamicsHomlnSftyCtx"
 /begin STRUCTURE_COMPONENT avasSpeakerReq tEnableState 0 SYMBOL_TYPE_LINK "avasSpeakerReq" /end STRUCTURE_COMPONENT
 /begin STRUCTURE_COMPONENT avasFanFrntReqPerc tPercent_S8 4 SYMBOL_TYPE_LINK "avasFanFrntReqPerc" /end STRUCTURE_COMPONENT
 /begin STRUCTURE_COMPONENT avasFanReReqPerc tPercent_S8 5 SYMBOL_TYPE_LINK "avasFanReReqPerc" /end STRUCTURE_COMPONENT
 /begin STRUCTURE_COMPONENT homldVehVel tKilometrePerHour_10_S16 6 SYMBOL_TYPE_LINK "homldVehVel" /end STRUCTURE_COMPONENT
 /begin STRUCTURE_COMPONENT homldVehVelQ tQualifier 8 SYMBOL_TYPE_LINK "homldVehVelQ" /end STRUCTURE_COMPONENT
 /begin STRUCTURE_COMPONENT indcdVehVel tKilometrePerHour_10_S16 12 SYMBOL_TYPE_LINK "indcdVehVel" /end STRUCTURE_COMPONENT
 /begin STRUCTURE_COMPONENT indcdVehVelQ tQualifier 16 SYMBOL_TYPE_LINK "indcdVehVelQ" /end STRUCTURE_COMPONENT
 /begin STRUCTURE_COMPONENT odoSyncIssue _Bool 20 SYMBOL_TYPE_LINK "odoSyncIssue" /end STRUCTURE_COMPONENT
 /begin STRUCTURE_COMPONENT odoVinSyncIssue _Bool 21 SYMBOL_TYPE_LINK "odoVinSyncIssue" /end STRUCTURE_COMPONENT
 /begin STRUCTURE_COMPONENT odoVal tKilometre 24 SYMBOL_TYPE_LINK "odoVal" /end STRUCTURE_COMPONENT
 /begin STRUCTURE_COMPONENT odoValQ tQualifier 28 SYMBOL_TYPE_LINK "odoValQ" /end STRUCTURE_COMPONENT
 /begin STRUCTURE_COMPONENT tpmsSpdLim tKilometrePerHour_10_S16 32 SYMBOL_TYPE_LINK "tpmsSpdLim" /end STRUCTURE_COMPONENT
 /begin STRUCTURE_COMPONENT tpmsSpdLimQ tQualifier 36 SYMBOL_TYPE_LINK "tpmsSpdLimQ" /end STRUCTURE_COMPONENT
 /begin STRUCTURE_COMPONENT tpmsSpdLimHit tTpmsSpdLimHit 40 SYMBOL_TYPE_LINK "tpmsSpdLimHit" /end STRUCTURE_COMPONENT
 /begin STRUCTURE_COMPONENT tpmsWarnLampSts tTpmsWarnLamp 44 SYMBOL_TYPE_LINK "tpmsWarnLampSts" /end STRUCTURE_COMPONENT
/end TYPEDEF_STRUCTURE
/begin TYPEDEF_STRUCTURE xSTATIC_LIST "" 0x14 SYMBOL_TYPE_LINK "xSTATIC_LIST" /begin STRUCTURE_COMPONENT uxDummy2 UBaseType_t 0 SYMBOL_TYPE_LINK "uxDummy2" /end STRUCTURE_COMPONENT
 /begin STRUCTURE_COMPONENT xDummy4 xSTATIC_MINI_LIST_ITEM 8 SYMBOL_TYPE_LINK "xDummy4" /end STRUCTURE_COMPONENT
/end TYPEDEF_STRUCTURE
/begin TYPEDEF_STRUCTURE EngineCtx "" 0x80 SYMBOL_TYPE_LINK "EngineCtx"
 /begin STRUCTURE_COMPONENT vehIdnNr tAscii 0 MATRIX_DIM 17 SYMBOL_TYPE_LINK "vehIdnNr" /end STRUCTURE_COMPONENT
 /begin STRUCTURE_COMPONENT trsmOilT tCelsius 20 SYMBOL_TYPE_LINK "trsmOilT" /end STRUCTURE_COMPONENT
 /begin STRUCTURE_COMPONENT iceCtrlSt tCombustionEngineControlState 24 SYMBOL_TYPE_LINK "iceCtrlSt" /end STRUCTURE_COMPONENT
 /begin STRUCTURE_COMPONENT engRunng tEngineRunning 28 SYMBOL_TYPE_LINK "engRunng" /end STRUCTURE_COMPONENT
 /begin STRUCTURE_COMPONENT actGear tGear 32 SYMBOL_TYPE_LINK "actGear" /end STRUCTURE_COMPONENT
 /begin STRUCTURE_COMPONENT tgtGear tGear 36 SYMBOL_TYPE_LINK "tgtGear" /end STRUCTURE_COMPONENT
 /begin STRUCTURE_COMPONENT iceSysSt tIceSystemState 40 SYMBOL_TYPE_LINK "iceSysSt" /end STRUCTURE_COMPONENT
 /begin STRUCTURE_COMPONENT fuelLevel tLitre 44 SYMBOL_TYPE_LINK "fuelLevel" /end STRUCTURE_COMPONENT
 /begin STRUCTURE_COMPONENT iceTqEstimd tNewtonMetre 48 SYMBOL_TYPE_LINK "iceTqEstimd" /end STRUCTURE_COMPONENT
 /begin STRUCTURE_COMPONENT iceTqMaxFast tNewtonMetre 52 SYMBOL_TYPE_LINK "iceTqMaxFast" /end STRUCTURE_COMPONENT
 /begin STRUCTURE_COMPONENT iceTqMaxSlow tNewtonMetre 56 SYMBOL_TYPE_LINK "iceTqMaxSlow" /end STRUCTURE_COMPONENT
 /begin STRUCTURE_COMPONENT iceTqMin tNewtonMetre 60 SYMBOL_TYPE_LINK "iceTqMin" /end STRUCTURE_COMPONENT
 /begin STRUCTURE_COMPONENT propshTqDmdForIce tNewtonMetre 64 SYMBOL_TYPE_LINK "propshTqDmdForIce" /end STRUCTURE_COMPONENT
 /begin STRUCTURE_COMPONENT iceLightoffReq tPercent_S8 68 SYMBOL_TYPE_LINK "iceLightoffReq" /end STRUCTURE_COMPONENT
 /begin STRUCTURE_COMPONENT lsttDrvgCrkSt tPropshaftDrivingCrankState 72 SYMBOL_TYPE_LINK "lsttDrvgCrkSt" /end STRUCTURE_COMPONENT
 /begin STRUCTURE_COMPONENT lsttStatyCrkSt tPropshaftStationaryCrankState 76 SYMBOL_TYPE_LINK "lsttStatyCrkSt" /end STRUCTURE_COMPONENT
 /begin STRUCTURE_COMPONENT iceSpdIdleQ tQualifier 80 SYMBOL_TYPE_LINK "iceSpdIdleQ" /end STRUCTURE_COMPONENT
 /begin STRUCTURE_COMPONENT iceSpdMaxQ tQualifier 84 SYMBOL_TYPE_LINK "iceSpdMaxQ" /end STRUCTURE_COMPONENT
 /begin STRUCTURE_COMPONENT iceSpdQ tQualifier 88 SYMBOL_TYPE_LINK "iceSpdQ" /end STRUCTURE_COMPONENT
 /begin STRUCTURE_COMPONENT iceTqEstimdQ tQualifier 92 SYMBOL_TYPE_LINK "iceTqEstimdQ" /end STRUCTURE_COMPONENT
 /begin STRUCTURE_COMPONENT iceTqMaxFastQ tQualifier 96 SYMBOL_TYPE_LINK "iceTqMaxFastQ" /end STRUCTURE_COMPONENT
 /begin STRUCTURE_COMPONENT iceTqMaxSlowQ tQualifier 100 SYMBOL_TYPE_LINK "iceTqMaxSlowQ" /end STRUCTURE_COMPONENT
 /begin STRUCTURE_COMPONENT iceTqMinQ tQualifier 104 SYMBOL_TYPE_LINK "iceTqMinQ" /end STRUCTURE_COMPONENT
 /begin STRUCTURE_COMPONENT propshTqDmdForIceQ tQualifier 108 SYMBOL_TYPE_LINK "propshTqDmdForIceQ" /end STRUCTURE_COMPONENT
 /begin STRUCTURE_COMPONENT trsmOutpShaftSpdQ tQualifier 112 SYMBOL_TYPE_LINK "trsmOutpShaftSpdQ" /end STRUCTURE_COMPONENT
 /begin STRUCTURE_COMPONENT vehIdnNrQ tQualifier 116 SYMBOL_TYPE_LINK "vehIdnNrQ" /end STRUCTURE_COMPONENT
 /begin STRUCTURE_COMPONENT iceSpd tRevolutionPerMinute_S16 120 SYMBOL_TYPE_LINK "iceSpd" /end STRUCTURE_COMPONENT
 /begin STRUCTURE_COMPONENT iceSpdIdle tRevolutionPerMinute_S16 122 SYMBOL_TYPE_LINK "iceSpdIdle" /end STRUCTURE_COMPONENT
 /begin STRUCTURE_COMPONENT iceSpdMax tRevolutionPerMinute_S16 124 SYMBOL_TYPE_LINK "iceSpdMax" /end STRUCTURE_COMPONENT
 /begin STRUCTURE_COMPONENT trsmOutpShaftSpd tRevolutionPerMinute_S16 126 SYMBOL_TYPE_LINK "trsmOutpShaftSpd" /end STRUCTURE_COMPONENT
/end TYPEDEF_STRUCTURE
/begin TYPEDEF_STRUCTURE TpmsSnsrFltBitfield "" 0x1 SYMBOL_TYPE_LINK "TpmsSnsrFltBitfield"
 /begin STRUCTURE_COMPONENT tpmsSnsrFltFlag TpmsSnsrFltFlag 0 SYMBOL_TYPE_LINK "tpmsSnsrFltFlag" /end STRUCTURE_COMPONENT
 /begin STRUCTURE_COMPONENT tpmsSnsrFltMask tHex_U8 0 SYMBOL_TYPE_LINK "tpmsSnsrFltMask" /end STRUCTURE_COMPONENT
/end TYPEDEF_STRUCTURE
/begin TYPEDEF_STRUCTURE LnchCtrlAbortFlg "" 0x2 SYMBOL_TYPE_LINK "LnchCtrlAbortFlg"
 /begin STRUCTURE_COMPONENT anyDoorOpen uint16_t_0x800 0 SYMBOL_TYPE_LINK "anyDoorOpen" /end STRUCTURE_COMPONENT
 /begin STRUCTURE_COMPONENT steerWhlAg uint16_t_0x400 0 SYMBOL_TYPE_LINK "steerWhlAg" /end STRUCTURE_COMPONENT
 /begin STRUCTURE_COMPONENT drvMod uint16_t_0x200 0 SYMBOL_TYPE_LINK "drvMod" /end STRUCTURE_COMPONENT
 /begin STRUCTURE_COMPONENT perfModAllwd uint16_t_0x100 0 SYMBOL_TYPE_LINK "perfModAllwd" /end STRUCTURE_COMPONENT
 /begin STRUCTURE_COMPONENT asf uint16_t_0x80 0 SYMBOL_TYPE_LINK "asf" /end STRUCTURE_COMPONENT
 /begin STRUCTURE_COMPONENT absFlt uint16_t_0x40 0 SYMBOL_TYPE_LINK "absFlt" /end STRUCTURE_COMPONENT
 /begin STRUCTURE_COMPONENT limpMod uint16_t_0x20 0 SYMBOL_TYPE_LINK "limpMod" /end STRUCTURE_COMPONENT
 /begin STRUCTURE_COMPONENT tcSts uint16_t_0x10 0 SYMBOL_TYPE_LINK "tcSts" /end STRUCTURE_COMPONENT
 /begin STRUCTURE_COMPONENT pwtFlt uint16_t_0x8 0 SYMBOL_TYPE_LINK "pwtFlt" /end STRUCTURE_COMPONENT
 /begin STRUCTURE_COMPONENT anyQualifierFlt uint16_t_0x4 0 SYMBOL_TYPE_LINK "anyQualifierFlt" /end STRUCTURE_COMPONENT
 /begin STRUCTURE_COMPONENT canComm uint16_t_0x2 0 SYMBOL_TYPE_LINK "canComm" /end STRUCTURE_COMPONENT
 /begin STRUCTURE_COMPONENT lcDisabled uint16_t_0x1 0 SYMBOL_TYPE_LINK "lcDisabled" /end STRUCTURE_COMPONENT
/end TYPEDEF_STRUCTURE
/begin TYPEDEF_STRUCTURE CanNodeTimeoutBitfield "" 0x4 SYMBOL_TYPE_LINK "CanNodeTimeoutBitfield"
 /begin STRUCTURE_COMPONENT canNodeTimeoutFlg CanNodeTimeoutFlg 0 SYMBOL_TYPE_LINK "canNodeTimeoutFlg" /end STRUCTURE_COMPONENT
 /begin STRUCTURE_COMPONENT canNodeTimeoutMask uint32_t 0 SYMBOL_TYPE_LINK "canNodeTimeoutMask" /end STRUCTURE_COMPONENT
/end TYPEDEF_STRUCTURE
/begin TYPEDEF_STRUCTURE BodyCtx "" 0xD0 SYMBOL_TYPE_LINK "BodyCtx" /begin STRUCTURE_COMPONENT bLeHandDrv _Bool 0 SYMBOL_TYPE_LINK "bLeHandDrv" /end STRUCTURE_COMPONENT /begin STRUCTURE_COMPONENT airPressure tBar 4 SYMBOL_TYPE_LINK "airPressure" /end STRUCTURE_COMPONENT
 /begin STRUCTURE_COMPONENT airTemperature tCelsius 8 SYMBOL_TYPE_LINK "airTemperature" /end STRUCTURE_COMPONENT
 /begin STRUCTURE_COMPONENT envtTi EnvtTi 12 SYMBOL_TYPE_LINK "envtTi" /end STRUCTURE_COMPONENT
 /begin STRUCTURE_COMPONENT hydraulicPumpSts tFunctionStatus 20 SYMBOL_TYPE_LINK "hydraulicPumpSts" /end STRUCTURE_COMPONENT
 /begin STRUCTURE_COMPONENT imobSt tImmobilizerState 24 SYMBOL_TYPE_LINK "imobSt" /end STRUCTURE_COMPONENT
 /begin STRUCTURE_COMPONENT imuSnsr1 ImuData 28 SYMBOL_TYPE_LINK "imuSnsr1" /end STRUCTURE_COMPONENT
 /begin STRUCTURE_COMPONENT imuSnsr2 ImuData 60 SYMBOL_TYPE_LINK "imuSnsr2" /end STRUCTURE_COMPONENT
 /begin STRUCTURE_COMPONENT imuSnsr3 ImuData 92 SYMBOL_TYPE_LINK "imuSnsr3" /end STRUCTURE_COMPONENT
 /begin STRUCTURE_COMPONENT huOdo tKilometre 124 SYMBOL_TYPE_LINK "huOdo" /end STRUCTURE_COMPONENT
 /begin STRUCTURE_COMPONENT vehVelGps tKilometrePerHour 128 SYMBOL_TYPE_LINK "vehVelGps" /end STRUCTURE_COMPONENT
 /begin STRUCTURE_COMPONENT market tMarket 132 SYMBOL_TYPE_LINK "market" /end STRUCTURE_COMPONENT
 /begin STRUCTURE_COMPONENT dstAboveSeaLvl tMetre 136 SYMBOL_TYPE_LINK "dstAboveSeaLvl" /end STRUCTURE_COMPONENT
 /begin STRUCTURE_COMPONENT drvrSeat tOccupancyStatus 140 SYMBOL_TYPE_LINK "drvrSeat" /end STRUCTURE_COMPONENT
 /begin STRUCTURE_COMPONENT passSeat tOccupancyStatus 144 SYMBOL_TYPE_LINK "passSeat" /end STRUCTURE_COMPONENT
 /begin STRUCTURE_COMPONENT rearLeftSeat tOccupancyStatus 148 SYMBOL_TYPE_LINK "rearLeftSeat" /end STRUCTURE_COMPONENT
 /begin STRUCTURE_COMPONENT rearRightSeat tOccupancyStatus 152 SYMBOL_TYPE_LINK "rearRightSeat" /end STRUCTURE_COMPONENT
 /begin STRUCTURE_COMPONENT doorStsLe tPanelStatus 156 SYMBOL_TYPE_LINK "doorStsLe" /end STRUCTURE_COMPONENT
 /begin STRUCTURE_COMPONENT doorStsRi tPanelStatus 160 SYMBOL_TYPE_LINK "doorStsRi" /end STRUCTURE_COMPONENT
 /begin STRUCTURE_COMPONENT hoodStsFrnt tPanelStatus 164 SYMBOL_TYPE_LINK "hoodStsFrnt" /end STRUCTURE_COMPONENT
 /begin STRUCTURE_COMPONENT hoodStsRear tPanelStatus 168 SYMBOL_TYPE_LINK "hoodStsRear" /end STRUCTURE_COMPONENT
 /begin STRUCTURE_COMPONENT airRelHumidity tPercent 172 SYMBOL_TYPE_LINK "airRelHumidity" /end STRUCTURE_COMPONENT
 /begin STRUCTURE_COMPONENT pwrSt tPowerState 176 SYMBOL_TYPE_LINK "pwrSt" /end STRUCTURE_COMPONENT
 /begin STRUCTURE_COMPONENT airPressureQ tQualifier 180 SYMBOL_TYPE_LINK "airPressureQ" /end STRUCTURE_COMPONENT
 /begin STRUCTURE_COMPONENT airRelHumidityQ tQualifier 184 SYMBOL_TYPE_LINK "airRelHumidityQ" /end STRUCTURE_COMPONENT
 /begin STRUCTURE_COMPONENT airTemperatureQ tQualifier 188 SYMBOL_TYPE_LINK "airTemperatureQ" /end STRUCTURE_COMPONENT
 /begin STRUCTURE_COMPONENT dstAboveSeaLvlQ tQualifier 192 SYMBOL_TYPE_LINK "dstAboveSeaLvlQ" /end STRUCTURE_COMPONENT
 /begin STRUCTURE_COMPONENT huOdoQ tQualifier 196 SYMBOL_TYPE_LINK "huOdoQ" /end STRUCTURE_COMPONENT
 /begin STRUCTURE_COMPONENT vehVelGpsQ tQualifier 200 SYMBOL_TYPE_LINK "vehVelGpsQ" /end STRUCTURE_COMPONENT
 /begin STRUCTURE_COMPONENT huVelIndcnMod tVelocityIndicationType 204 SYMBOL_TYPE_LINK "huVelIndcnMod" /end STRUCTURE_COMPONENT
/end TYPEDEF_STRUCTURE
/begin TYPEDEF_STRUCTURE PerfModCptRejctdRsnBitfield "" 0x1 SYMBOL_TYPE_LINK "PerfModCptRejctdRsnBitfield"
 /begin STRUCTURE_COMPONENT perfModCptRejctdFlg PerfModCptRejctdFlg 0 SYMBOL_TYPE_LINK "perfModCptRejctdFlg" /end STRUCTURE_COMPONENT
 /begin STRUCTURE_COMPONENT perfModCptRejctdMask uint8_t 0 SYMBOL_TYPE_LINK "perfModCptRejctdMask" /end STRUCTURE_COMPONENT
/end TYPEDEF_STRUCTURE
/begin TYPEDEF_STRUCTURE LaunchCtrlReqAllwdBitfield "" 0x1 SYMBOL_TYPE_LINK "LaunchCtrlReqAllwdBitfield"
 /begin STRUCTURE_COMPONENT lnchCtrlReqAllwdFlg LnchCtrlReqAllwdFlg 0 SYMBOL_TYPE_LINK "lnchCtrlReqAllwdFlg" /end STRUCTURE_COMPONENT
 /begin STRUCTURE_COMPONENT lnchCtrlReqAllwdMask uint8_t 0 SYMBOL_TYPE_LINK "lnchCtrlReqAllwdMask" /end STRUCTURE_COMPONENT
/end TYPEDEF_STRUCTURE
/begin TYPEDEF_STRUCTURE Fault "" 0x4 SYMBOL_TYPE_LINK "Fault"
 /begin STRUCTURE_COMPONENT lastNegativeEdgeFaultActive uint32_t_0xFFFFFFFC 0 SYMBOL_TYPE_LINK "lastNegativeEdgeFaultActive" /end STRUCTURE_COMPONENT
 /begin STRUCTURE_COMPONENT statusPrev uint32_t_0x3 0 SYMBOL_TYPE_LINK "statusPrev" /end STRUCTURE_COMPONENT
/end TYPEDEF_STRUCTURE
/begin TYPEDEF_STRUCTURE DynamicsVsoCtx "" 0x2B4 SYMBOL_TYPE_LINK "DynamicsVsoCtx" /begin STRUCTURE_COMPONENT whlTq tNewtonMetre 0 MATRIX_DIM 4 SYMBOL_TYPE_LINK "whlTq" /end STRUCTURE_COMPONENT
 /begin STRUCTURE_COMPONENT whlTqQ tQualifier 16 MATRIX_DIM 4 SYMBOL_TYPE_LINK "whlTqQ" /end STRUCTURE_COMPONENT
 /begin STRUCTURE_COMPONENT whlTqBrkMin tNewtonMetre 32 MATRIX_DIM 4 SYMBOL_TYPE_LINK "whlTqBrkMin" /end STRUCTURE_COMPONENT
 /begin STRUCTURE_COMPONENT whlTqBrkMax tNewtonMetre 48 MATRIX_DIM 4 SYMBOL_TYPE_LINK "whlTqBrkMax" /end STRUCTURE_COMPONENT
 /begin STRUCTURE_COMPONENT whlTqBrkCoeff _float 64 MATRIX_DIM 4 SYMBOL_TYPE_LINK "whlTqBrkCoeff" /end STRUCTURE_COMPONENT
 /begin STRUCTURE_COMPONENT imuCog ImuData 80 SYMBOL_TYPE_LINK "imuCog" /end STRUCTURE_COMPONENT
 /begin STRUCTURE_COMPONENT imuCogFild ImuData 112 SYMBOL_TYPE_LINK "imuCogFild" /end STRUCTURE_COMPONENT
 /begin STRUCTURE_COMPONENT bVehHasMoved _Bool 144 SYMBOL_TYPE_LINK "bVehHasMoved" /end STRUCTURE_COMPONENT
 /begin STRUCTURE_COMPONENT vehRollgSt tRollingState 148 SYMBOL_TYPE_LINK "vehRollgSt" /end STRUCTURE_COMPONENT
 /begin STRUCTURE_COMPONENT vehMass tKilogram 152 SYMBOL_TYPE_LINK "vehMass" /end STRUCTURE_COMPONENT
 /begin STRUCTURE_COMPONENT vehMassQ tQualifier 156 SYMBOL_TYPE_LINK "vehMassQ" /end STRUCTURE_COMPONENT
 /begin STRUCTURE_COMPONENT whlAg tRadian 160 MATRIX_DIM 4 SYMBOL_TYPE_LINK "whlAg" /end STRUCTURE_COMPONENT
 /begin STRUCTURE_COMPONENT tireRollgRd tMetre 176 MATRIX_DIM 4 SYMBOL_TYPE_LINK "tireRollgRd" /end STRUCTURE_COMPONENT
 /begin STRUCTURE_COMPONENT tireRollgRdTqAvg tMetre 192 SYMBOL_TYPE_LINK "tireRollgRdTqAvg" /end STRUCTURE_COMPONENT
 /begin STRUCTURE_COMPONENT tireRollgRdQ tQualifier 196 MATRIX_DIM 4 SYMBOL_TYPE_LINK "tireRollgRdQ" /end STRUCTURE_COMPONENT
 /begin STRUCTURE_COMPONENT tireRollgRdTqAvgQ tQualifier 212 SYMBOL_TYPE_LINK "tireRollgRdTqAvgQ" /end STRUCTURE_COMPONENT
 /begin STRUCTURE_COMPONENT tireLgtSlip tFactor 216 MATRIX_DIM 4 SYMBOL_TYPE_LINK "tireLgtSlip" /end STRUCTURE_COMPONENT
 /begin STRUCTURE_COMPONENT whlRefLnrSpdEstimd tMetrePerSecond 232 MATRIX_DIM 4 SYMBOL_TYPE_LINK "whlRefLnrSpdEstimd" /end STRUCTURE_COMPONENT
 /begin STRUCTURE_COMPONENT vehVelLgt tMetrePerSecond 248 SYMBOL_TYPE_LINK "vehVelLgt" /end STRUCTURE_COMPONENT
 /begin STRUCTURE_COMPONENT vehAccelLgt tMetrePerSquareSecond 252 SYMBOL_TYPE_LINK "vehAccelLgt" /end STRUCTURE_COMPONENT
 /begin STRUCTURE_COMPONENT vehSideslipAg tRadian 256 SYMBOL_TYPE_LINK "vehSideslipAg" /end STRUCTURE_COMPONENT
 /begin STRUCTURE_COMPONENT roadGrdt tRadian 260 SYMBOL_TYPE_LINK "roadGrdt" /end STRUCTURE_COMPONENT
 /begin STRUCTURE_COMPONENT roadGrdtQ tQualifier 264 SYMBOL_TYPE_LINK "roadGrdtQ" /end STRUCTURE_COMPONENT
 /begin STRUCTURE_COMPONENT vehAccelLgtQ tQualifier 268 SYMBOL_TYPE_LINK "vehAccelLgtQ" /end STRUCTURE_COMPONENT
 /begin STRUCTURE_COMPONENT vehSideslipAgQ tQualifier 272 SYMBOL_TYPE_LINK "vehSideslipAgQ" /end STRUCTURE_COMPONENT
 /begin STRUCTURE_COMPONENT vehVelLgtQ tQualifier 276 SYMBOL_TYPE_LINK "vehVelLgtQ" /end STRUCTURE_COMPONENT
 /begin STRUCTURE_COMPONENT tireMdlParam TireMdlPacejkaParam 280 MATRIX_DIM 4 SYMBOL_TYPE_LINK "tireMdlParam" /end STRUCTURE_COMPONENT
 /begin STRUCTURE_COMPONENT tireMaxLgtSlip tFactor 616 MATRIX_DIM 4 SYMBOL_TYPE_LINK "tireMaxLgtSlip" /end STRUCTURE_COMPONENT
 /begin STRUCTURE_COMPONENT tireMaxLgtF tNewton 632 MATRIX_DIM 4 SYMBOL_TYPE_LINK "tireMaxLgtF" /end STRUCTURE_COMPONENT
 /begin STRUCTURE_COMPONENT tireMaxLgtFPure tNewton 648 MATRIX_DIM 4 SYMBOL_TYPE_LINK "tireMaxLgtFPure" /end STRUCTURE_COMPONENT
 /begin STRUCTURE_COMPONENT coastDownDrgWhlTq tNewtonMetre 664 SYMBOL_TYPE_LINK "coastDownDrgWhlTq" /end STRUCTURE_COMPONENT
 /begin STRUCTURE_COMPONENT drvgDtLossPropshTqTot tNewtonMetre 668 SYMBOL_TYPE_LINK "drvgDtLossPropshTqTot" /end STRUCTURE_COMPONENT
 /begin STRUCTURE_COMPONENT roadGrdtResWhlTq tNewtonMetre 672 SYMBOL_TYPE_LINK "roadGrdtResWhlTq" /end STRUCTURE_COMPONENT
 /begin STRUCTURE_COMPONENT rollgResWhlTq tNewtonMetre 676 SYMBOL_TYPE_LINK "rollgResWhlTq" /end STRUCTURE_COMPONENT
 /begin STRUCTURE_COMPONENT steerAg tDegree 680 SYMBOL_TYPE_LINK "steerAg" /end STRUCTURE_COMPONENT
 /begin STRUCTURE_COMPONENT steerAgRate tDegreePerSecond 684 SYMBOL_TYPE_LINK "steerAgRate" /end STRUCTURE_COMPONENT
 /begin STRUCTURE_COMPONENT steerSnsrQ tQualifier 688 SYMBOL_TYPE_LINK "steerSnsrQ" /end STRUCTURE_COMPONENT
/end TYPEDEF_STRUCTURE
/begin TYPEDEF_STRUCTURE HybridInternalVars "" 0x28 SYMBOL_TYPE_LINK "HybridInternalVars" /begin STRUCTURE_COMPONENT invEnableCmd _Bool 0 SYMBOL_TYPE_LINK "invEnableCmd" /end STRUCTURE_COMPONENT /begin STRUCTURE_COMPONENT motorEnableCmd _Bool 1 SYMBOL_TYPE_LINK "motorEnableCmd" /end STRUCTURE_COMPONENT /begin STRUCTURE_COMPONENT invShutdownCmd _Bool 2 SYMBOL_TYPE_LINK "invShutdownCmd" /end STRUCTURE_COMPONENT /begin STRUCTURE_COMPONENT inverterOnline _Bool 3 SYMBOL_TYPE_LINK "inverterOnline" /end STRUCTURE_COMPONENT /begin STRUCTURE_COMPONENT invState tInvSmStatus 4 SYMBOL_TYPE_LINK "invState" /end STRUCTURE_COMPONENT /begin STRUCTURE_COMPONENT invDirection _Bool 8 SYMBOL_TYPE_LINK "invDirection" /end STRUCTURE_COMPONENT /begin STRUCTURE_COMPONENT invDcVoltage tVolt 12 SYMBOL_TYPE_LINK "invDcVoltage" /end STRUCTURE_COMPONENT /begin STRUCTURE_COMPONENT bmsState tBMSState 16 SYMBOL_TYPE_LINK "bmsState" /end STRUCTURE_COMPONENT /begin STRUCTURE_COMPONENT hybState tHybSmState 20 SYMBOL_TYPE_LINK "hybState" /end STRUCTURE_COMPONENT
 /begin STRUCTURE_COMPONENT virtualBattVltg tVolt 24 SYMBOL_TYPE_LINK "virtualBattVltg" /end STRUCTURE_COMPONENT
 /begin STRUCTURE_COMPONENT virtualBattCrnt tAmpere 28 SYMBOL_TYPE_LINK "virtualBattCrnt" /end STRUCTURE_COMPONENT
 /begin STRUCTURE_COMPONENT virtualBattCp tAmpereHour 32 SYMBOL_TYPE_LINK "virtualBattCp" /end STRUCTURE_COMPONENT
 /begin STRUCTURE_COMPONENT virtualSocPrc tPercent_S8 36 SYMBOL_TYPE_LINK "virtualSocPrc" /end STRUCTURE_COMPONENT
/end TYPEDEF_STRUCTURE
/begin TYPEDEF_STRUCTURE DynamicsDmrCtx "" 0xA8 SYMBOL_TYPE_LINK "DynamicsDmrCtx" /begin STRUCTURE_COMPONENT bAccBtnLongPsd _Bool 0 SYMBOL_TYPE_LINK "bAccBtnLongPsd" /end STRUCTURE_COMPONENT /begin STRUCTURE_COMPONENT bAccBtnShoPsd _Bool 1 SYMBOL_TYPE_LINK "bAccBtnShoPsd" /end STRUCTURE_COMPONENT /begin STRUCTURE_COMPONENT bAccBtnUnavl _Bool 2 SYMBOL_TYPE_LINK "bAccBtnUnavl" /end STRUCTURE_COMPONENT
 /begin STRUCTURE_COMPONENT bAccScrollBtnLongPsd _Bool 3 SYMBOL_TYPE_LINK "bAccScrollBtnLongPsd" /end STRUCTURE_COMPONENT
 /begin STRUCTURE_COMPONENT bAccScrollBtnShoPsd _Bool 4 SYMBOL_TYPE_LINK "bAccScrollBtnShoPsd" /end STRUCTURE_COMPONENT
 /begin STRUCTURE_COMPONENT bAccScrollBtnUnavl _Bool 5 SYMBOL_TYPE_LINK "bAccScrollBtnUnavl" /end STRUCTURE_COMPONENT
 /begin STRUCTURE_COMPONENT bAhhBrkPReqEna _Bool 6 SYMBOL_TYPE_LINK "bAhhBrkPReqEna" /end STRUCTURE_COMPONENT
 /begin STRUCTURE_COMPONENT bAutoModActv _Bool 7 SYMBOL_TYPE_LINK "bAutoModActv" /end STRUCTURE_COMPONENT
 /begin STRUCTURE_COMPONENT bDrvrElecDrvDesired _Bool 8 SYMBOL_TYPE_LINK "bDrvrElecDrvDesired" /end STRUCTURE_COMPONENT
 /begin STRUCTURE_COMPONENT bHoldIgnOnReq _Bool 9 SYMBOL_TYPE_LINK "bHoldIgnOnReq" /end STRUCTURE_COMPONENT
 /begin STRUCTURE_COMPONENT bManModActv _Bool 10 SYMBOL_TYPE_LINK "bManModActv" /end STRUCTURE_COMPONENT
 /begin STRUCTURE_COMPONENT perfModAutoShift tAutoShiftMode 12 SYMBOL_TYPE_LINK "perfModAutoShift" /end STRUCTURE_COMPONENT
 /begin STRUCTURE_COMPONENT ahhBrkPReq tBar_10_S16 16 MATRIX_DIM 4 SYMBOL_TYPE_LINK "ahhBrkPReq" /end STRUCTURE_COMPONENT
 /begin STRUCTURE_COMPONENT brkLiReq tBrakeLightRequest 24 SYMBOL_TYPE_LINK "brkLiReq" /end STRUCTURE_COMPONENT
 /begin STRUCTURE_COMPONENT chgModReqIEB tChangeModeEnableIEB 28 SYMBOL_TYPE_LINK "chgModReqIEB" /end STRUCTURE_COMPONENT
 /begin STRUCTURE_COMPONENT drvCfgReq tDriveConfiguration 32 SYMBOL_TYPE_LINK "drvCfgReq" /end STRUCTURE_COMPONENT
 /begin STRUCTURE_COMPONENT drvMod tDriveMode 36 SYMBOL_TYPE_LINK "drvMod" /end STRUCTURE_COMPONENT
 /begin STRUCTURE_COMPONENT autoHoldStSwtFb tEnableState 40 SYMBOL_TYPE_LINK "autoHoldStSwtFb" /end STRUCTURE_COMPONENT
 /begin STRUCTURE_COMPONENT driftModSt tEnableState 44 SYMBOL_TYPE_LINK "driftModSt" /end STRUCTURE_COMPONENT
 /begin STRUCTURE_COMPONENT tireMdlFricCoeffEstimnEna tEnableState 48 SYMBOL_TYPE_LINK "tireMdlFricCoeffEstimnEna" /end STRUCTURE_COMPONENT
 /begin STRUCTURE_COMPONENT tireMdlTireMaxFRednFacEna tEnableState 52 SYMBOL_TYPE_LINK "tireMdlTireMaxFRednFacEna" /end STRUCTURE_COMPONENT
 /begin STRUCTURE_COMPONENT hndlgAttdMod tHandlingAttitudeMode 56 SYMBOL_TYPE_LINK "hndlgAttdMod" /end STRUCTURE_COMPONENT
 /begin STRUCTURE_COMPONENT lcStMac tLaunchControlStMac 60 SYMBOL_TYPE_LINK "lcStMac" /end STRUCTURE_COMPONENT
 /begin STRUCTURE_COMPONENT lcSts tLaunchControlMode 64 SYMBOL_TYPE_LINK "lcSts" /end STRUCTURE_COMPONENT
 /begin STRUCTURE_COMPONENT prkgBrkReq tParkingBrakeRequest 68 SYMBOL_TYPE_LINK "prkgBrkReq" /end STRUCTURE_COMPONENT
 /begin STRUCTURE_COMPONENT perfModPedlMap tPedalMapMode 72 SYMBOL_TYPE_LINK "perfModPedlMap" /end STRUCTURE_COMPONENT
 /begin STRUCTURE_COMPONENT perfMod tPerformanceMode 76 SYMBOL_TYPE_LINK "perfMod" /end STRUCTURE_COMPONENT
 /begin STRUCTURE_COMPONENT perfModReq tPerformanceMode 80 SYMBOL_TYPE_LINK "perfModReq" /end STRUCTURE_COMPONENT
 /begin STRUCTURE_COMPONENT perfModReqDDC tPerformanceModeDDC 84 SYMBOL_TYPE_LINK "perfModReqDDC" /end STRUCTURE_COMPONENT
 /begin STRUCTURE_COMPONENT perfModReqEPS tPerformanceModeEPS 88 SYMBOL_TYPE_LINK "perfModReqEPS" /end STRUCTURE_COMPONENT
 /begin STRUCTURE_COMPONENT perfModReqRHC tPerformanceModeRHC 92 SYMBOL_TYPE_LINK "perfModReqRHC" /end STRUCTURE_COMPONENT
 /begin STRUCTURE_COMPONENT perfModSpdLim tPerformanceModeSpeedLimiter 96 SYMBOL_TYPE_LINK "perfModSpdLim" /end STRUCTURE_COMPONENT
 /begin STRUCTURE_COMPONENT perfModSt tPerformanceModeSwitchState 100 SYMBOL_TYPE_LINK "perfModSt" /end STRUCTURE_COMPONENT
 /begin STRUCTURE_COMPONENT perfModTPMS tPerformanceModeTPMS 104 SYMBOL_TYPE_LINK "perfModTPMS" /end STRUCTURE_COMPONENT
 /begin STRUCTURE_COMPONENT perfModReqVDC tPerformanceModeVDC 108 SYMBOL_TYPE_LINK "perfModReqVDC" /end STRUCTURE_COMPONENT
 /begin STRUCTURE_COMPONENT perfStgyReq tPerformanceStrategy 112 SYMBOL_TYPE_LINK "perfStgyReq" /end STRUCTURE_COMPONENT
 /begin STRUCTURE_COMPONENT prplModReq tPropulsionMode 116 SYMBOL_TYPE_LINK "prplModReq" /end STRUCTURE_COMPONENT
 /begin STRUCTURE_COMPONENT ahhBrkPReqQ tQualifier 120 MATRIX_DIM 4 SYMBOL_TYPE_LINK "ahhBrkPReqQ" /end STRUCTURE_COMPONENT
 /begin STRUCTURE_COMPONENT perfModRgnMod tRegenMode 136 SYMBOL_TYPE_LINK "perfModRgnMod" /end STRUCTURE_COMPONENT
 /begin STRUCTURE_COMPONENT suppgMod tSupportingMode 140 SYMBOL_TYPE_LINK "suppgMod" /end STRUCTURE_COMPONENT
 /begin STRUCTURE_COMPONENT tracCtrlMod tTractionControlMode 144 SYMBOL_TYPE_LINK "tracCtrlMod" /end STRUCTURE_COMPONENT
 /begin STRUCTURE_COMPONENT yawTqReqMod tYawTorqueRequestMode 148 SYMBOL_TYPE_LINK "yawTqReqMod" /end STRUCTURE_COMPONENT
 /begin STRUCTURE_COMPONENT liftBtnPsdCnt uint8_t 152 SYMBOL_TYPE_LINK "liftBtnPsdCnt" /end STRUCTURE_COMPONENT
 /begin STRUCTURE_COMPONENT perfModRejctdMask uint8_t 153 SYMBOL_TYPE_LINK "perfModRejctdMask" /end STRUCTURE_COMPONENT
 /begin STRUCTURE_COMPONENT lcReqAllwdInfoMsg uint8_t 154 SYMBOL_TYPE_LINK "lcReqAllwdInfoMsg" /end STRUCTURE_COMPONENT
 /begin STRUCTURE_COMPONENT lcAbortRsnInfoMsg uint16_t 156 SYMBOL_TYPE_LINK "lcAbortRsnInfoMsg" /end STRUCTURE_COMPONENT
 /begin STRUCTURE_COMPONENT tireMdl tTireModel 160 SYMBOL_TYPE_LINK "tireMdl" /end STRUCTURE_COMPONENT
 /begin STRUCTURE_COMPONENT fdbSteer tHapticFeedbackSteering 164 SYMBOL_TYPE_LINK "fdbSteer" /end STRUCTURE_COMPONENT
/end TYPEDEF_STRUCTURE
/begin TYPEDEF_STRUCTURE TqStructCtx "" 0xE8 SYMBOL_TYPE_LINK "TqStructCtx"
 /begin STRUCTURE_COMPONENT bHybDrvTakeoffRdy _Bool 0 SYMBOL_TYPE_LINK "bHybDrvTakeoffRdy" /end STRUCTURE_COMPONENT
 /begin STRUCTURE_COMPONENT bPropshStatyCrkFinished _Bool 1 SYMBOL_TYPE_LINK "bPropshStatyCrkFinished" /end STRUCTURE_COMPONENT
 /begin STRUCTURE_COMPONENT brkPReq tBar 4 MATRIX_DIM 4 SYMBOL_TYPE_LINK "brkPReq" /end STRUCTURE_COMPONENT
 /begin STRUCTURE_COMPONENT cenCluStReq tClutchState 20 SYMBOL_TYPE_LINK "cenCluStReq" /end STRUCTURE_COMPONENT
 /begin STRUCTURE_COMPONENT vehVelLimDt tKilometrePerHour_10_S16 24 SYMBOL_TYPE_LINK "vehVelLimDt" /end STRUCTURE_COMPONENT
 /begin STRUCTURE_COMPONENT cenCluTqReqAbslt tNewtonMetre 28 SYMBOL_TYPE_LINK "cenCluTqReqAbslt" /end STRUCTURE_COMPONENT
 /begin STRUCTURE_COMPONENT drvrWhlTqBrkPedlDtAct tNewtonMetre 32 SYMBOL_TYPE_LINK "drvrWhlTqBrkPedlDtAct" /end STRUCTURE_COMPONENT
 /begin STRUCTURE_COMPONENT propshRateCtrlTqReqIntglLimitRamped tNewtonMetre 36 SYMBOL_TYPE_LINK "propshRateCtrlTqReqIntglLimitRamped" /end STRUCTURE_COMPONENT
 /begin STRUCTURE_COMPONENT propshTqReqDtTot tNewtonMetre 40 SYMBOL_TYPE_LINK "propshTqReqDtTot" /end STRUCTURE_COMPONENT
 /begin STRUCTURE_COMPONENT propshTqReqTot tNewtonMetre 44 SYMBOL_TYPE_LINK "propshTqReqTot" /end STRUCTURE_COMPONENT
 /begin STRUCTURE_COMPONENT whlTqReqFricBrk tNewtonMetre 48 MATRIX_DIM 4 SYMBOL_TYPE_LINK "whlTqReqFricBrk" /end STRUCTURE_COMPONENT
 /begin STRUCTURE_COMPONENT pReqRsn tPressureReqRsn 64 SYMBOL_TYPE_LINK "pReqRsn" /end STRUCTURE_COMPONENT
 /begin STRUCTURE_COMPONENT propshDrvgCrkSt tPropshaftDrivingCrankState 68 SYMBOL_TYPE_LINK "propshDrvgCrkSt" /end STRUCTURE_COMPONENT
 /begin STRUCTURE_COMPONENT propshStatyCrkSt tPropshaftStationaryCrankState 72 SYMBOL_TYPE_LINK "propshStatyCrkSt" /end STRUCTURE_COMPONENT
 /begin STRUCTURE_COMPONENT brkPReqQ tQualifier 76 MATRIX_DIM 4 SYMBOL_TYPE_LINK "brkPReqQ" /end STRUCTURE_COMPONENT
 /begin STRUCTURE_COMPONENT cenCluSpdSlipQ tQualifier 92 SYMBOL_TYPE_LINK "cenCluSpdSlipQ" /end STRUCTURE_COMPONENT
 /begin STRUCTURE_COMPONENT drvrWhlTqBrkPedlDtActQ tQualifier 96 SYMBOL_TYPE_LINK "drvrWhlTqBrkPedlDtActQ" /end STRUCTURE_COMPONENT
 /begin STRUCTURE_COMPONENT propshRateTar tRadianPerSecond 100 SYMBOL_TYPE_LINK "propshRateTar" /end STRUCTURE_COMPONENT
 /begin STRUCTURE_COMPONENT propshRateDrvgTarPos tRadianPerSecond 104 SYMBOL_TYPE_LINK "propshRateDrvgTarPos" /end STRUCTURE_COMPONENT
 /begin STRUCTURE_COMPONENT whlCluRateMinSlipTar tRadianPerSecond 108 MATRIX_DIM 4 SYMBOL_TYPE_LINK "whlCluRateMinSlipTar" /end STRUCTURE_COMPONENT
 /begin STRUCTURE_COMPONENT whlCluRateOuterMax tRadianPerSecond 124 MATRIX_DIM 4 SYMBOL_TYPE_LINK "whlCluRateOuterMax" /end STRUCTURE_COMPONENT
 /begin STRUCTURE_COMPONENT cenCluSpdSlipAbs tRevolutionPerMinute 140 SYMBOL_TYPE_LINK "cenCluSpdSlipAbs" /end STRUCTURE_COMPONENT
 /begin STRUCTURE_COMPONENT iceSpdReqMin tRevolutionPerMinute_S16 144 SYMBOL_TYPE_LINK "iceSpdReqMin" /end STRUCTURE_COMPONENT
 /begin STRUCTURE_COMPONENT dtTqSign tSign 148 SYMBOL_TYPE_LINK "dtTqSign" /end STRUCTURE_COMPONENT
 /begin STRUCTURE_COMPONENT takeoffSt tTakeoffState 152 SYMBOL_TYPE_LINK "takeoffSt" /end STRUCTURE_COMPONENT
 /begin STRUCTURE_COMPONENT bElecChrgTqAllwd _Bool 156 SYMBOL_TYPE_LINK "bElecChrgTqAllwd" /end STRUCTURE_COMPONENT
 /begin STRUCTURE_COMPONENT bForcedChrgActv _Bool 157 SYMBOL_TYPE_LINK "bForcedChrgActv" /end STRUCTURE_COMPONENT
 /begin STRUCTURE_COMPONENT bInvCtrlStPlaus _Bool 158 SYMBOL_TYPE_LINK "bInvCtrlStPlaus" /end STRUCTURE_COMPONENT
 /begin STRUCTURE_COMPONENT bPropshPumpCtrlFlt _Bool 159 SYMBOL_TYPE_LINK "bPropshPumpCtrlFlt" /end STRUCTURE_COMPONENT
 /begin STRUCTURE_COMPONENT bPropshPumpCtrlRun _Bool 160 SYMBOL_TYPE_LINK "bPropshPumpCtrlRun" /end STRUCTURE_COMPONENT
 /begin STRUCTURE_COMPONENT iceSpdReqV _Bool 161 SYMBOL_TYPE_LINK "iceSpdReqV" /end STRUCTURE_COMPONENT
 /begin STRUCTURE_COMPONENT iceCtrlStReq tCombustionEngineControlState 164 SYMBOL_TYPE_LINK "iceCtrlStReq" /end STRUCTURE_COMPONENT
 /begin STRUCTURE_COMPONENT invCtrlStReq tInvCtrlMode 168 SYMBOL_TYPE_LINK "invCtrlStReq" /end STRUCTURE_COMPONENT
 /begin STRUCTURE_COMPONENT invSpdCtrlGainSet tInvSpdCtrlGainSet 172 SYMBOL_TYPE_LINK "invSpdCtrlGainSet" /end STRUCTURE_COMPONENT
 /begin STRUCTURE_COMPONENT elecMotTqReq tNewtonMetre 176 SYMBOL_TYPE_LINK "elecMotTqReq" /end STRUCTURE_COMPONENT
 /begin STRUCTURE_COMPONENT iceTqReqFast tNewtonMetre 180 SYMBOL_TYPE_LINK "iceTqReqFast" /end STRUCTURE_COMPONENT
 /begin STRUCTURE_COMPONENT iceTqReqSlow tNewtonMetre 184 SYMBOL_TYPE_LINK "iceTqReqSlow" /end STRUCTURE_COMPONENT
 /begin STRUCTURE_COMPONENT propshTqAvlFromElecMotMax tNewtonMetre 188 SYMBOL_TYPE_LINK "propshTqAvlFromElecMotMax" /end STRUCTURE_COMPONENT
 /begin STRUCTURE_COMPONENT propshTqAvlFromElecMotMin tNewtonMetre 192 SYMBOL_TYPE_LINK "propshTqAvlFromElecMotMin" /end STRUCTURE_COMPONENT
 /begin STRUCTURE_COMPONENT elecMotSpdReq tRevolutionPerMinute_S16 196 SYMBOL_TYPE_LINK "elecMotSpdReq" /end STRUCTURE_COMPONENT
 /begin STRUCTURE_COMPONENT iceSpdReq tRevolutionPerMinute_S16 198 SYMBOL_TYPE_LINK "iceSpdReq" /end STRUCTURE_COMPONENT
 /begin STRUCTURE_COMPONENT whlCluStReq tClutchState 200 MATRIX_DIM 4 SYMBOL_TYPE_LINK "whlCluStReq" /end STRUCTURE_COMPONENT
 /begin STRUCTURE_COMPONENT whlCluTqReqAbslt tNewtonMetre 216 MATRIX_DIM 4 SYMBOL_TYPE_LINK "whlCluTqReqAbslt" /end STRUCTURE_COMPONENT
/end TYPEDEF_STRUCTURE
/begin TYPEDEF_STRUCTURE CanAMsgTimeoutCtx "" 0x8 SYMBOL_TYPE_LINK "CanAMsgTimeoutCtx"
 /begin STRUCTURE_COMPONENT canAMsgTimeoutIdx tCanATimeoutIndex 0 SYMBOL_TYPE_LINK "canAMsgTimeoutIdx" /end STRUCTURE_COMPONENT
 /begin STRUCTURE_COMPONENT msgTimeoutCnt uint16_t 4 SYMBOL_TYPE_LINK "msgTimeoutCnt" /end STRUCTURE_COMPONENT
/end TYPEDEF_STRUCTURE
/begin TYPEDEF_STRUCTURE PerfModTmrCtx "" 0x20 SYMBOL_TYPE_LINK "PerfModTmrCtx" /begin STRUCTURE_COMPONENT ddcTmr tMillisecond_U32 0 SYMBOL_TYPE_LINK "ddcTmr" /end STRUCTURE_COMPONENT /begin STRUCTURE_COMPONENT epsTmr tMillisecond_U32 4 SYMBOL_TYPE_LINK "epsTmr" /end STRUCTURE_COMPONENT
 /begin STRUCTURE_COMPONENT perfModCptReqHoldTmr tMillisecond_U32 8 SYMBOL_TYPE_LINK "perfModCptReqHoldTmr" /end STRUCTURE_COMPONENT
 /begin STRUCTURE_COMPONENT perfModReqHoldTmr tMillisecond_U32 12 SYMBOL_TYPE_LINK "perfModReqHoldTmr" /end STRUCTURE_COMPONENT
 /begin STRUCTURE_COMPONENT perfModReqPndStTmr tMillisecond_U32 16 SYMBOL_TYPE_LINK "perfModReqPndStTmr" /end STRUCTURE_COMPONENT
 /begin STRUCTURE_COMPONENT perfModReqRejctdTmr tMillisecond_U32 20 SYMBOL_TYPE_LINK "perfModReqRejctdTmr" /end STRUCTURE_COMPONENT
 /begin STRUCTURE_COMPONENT prplModTmr tMillisecond_U32 24 SYMBOL_TYPE_LINK "prplModTmr" /end STRUCTURE_COMPONENT
 /begin STRUCTURE_COMPONENT rhcTmr tMillisecond_U32 28 SYMBOL_TYPE_LINK "rhcTmr" /end STRUCTURE_COMPONENT
/end TYPEDEF_STRUCTURE
/begin TYPEDEF_STRUCTURE CanBMsgTimeoutCtx "" 0x8 SYMBOL_TYPE_LINK "CanBMsgTimeoutCtx"
 /begin STRUCTURE_COMPONENT canBMsgTimeoutIdx tCanBTimeoutIndex 0 SYMBOL_TYPE_LINK "canBMsgTimeoutIdx" /end STRUCTURE_COMPONENT
 /begin STRUCTURE_COMPONENT msgTimeoutCnt uint16_t 4 SYMBOL_TYPE_LINK "msgTimeoutCnt" /end STRUCTURE_COMPONENT
/end TYPEDEF_STRUCTURE
/begin TYPEDEF_STRUCTURE CanCMsgTimeoutCtx "" 0x8 SYMBOL_TYPE_LINK "CanCMsgTimeoutCtx"
 /begin STRUCTURE_COMPONENT canCMsgTimeoutIdx tCanCTimeoutIndex 0 SYMBOL_TYPE_LINK "canCMsgTimeoutIdx" /end STRUCTURE_COMPONENT
 /begin STRUCTURE_COMPONENT msgTimeoutCnt uint16_t 4 SYMBOL_TYPE_LINK "msgTimeoutCnt" /end STRUCTURE_COMPONENT
/end TYPEDEF_STRUCTURE
/begin TYPEDEF_STRUCTURE CanDMsgTimeoutCtx "" 0x8 SYMBOL_TYPE_LINK "CanDMsgTimeoutCtx"
 /begin STRUCTURE_COMPONENT canDMsgTimeoutIdx tCanDTimeoutIndex 0 SYMBOL_TYPE_LINK "canDMsgTimeoutIdx" /end STRUCTURE_COMPONENT
 /begin STRUCTURE_COMPONENT msgTimeoutCnt uint16_t 4 SYMBOL_TYPE_LINK "msgTimeoutCnt" /end STRUCTURE_COMPONENT
/end TYPEDEF_STRUCTURE
/begin TYPEDEF_STRUCTURE SuspFltBitfield "" 0x4 SYMBOL_TYPE_LINK "SuspFltBitfield" /begin STRUCTURE_COMPONENT suspFltFlag SuspFltFlag 0 SYMBOL_TYPE_LINK "suspFltFlag" /end STRUCTURE_COMPONENT /begin STRUCTURE_COMPONENT suspFltMask tHex_U32 0 SYMBOL_TYPE_LINK "suspFltMask" /end STRUCTURE_COMPONENT /end TYPEDEF_STRUCTURE
/begin TYPEDEF_STRUCTURE CanEMsgTimeoutCtx "" 0x8 SYMBOL_TYPE_LINK "CanEMsgTimeoutCtx"
 /begin STRUCTURE_COMPONENT canEMsgTimeoutIdx tCanETimeoutIndex 0 SYMBOL_TYPE_LINK "canEMsgTimeoutIdx" /end STRUCTURE_COMPONENT
 /begin STRUCTURE_COMPONENT msgTimeoutCnt uint16_t 4 SYMBOL_TYPE_LINK "msgTimeoutCnt" /end STRUCTURE_COMPONENT
/end TYPEDEF_STRUCTURE
/begin TYPEDEF_STRUCTURE CanFMsgTimeoutCtx "" 0x8 SYMBOL_TYPE_LINK "CanFMsgTimeoutCtx"
 /begin STRUCTURE_COMPONENT canFMsgTimeoutIdx tCanFTimeoutIndex 0 SYMBOL_TYPE_LINK "canFMsgTimeoutIdx" /end STRUCTURE_COMPONENT
 /begin STRUCTURE_COMPONENT msgTimeoutCnt uint16_t 4 SYMBOL_TYPE_LINK "msgTimeoutCnt" /end STRUCTURE_COMPONENT
/end TYPEDEF_STRUCTURE
/begin TYPEDEF_STRUCTURE TpmsEcuFltFlag "" 0x1 SYMBOL_TYPE_LINK "TpmsEcuFltFlag" /begin STRUCTURE_COMPONENT reserved uint8_t_0xC0 0 SYMBOL_TYPE_LINK "reserved" /end STRUCTURE_COMPONENT /begin STRUCTURE_COMPONENT ecuTErr uint8_t_0x20 0 SYMBOL_TYPE_LINK "ecuTErr" /end STRUCTURE_COMPONENT /begin STRUCTURE_COMPONENT ecuUErr uint8_t_0x10 0 SYMBOL_TYPE_LINK "ecuUErr" /end STRUCTURE_COMPONENT
 /begin STRUCTURE_COMPONENT ecuHeartbeatFrzn uint8_t_0x8 0 SYMBOL_TYPE_LINK "ecuHeartbeatFrzn" /end STRUCTURE_COMPONENT
 /begin STRUCTURE_COMPONENT ecuTiout uint8_t_0x4 0 SYMBOL_TYPE_LINK "ecuTiout" /end STRUCTURE_COMPONENT
 /begin STRUCTURE_COMPONENT carDataTiout uint8_t_0x2 0 SYMBOL_TYPE_LINK "carDataTiout" /end STRUCTURE_COMPONENT
 /begin STRUCTURE_COMPONENT noFlt uint8_t_0x1 0 SYMBOL_TYPE_LINK "noFlt" /end STRUCTURE_COMPONENT
/end TYPEDEF_STRUCTURE
/begin TYPEDEF_STRUCTURE xSTATIC_MINI_LIST_ITEM "" 0xC SYMBOL_TYPE_LINK "xSTATIC_MINI_LIST_ITEM" /begin STRUCTURE_COMPONENT xDummy2 TickType_t 0 SYMBOL_TYPE_LINK "xDummy2" /end STRUCTURE_COMPONENT /end TYPEDEF_STRUCTURE
/begin TYPEDEF_STRUCTURE TpmsSnsrFltFlag "" 0x1 SYMBOL_TYPE_LINK "TpmsSnsrFltFlag"
 /begin STRUCTURE_COMPONENT wsCombdHwErr uint8_t_0x80 0 SYMBOL_TYPE_LINK "wsCombdHwErr" /end STRUCTURE_COMPONENT
 /begin STRUCTURE_COMPONENT wsNotDetd uint8_t_0x40 0 SYMBOL_TYPE_LINK "wsNotDetd" /end STRUCTURE_COMPONENT
 /begin STRUCTURE_COMPONENT wsNotCfmd uint8_t_0x20 0 SYMBOL_TYPE_LINK "wsNotCfmd" /end STRUCTURE_COMPONENT
 /begin STRUCTURE_COMPONENT wsSecuMismatch uint8_t_0x10 0 SYMBOL_TYPE_LINK "wsSecuMismatch" /end STRUCTURE_COMPONENT
 /begin STRUCTURE_COMPONENT wsSnsrFltGroup uint8_t_0x8 0 SYMBOL_TYPE_LINK "wsSnsrFltGroup" /end STRUCTURE_COMPONENT
 /begin STRUCTURE_COMPONENT tErr uint8_t_0x4 0 SYMBOL_TYPE_LINK "tErr" /end STRUCTURE_COMPONENT
 /begin STRUCTURE_COMPONENT pErr uint8_t_0x2 0 SYMBOL_TYPE_LINK "pErr" /end STRUCTURE_COMPONENT
 /begin STRUCTURE_COMPONENT noFault uint8_t_0x1 0 SYMBOL_TYPE_LINK "noFault" /end STRUCTURE_COMPONENT
/end TYPEDEF_STRUCTURE
/begin TYPEDEF_STRUCTURE CanNodeTimeoutFlg "" 0x4 SYMBOL_TYPE_LINK "CanNodeTimeoutFlg" /begin STRUCTURE_COMPONENT tpmsRe uint32_t_0x200000 0 SYMBOL_TYPE_LINK "tpmsRe" /end STRUCTURE_COMPONENT /begin STRUCTURE_COMPONENT tpmsFrnt uint32_t_0x100000 0 SYMBOL_TYPE_LINK "tpmsFrnt" /end STRUCTURE_COMPONENT /begin STRUCTURE_COMPONENT scu uint32_t_0x80000 0 SYMBOL_TYPE_LINK "scu" /end STRUCTURE_COMPONENT /begin STRUCTURE_COMPONENT lstt uint32_t_0x40000 0 SYMBOL_TYPE_LINK "lstt" /end STRUCTURE_COMPONENT /begin STRUCTURE_COMPONENT lpdm3 uint32_t_0x20000 0 SYMBOL_TYPE_LINK "lpdm3" /end STRUCTURE_COMPONENT /begin STRUCTURE_COMPONENT lpdm2 uint32_t_0x10000 0 SYMBOL_TYPE_LINK "lpdm2" /end STRUCTURE_COMPONENT /begin STRUCTURE_COMPONENT lpdm1 uint32_t_0x8000 0 SYMBOL_TYPE_LINK "lpdm1" /end STRUCTURE_COMPONENT /begin STRUCTURE_COMPONENT inv uint32_t_0x4000 0 SYMBOL_TYPE_LINK "inv" /end STRUCTURE_COMPONENT /begin STRUCTURE_COMPONENT imu uint32_t_0x2000 0 SYMBOL_TYPE_LINK "imu" /end STRUCTURE_COMPONENT /begin STRUCTURE_COMPONENT ieb uint32_t_0x1000 0 SYMBOL_TYPE_LINK "ieb" /end STRUCTURE_COMPONENT /begin STRUCTURE_COMPONENT hubDyno uint32_t_0x800 0 SYMBOL_TYPE_LINK "hubDyno" /end STRUCTURE_COMPONENT /begin STRUCTURE_COMPONENT hpdm4 uint32_t_0x400 0 SYMBOL_TYPE_LINK "hpdm4" /end STRUCTURE_COMPONENT /begin STRUCTURE_COMPONENT hpdm3 uint32_t_0x200 0 SYMBOL_TYPE_LINK "hpdm3" /end STRUCTURE_COMPONENT /begin STRUCTURE_COMPONENT hpdm2 uint32_t_0x100 0 SYMBOL_TYPE_LINK "hpdm2" /end STRUCTURE_COMPONENT /begin STRUCTURE_COMPONENT hpdm1 uint32_t_0x80 0 SYMBOL_TYPE_LINK "hpdm1" /end STRUCTURE_COMPONENT /begin STRUCTURE_COMPONENT eps uint32_t_0x40 0 SYMBOL_TYPE_LINK "eps" /end STRUCTURE_COMPONENT /begin STRUCTURE_COMPONENT ecm uint32_t_0x20 0 SYMBOL_TYPE_LINK "ecm" /end STRUCTURE_COMPONENT /begin STRUCTURE_COMPONENT ddc uint32_t_0x10 0 SYMBOL_TYPE_LINK "ddc" /end STRUCTURE_COMPONENT /begin STRUCTURE_COMPONENT dcdc uint32_t_0x8 0 SYMBOL_TYPE_LINK "dcdc" /end STRUCTURE_COMPONENT /begin STRUCTURE_COMPONENT slipring uint32_t_0x4 0 SYMBOL_TYPE_LINK "slipring" /end STRUCTURE_COMPONENT /begin STRUCTURE_COMPONENT acc uint32_t_0x2 0 SYMBOL_TYPE_LINK "acc" /end STRUCTURE_COMPONENT /end TYPEDEF_STRUCTURE
/begin TYPEDEF_STRUCTURE EnvtTi "" 0x8 SYMBOL_TYPE_LINK "EnvtTi" /begin STRUCTURE_COMPONENT yr uint16_t 0 SYMBOL_TYPE_LINK "yr" /end STRUCTURE_COMPONENT /begin STRUCTURE_COMPONENT mth uint8_t 2 SYMBOL_TYPE_LINK "mth" /end STRUCTURE_COMPONENT /begin STRUCTURE_COMPONENT day uint8_t 3 SYMBOL_TYPE_LINK "day" /end STRUCTURE_COMPONENT /begin STRUCTURE_COMPONENT hr uint8_t 4 SYMBOL_TYPE_LINK "hr" /end STRUCTURE_COMPONENT /begin STRUCTURE_COMPONENT min uint8_t 5 SYMBOL_TYPE_LINK "min" /end STRUCTURE_COMPONENT /begin STRUCTURE_COMPONENT sec uint8_t 6 SYMBOL_TYPE_LINK "sec" /end STRUCTURE_COMPONENT /end TYPEDEF_STRUCTURE
/begin TYPEDEF_STRUCTURE LnchCtrlReqAllwdFlg "" 0x1 SYMBOL_TYPE_LINK "LnchCtrlReqAllwdFlg" /begin STRUCTURE_COMPONENT engIatHi uint8_t_0x80 0 SYMBOL_TYPE_LINK "engIatHi" /end STRUCTURE_COMPONENT
 /begin STRUCTURE_COMPONENT invCooltTempHi uint8_t_0x40 0 SYMBOL_TYPE_LINK "invCooltTempHi" /end STRUCTURE_COMPONENT
 /begin STRUCTURE_COMPONENT engCooltTempHi uint8_t_0x20 0 SYMBOL_TYPE_LINK "engCooltTempHi" /end STRUCTURE_COMPONENT
 /begin STRUCTURE_COMPONENT lsttOilTempHi uint8_t_0x10 0 SYMBOL_TYPE_LINK "lsttOilTempHi" /end STRUCTURE_COMPONENT
 /begin STRUCTURE_COMPONENT reqInhibTmr uint8_t_0x8 0 SYMBOL_TYPE_LINK "reqInhibTmr" /end STRUCTURE_COMPONENT
 /begin STRUCTURE_COMPONENT brkPedlNotPsd uint8_t_0x4 0 SYMBOL_TYPE_LINK "brkPedlNotPsd" /end STRUCTURE_COMPONENT
 /begin STRUCTURE_COMPONENT vehNonStaty uint8_t_0x2 0 SYMBOL_TYPE_LINK "vehNonStaty" /end STRUCTURE_COMPONENT
 /begin STRUCTURE_COMPONENT abortFlg uint8_t_0x1 0 SYMBOL_TYPE_LINK "abortFlg" /end STRUCTURE_COMPONENT
/end TYPEDEF_STRUCTURE
/begin TYPEDEF_STRUCTURE PerfModCptRejctdFlg "" 0x1 SYMBOL_TYPE_LINK "PerfModCptRejctdFlg"
 /begin STRUCTURE_COMPONENT perfModRejctdEPS uint8_t_0x40 0 SYMBOL_TYPE_LINK "perfModRejctdEPS" /end STRUCTURE_COMPONENT
 /begin STRUCTURE_COMPONENT perfModRejctdDDC uint8_t_0x20 0 SYMBOL_TYPE_LINK "perfModRejctdDDC" /end STRUCTURE_COMPONENT
 /begin STRUCTURE_COMPONENT perfModRejctdRHC uint8_t_0x10 0 SYMBOL_TYPE_LINK "perfModRejctdRHC" /end STRUCTURE_COMPONENT
 /begin STRUCTURE_COMPONENT perfModRejctdPrplMod uint8_t_0x8 0 SYMBOL_TYPE_LINK "perfModRejctdPrplMod" /end STRUCTURE_COMPONENT
 /begin STRUCTURE_COMPONENT perfModRejctd uint8_t_0x4 0 SYMBOL_TYPE_LINK "perfModRejctd" /end STRUCTURE_COMPONENT
/end TYPEDEF_STRUCTURE
/begin TYPEDEF_STRUCTURE SuspFltFlag "" 0x4 SYMBOL_TYPE_LINK "SuspFltFlag" /begin STRUCTURE_COMPONENT reserved uint32_t_0xFFE00000 0 SYMBOL_TYPE_LINK "reserved" /end STRUCTURE_COMPONENT
 /begin STRUCTURE_COMPONENT susp_vlv_err_rrr uint32_t_0x100000 0 SYMBOL_TYPE_LINK "susp_vlv_err_rrr" /end STRUCTURE_COMPONENT
 /begin STRUCTURE_COMPONENT susp_vlv_err_rrc uint32_t_0x80000 0 SYMBOL_TYPE_LINK "susp_vlv_err_rrc" /end STRUCTURE_COMPONENT
 /begin STRUCTURE_COMPONENT susp_vlv_err_rlr uint32_t_0x40000 0 SYMBOL_TYPE_LINK "susp_vlv_err_rlr" /end STRUCTURE_COMPONENT
 /begin STRUCTURE_COMPONENT susp_vlv_err_rlc uint32_t_0x20000 0 SYMBOL_TYPE_LINK "susp_vlv_err_rlc" /end STRUCTURE_COMPONENT
 /begin STRUCTURE_COMPONENT susp_vlv_err_frr uint32_t_0x10000 0 SYMBOL_TYPE_LINK "susp_vlv_err_frr" /end STRUCTURE_COMPONENT
 /begin STRUCTURE_COMPONENT susp_vlv_err_frc uint32_t_0x8000 0 SYMBOL_TYPE_LINK "susp_vlv_err_frc" /end STRUCTURE_COMPONENT
 /begin STRUCTURE_COMPONENT susp_vlv_err_flr uint32_t_0x4000 0 SYMBOL_TYPE_LINK "susp_vlv_err_flr" /end STRUCTURE_COMPONENT
 /begin STRUCTURE_COMPONENT susp_vlv_err_flc uint32_t_0x2000 0 SYMBOL_TYPE_LINK "susp_vlv_err_flc" /end STRUCTURE_COMPONENT
 /begin STRUCTURE_COMPONENT susp_snsr_whl_err_rr uint32_t_0x1000 0 SYMBOL_TYPE_LINK "susp_snsr_whl_err_rr" /end STRUCTURE_COMPONENT
 /begin STRUCTURE_COMPONENT susp_snsr_whl_err_rl uint32_t_0x800 0 SYMBOL_TYPE_LINK "susp_snsr_whl_err_rl" /end STRUCTURE_COMPONENT
 /begin STRUCTURE_COMPONENT susp_snsr_whl_err_fr uint32_t_0x400 0 SYMBOL_TYPE_LINK "susp_snsr_whl_err_fr" /end STRUCTURE_COMPONENT
 /begin STRUCTURE_COMPONENT susp_snsr_whl_err_fl uint32_t_0x200 0 SYMBOL_TYPE_LINK "susp_snsr_whl_err_fl" /end STRUCTURE_COMPONENT
 /begin STRUCTURE_COMPONENT susp_snsr_chassis_err_r uint32_t_0x100 0 SYMBOL_TYPE_LINK "susp_snsr_chassis_err_r" /end STRUCTURE_COMPONENT
 /begin STRUCTURE_COMPONENT susp_snsr_chassis_err_fr uint32_t_0x80 0 SYMBOL_TYPE_LINK "susp_snsr_chassis_err_fr" /end STRUCTURE_COMPONENT
 /begin STRUCTURE_COMPONENT susp_snsr_chassis_err_fl uint32_t_0x40 0 SYMBOL_TYPE_LINK "susp_snsr_chassis_err_fl" /end STRUCTURE_COMPONENT
 /begin STRUCTURE_COMPONENT susp_snsr_supply_chassis_err uint32_t_0x20 0 SYMBOL_TYPE_LINK "susp_snsr_supply_chassis_err" /end STRUCTURE_COMPONENT
 /begin STRUCTURE_COMPONENT susp_snsr_supply_whl_err uint32_t_0x10 0 SYMBOL_TYPE_LINK "susp_snsr_supply_whl_err" /end STRUCTURE_COMPONENT
 /begin STRUCTURE_COMPONENT susp_err_active_sts uint32_t_0x8 0 SYMBOL_TYPE_LINK "susp_err_active_sts" /end STRUCTURE_COMPONENT
 /begin STRUCTURE_COMPONENT susp_err_can_rx uint32_t_0x4 0 SYMBOL_TYPE_LINK "susp_err_can_rx" /end STRUCTURE_COMPONENT
 /begin STRUCTURE_COMPONENT susp_voltage_err uint32_t_0x2 0 SYMBOL_TYPE_LINK "susp_voltage_err" /end STRUCTURE_COMPONENT
 /begin STRUCTURE_COMPONENT susp_ecu_tiout uint32_t_0x1 0 SYMBOL_TYPE_LINK "susp_ecu_tiout" /end STRUCTURE_COMPONENT
/end TYPEDEF_STRUCTURE
/begin INSTANCE taskDynDmr "" TaskDynamicsDmr 0x40036598 READ_WRITE SYMBOL_LINK "taskDynDmr" 0
 /begin IF_DATA XCP
  /begin DAQ_EVENT VARIABLE /begin DEFAULT_EVENT_LIST EVENT 3 /end DEFAULT_EVENT_LIST /end DAQ_EVENT
 /end IF_DATA
/end INSTANCE
/begin INSTANCE taskDynamicsGateway "" TaskDynamicsGateway 0x40036E90 READ_WRITE SYMBOL_LINK "taskDynamicsGateway" 0
 /begin IF_DATA XCP
  /begin DAQ_EVENT VARIABLE /begin DEFAULT_EVENT_LIST EVENT 3 /end DEFAULT_EVENT_LIST /end DAQ_EVENT
 /end IF_DATA
/end INSTANCE
/begin INSTANCE taskDiagManager100ms "" TaskDiagManager100ms 0x400372C4 READ_WRITE SYMBOL_LINK "taskDiagManager100ms" 0
 /begin IF_DATA XCP
  /begin DAQ_EVENT VARIABLE /begin DEFAULT_EVENT_LIST EVENT 3 /end DEFAULT_EVENT_LIST /end DAQ_EVENT
 /end IF_DATA
/end INSTANCE
/begin INSTANCE taskDem "" TaskDem 0x40037B8C READ_WRITE SYMBOL_LINK "taskDem" 0
 /begin IF_DATA XCP
  /begin DAQ_EVENT VARIABLE /begin DEFAULT_EVENT_LIST EVENT 3 /end DEFAULT_EVENT_LIST /end DAQ_EVENT
 /end IF_DATA
/end INSTANCE
/begin INSTANCE sharedObjMutexRam "" xSTATIC_QUEUE 0x40033338 READ_WRITE SYMBOL_LINK "sharedObjMutexRam" 0
 /begin IF_DATA XCP
  /begin DAQ_EVENT VARIABLE /begin DEFAULT_EVENT_LIST EVENT 3 /end DEFAULT_EVENT_LIST /end DAQ_EVENT
 /end IF_DATA
/end INSTANCE
/begin INSTANCE shared "" SharedDataObject 0x40033388 READ_WRITE SYMBOL_LINK "shared" 0
 /begin IF_DATA XCP
  /begin DAQ_EVENT VARIABLE /begin DEFAULT_EVENT_LIST EVENT 3 /end DEFAULT_EVENT_LIST /end DAQ_EVENT
 /end IF_DATA
/end INSTANCE
/begin COMPU_METHOD tFactor "" IDENTICAL "%.6" "" /end COMPU_METHOD
/begin COMPU_METHOD tFactor_1000_S16 "" LINEAR "%.3" "-" COEFFS_LINEAR 0.001000 0 /end COMPU_METHOD
/begin COMPU_METHOD tPercent "" IDENTICAL "%.1" "%" /end COMPU_METHOD
/begin COMPU_METHOD tPercent_100_S16 "" LINEAR "%.2" "%" COEFFS_LINEAR 0.010000 0 /end COMPU_METHOD
/begin COMPU_METHOD tPercent_S8 "" IDENTICAL "%.0" "%" /end COMPU_METHOD
/begin COMPU_METHOD tPercent_100_S32 "" LINEAR "%.2" "%" COEFFS_LINEAR 0.010000 0 /end COMPU_METHOD
/begin COMPU_METHOD tSecond "" IDENTICAL "%.3" "s" /end COMPU_METHOD
/begin COMPU_METHOD tHertz "" IDENTICAL "%.3" "Hz" /end COMPU_METHOD
/begin COMPU_METHOD tMillisecond_U32 "" IDENTICAL "%.3" "ms" /end COMPU_METHOD
/begin COMPU_METHOD tMetre "" IDENTICAL "%.4" "m" /end COMPU_METHOD
/begin COMPU_METHOD tMillimetre "" IDENTICAL "%.3" "mm" /end COMPU_METHOD
/begin COMPU_METHOD tMillimetre_10_S16 "" LINEAR "%.1" "mm" COEFFS_LINEAR 0.100000 0 /end COMPU_METHOD
/begin COMPU_METHOD tKilometre "" IDENTICAL "%.3" "km" /end COMPU_METHOD
/begin COMPU_METHOD tMetrePerSecond "" IDENTICAL "%.3" "m/s" /end COMPU_METHOD
/begin COMPU_METHOD tKilometrePerHour "" IDENTICAL "%.3" "km/h" /end COMPU_METHOD
/begin COMPU_METHOD tKilometrePerHour_10_S16 "" LINEAR "%.1" "km/h" COEFFS_LINEAR 0.100000 0 /end COMPU_METHOD
/begin COMPU_METHOD tMetrePerSquareSecond "" IDENTICAL "%.3" "m/s2" /end COMPU_METHOD
/begin COMPU_METHOD tRadian "" IDENTICAL "%.3" "rad" /end COMPU_METHOD
/begin COMPU_METHOD tDegree "" IDENTICAL "%.3" "deg" /end COMPU_METHOD
/begin COMPU_METHOD tDegree_10_S16 "" LINEAR "%.1" "deg" COEFFS_LINEAR 0.100000 0 /end COMPU_METHOD
/begin COMPU_METHOD tRadianPerSecond "" IDENTICAL "%.3" "rad/s" /end COMPU_METHOD
/begin COMPU_METHOD tRadianPerSecond_100_U16 "" LINEAR "%.2" "rad/s" COEFFS_LINEAR 0.010000 0 /end COMPU_METHOD
/begin COMPU_METHOD tRevolutionPerMinute "" IDENTICAL "%.3" "rpm" /end COMPU_METHOD
/begin COMPU_METHOD tRevolutionPerMinute_S16 "" IDENTICAL "%.0" "rpm" /end COMPU_METHOD
/begin COMPU_METHOD tDegreePerSecond "" IDENTICAL "%.3" "deg/s" /end COMPU_METHOD
/begin COMPU_METHOD tKilogram "" IDENTICAL "%.3" "kg" /end COMPU_METHOD
/begin COMPU_METHOD tNewton "" IDENTICAL "%.3" "N" /end COMPU_METHOD
/begin COMPU_METHOD tNewtonMetre "" IDENTICAL "%.3" "Nm" /end COMPU_METHOD
/begin COMPU_METHOD tNewtonMetre_100_S32 "" LINEAR "%.2" "Nm" COEFFS_LINEAR 0.010000 0 /end COMPU_METHOD
/begin COMPU_METHOD tKilowatt "" IDENTICAL "%.3" "kW" /end COMPU_METHOD
/begin COMPU_METHOD tCelsius "" IDENTICAL "%.3" "C" /end COMPU_METHOD
/begin COMPU_METHOD tCelsius_10_S16 "" LINEAR "%.1" "C" COEFFS_LINEAR 0.100000 0 /end COMPU_METHOD
/begin COMPU_METHOD tBar "" IDENTICAL "%.3" "bar" /end COMPU_METHOD
/begin COMPU_METHOD tBar_10_S16 "" LINEAR "%.1" "bar" COEFFS_LINEAR 0.100000 0 /end COMPU_METHOD
/begin COMPU_METHOD tBar_100_S16 "" LINEAR "%.2" "bar" COEFFS_LINEAR 0.010000 0 /end COMPU_METHOD
/begin COMPU_METHOD tBar_1000_S16 "" LINEAR "%.3" "bar" COEFFS_LINEAR 0.001000 0 /end COMPU_METHOD
/begin COMPU_METHOD tAmpere "" IDENTICAL "%.3" "A" /end COMPU_METHOD
/begin COMPU_METHOD tAmpereHour "" IDENTICAL "%.3" "Ah" /end COMPU_METHOD
/begin COMPU_METHOD tHex_U8 "" IDENTICAL "%.0" "HEX" /end COMPU_METHOD
/begin COMPU_METHOD tHex_U32 "" IDENTICAL "%.0" "HEX" /end COMPU_METHOD
/begin COMPU_METHOD tVolt "" IDENTICAL "%.3" "V" /end COMPU_METHOD
/begin COMPU_METHOD tLitre "" IDENTICAL "%.3" "L" /end COMPU_METHOD
/begin COMPU_METHOD tAscii "" IDENTICAL "%.0" "ascii" /end COMPU_METHOD
/begin COMPU_METHOD tQualifier "" TAB_VERB "%.0" "" COMPU_TAB_REF tQualifier /end COMPU_METHOD
/begin COMPU_METHOD tSign "" TAB_VERB "%.0" "" COMPU_TAB_REF tSign /end COMPU_METHOD
/begin COMPU_METHOD tCluCtrlState "" TAB_VERB "%.0" "" COMPU_TAB_REF tCluCtrlState /end COMPU_METHOD
/begin COMPU_METHOD tDiagnos_IEB "" TAB_VERB "%.0" "" COMPU_TAB_REF tDiagnos_IEB /end COMPU_METHOD
/begin COMPU_METHOD tTqMacSt "" TAB_VERB "%.0" "" COMPU_TAB_REF tTqMacSt /end COMPU_METHOD
/begin COMPU_METHOD tPropshaftStationaryCrankState "" TAB_VERB "%.0" "" COMPU_TAB_REF tPropshaftStationaryCrankState /end COMPU_METHOD
/begin COMPU_METHOD tPropshaftDrivingCrankState "" TAB_VERB "%.0" "" COMPU_TAB_REF tPropshaftDrivingCrankState /end COMPU_METHOD
/begin COMPU_METHOD tPropulsionMode "" TAB_VERB "%.0" "" COMPU_TAB_REF tPropulsionMode /end COMPU_METHOD
/begin COMPU_METHOD tSpeedLimiterState "" TAB_VERB "%.0" "" COMPU_TAB_REF tSpeedLimiterState /end COMPU_METHOD
/begin COMPU_METHOD tDriveConfiguration "" TAB_VERB "%.0" "" COMPU_TAB_REF tDriveConfiguration /end COMPU_METHOD
/begin COMPU_METHOD tDriveMode "" TAB_VERB "%.0" "" COMPU_TAB_REF tDriveMode /end COMPU_METHOD
/begin COMPU_METHOD tShiftRequest "" TAB_VERB "%.0" "" COMPU_TAB_REF tShiftRequest /end COMPU_METHOD
/begin COMPU_METHOD tGear "" TAB_VERB "%.0" "" COMPU_TAB_REF tGear /end COMPU_METHOD
/begin COMPU_METHOD tPerformanceMode "" TAB_VERB "%.0" "" COMPU_TAB_REF tPerformanceMode /end COMPU_METHOD
/begin COMPU_METHOD tHandlingAttitudeMode "" TAB_VERB "%.0" "" COMPU_TAB_REF tHandlingAttitudeMode /end COMPU_METHOD
/begin COMPU_METHOD tTractionControlMode "" TAB_VERB "%.0" "" COMPU_TAB_REF tTractionControlMode /end COMPU_METHOD
/begin COMPU_METHOD tYawTorqueRequestMode "" TAB_VERB "%.0" "" COMPU_TAB_REF tYawTorqueRequestMode /end COMPU_METHOD
/begin COMPU_METHOD tPerformanceModeSwitchState "" TAB_VERB "%.0" "" COMPU_TAB_REF tPerformanceModeSwitchState /end COMPU_METHOD
/begin COMPU_METHOD tPerformanceModeRequestInhibitReason "" TAB_VERB "%.0" "" COMPU_TAB_REF tPerformanceModeRequestInhibitReason /end COMPU_METHOD
/begin COMPU_METHOD tPedalMapMode "" TAB_VERB "%.0" "" COMPU_TAB_REF tPedalMapMode /end COMPU_METHOD
/begin COMPU_METHOD tRegenMode "" TAB_VERB "%.0" "" COMPU_TAB_REF tRegenMode /end COMPU_METHOD
/begin COMPU_METHOD tPerformanceModeRHC "" TAB_VERB "%.0" "" COMPU_TAB_REF tPerformanceModeRHC /end COMPU_METHOD
/begin COMPU_METHOD tAutoShiftMode "" TAB_VERB "%.0" "" COMPU_TAB_REF tAutoShiftMode /end COMPU_METHOD
/begin COMPU_METHOD tPerformanceModeDDC "" TAB_VERB "%.0" "" COMPU_TAB_REF tPerformanceModeDDC /end COMPU_METHOD
/begin COMPU_METHOD tChangeModeEnableIEB "" TAB_VERB "%.0" "" COMPU_TAB_REF tChangeModeEnableIEB /end COMPU_METHOD
/begin COMPU_METHOD tPerformanceModeVDC "" TAB_VERB "%.0" "" COMPU_TAB_REF tPerformanceModeVDC /end COMPU_METHOD
/begin COMPU_METHOD tPerformanceModeEPS "" TAB_VERB "%.0" "" COMPU_TAB_REF tPerformanceModeEPS /end COMPU_METHOD
/begin COMPU_METHOD tPerformanceModeTPMS "" TAB_VERB "%.0" "" COMPU_TAB_REF tPerformanceModeTPMS /end COMPU_METHOD
/begin COMPU_METHOD tPerformanceModeSpeedLimiter "" TAB_VERB "%.0" "" COMPU_TAB_REF tPerformanceModeSpeedLimiter /end COMPU_METHOD
/begin COMPU_METHOD tEnableState "" TAB_VERB "%.0" "" COMPU_TAB_REF tEnableState /end COMPU_METHOD
/begin COMPU_METHOD tButtonState "" TAB_VERB "%.0" "" COMPU_TAB_REF tButtonState /end COMPU_METHOD
/begin COMPU_METHOD tPaddleComb "" TAB_VERB "%.0" "" COMPU_TAB_REF tPaddleComb /end COMPU_METHOD
/begin COMPU_METHOD tPerformanceStrategy "" TAB_VERB "%.0" "" COMPU_TAB_REF tPerformanceStrategy /end COMPU_METHOD
/begin COMPU_METHOD tPanelStatus "" TAB_VERB "%.0" "" COMPU_TAB_REF tPanelStatus /end COMPU_METHOD
/begin COMPU_METHOD tImmobilizerState "" TAB_VERB "%.0" "" COMPU_TAB_REF tImmobilizerState /end COMPU_METHOD
/begin COMPU_METHOD tIceSystemState "" TAB_VERB "%.0" "" COMPU_TAB_REF tIceSystemState /end COMPU_METHOD
/begin COMPU_METHOD tElectricalSystemState "" TAB_VERB "%.0" "" COMPU_TAB_REF tElectricalSystemState /end COMPU_METHOD
/begin COMPU_METHOD tAxleSystemState "" TAB_VERB "%.0" "" COMPU_TAB_REF tAxleSystemState /end COMPU_METHOD
/begin COMPU_METHOD tTorqueSystemState "" TAB_VERB "%.0" "" COMPU_TAB_REF tTorqueSystemState /end COMPU_METHOD
/begin COMPU_METHOD tPowerState "" TAB_VERB "%.0" "" COMPU_TAB_REF tPowerState /end COMPU_METHOD
/begin COMPU_METHOD tEBrakeState "" TAB_VERB "%.0" "" COMPU_TAB_REF tEBrakeState /end COMPU_METHOD
/begin COMPU_METHOD tParkingBrakeRequest "" TAB_VERB "%.0" "" COMPU_TAB_REF tParkingBrakeRequest /end COMPU_METHOD
/begin COMPU_METHOD tRollingState "" TAB_VERB "%.0" "" COMPU_TAB_REF tRollingState /end COMPU_METHOD
/begin COMPU_METHOD tEngineRunning "" TAB_VERB "%.0" "" COMPU_TAB_REF tEngineRunning /end COMPU_METHOD
/begin COMPU_METHOD tClutchState "" TAB_VERB "%.0" "" COMPU_TAB_REF tClutchState /end COMPU_METHOD
/begin COMPU_METHOD tTakeoffState "" TAB_VERB "%.0" "" COMPU_TAB_REF tTakeoffState /end COMPU_METHOD
/begin COMPU_METHOD tCombustionEngineControlState "" TAB_VERB "%.0" "" COMPU_TAB_REF tCombustionEngineControlState /end COMPU_METHOD
/begin COMPU_METHOD tTireModel "" TAB_VERB "%.0" "" COMPU_TAB_REF tTireModel /end COMPU_METHOD
/begin COMPU_METHOD tSupportingMode "" TAB_VERB "%.0" "" COMPU_TAB_REF tSupportingMode /end COMPU_METHOD
/begin COMPU_METHOD tOccupancyStatus "" TAB_VERB "%.0" "" COMPU_TAB_REF tOccupancyStatus /end COMPU_METHOD
/begin COMPU_METHOD tTelltale "" TAB_VERB "%.0" "" COMPU_TAB_REF tTelltale /end COMPU_METHOD
/begin COMPU_METHOD tFrictionBrakeTorqueArbitrationMode "" TAB_VERB "%.0" "" COMPU_TAB_REF tFrictionBrakeTorqueArbitrationMode /end COMPU_METHOD
/begin COMPU_METHOD tFunctionStatus "" TAB_VERB "%.0" "" COMPU_TAB_REF tFunctionStatus /end COMPU_METHOD
/begin COMPU_METHOD tAbsStatus "" TAB_VERB "%.0" "" COMPU_TAB_REF tAbsStatus /end COMPU_METHOD
/begin COMPU_METHOD tHapticFeedbackSteering "" TAB_VERB "%.0" "" COMPU_TAB_REF tHapticFeedbackSteering /end COMPU_METHOD
/begin COMPU_METHOD tAdasRequest "" TAB_VERB "%.0" "" COMPU_TAB_REF tAdasRequest /end COMPU_METHOD
/begin COMPU_METHOD tSensorCalibration "" TAB_VERB "%.0" "" COMPU_TAB_REF tSensorCalibration /end COMPU_METHOD
/begin COMPU_METHOD tSensorStatusAdv "" TAB_VERB "%.0" "" COMPU_TAB_REF tSensorStatusAdv /end COMPU_METHOD
/begin COMPU_METHOD tSteeringSystemStatus "" TAB_VERB "%.0" "" COMPU_TAB_REF tSteeringSystemStatus /end COMPU_METHOD
/begin COMPU_METHOD tWheelSpeedSensorStatus "" TAB_VERB "%.0" "" COMPU_TAB_REF tWheelSpeedSensorStatus /end COMPU_METHOD
/begin COMPU_METHOD tAutoHillHoldState "" TAB_VERB "%.0" "" COMPU_TAB_REF tAutoHillHoldState /end COMPU_METHOD
/begin COMPU_METHOD tAutoHillHoldDirection "" TAB_VERB "%.0" "" COMPU_TAB_REF tAutoHillHoldDirection /end COMPU_METHOD
/begin COMPU_METHOD tHillHoldSts "" TAB_VERB "%.0" "" COMPU_TAB_REF tHillHoldSts /end COMPU_METHOD
/begin COMPU_METHOD tLeakage "" TAB_VERB "%.0" "" COMPU_TAB_REF tLeakage /end COMPU_METHOD
/begin COMPU_METHOD tBrakeActiveStatus "" TAB_VERB "%.0" "" COMPU_TAB_REF tBrakeActiveStatus /end COMPU_METHOD
/begin COMPU_METHOD tRegenStatus "" TAB_VERB "%.0" "" COMPU_TAB_REF tRegenStatus /end COMPU_METHOD
/begin COMPU_METHOD tHybSmState "" TAB_VERB "%.0" "" COMPU_TAB_REF tHybSmState /end COMPU_METHOD
/begin COMPU_METHOD tBMSState "" TAB_VERB "%.0" "" COMPU_TAB_REF tBMSState /end COMPU_METHOD
/begin COMPU_METHOD tInvSmStatus "" TAB_VERB "%.0" "" COMPU_TAB_REF tInvSmStatus /end COMPU_METHOD
/begin COMPU_METHOD tChargePortStatus "" TAB_VERB "%.0" "" COMPU_TAB_REF tChargePortStatus /end COMPU_METHOD
/begin COMPU_METHOD tInvCtrlMode "" TAB_VERB "%.0" "" COMPU_TAB_REF tInvCtrlMode /end COMPU_METHOD
/begin COMPU_METHOD tInvSpdCtrlGainSet "" TAB_VERB "%.0" "" COMPU_TAB_REF tInvSpdCtrlGainSet /end COMPU_METHOD
/begin COMPU_METHOD tLiftIndication "" TAB_VERB "%.0" "" COMPU_TAB_REF tLiftIndication /end COMPU_METHOD
/begin COMPU_METHOD tLiftState "" TAB_VERB "%.0" "" COMPU_TAB_REF tLiftState /end COMPU_METHOD
/begin COMPU_METHOD tLiftMovement "" TAB_VERB "%.0" "" COMPU_TAB_REF tLiftMovement /end COMPU_METHOD
/begin COMPU_METHOD tIEBDegState "" TAB_VERB "%.0" "" COMPU_TAB_REF tIEBDegState /end COMPU_METHOD
/begin COMPU_METHOD tLaunchControlStMac "" TAB_VERB "%.0" "" COMPU_TAB_REF tLaunchControlStMac /end COMPU_METHOD
/begin COMPU_METHOD tLaunchControlMode "" TAB_VERB "%.0" "" COMPU_TAB_REF tLaunchControlMode /end COMPU_METHOD
/begin COMPU_METHOD tPressureReqRsn "" TAB_VERB "%.0" "" COMPU_TAB_REF tPressureReqRsn /end COMPU_METHOD
/begin COMPU_METHOD tAccVehicleDetection "" TAB_VERB "%.0" "" COMPU_TAB_REF tAccVehicleDetection /end COMPU_METHOD
/begin COMPU_METHOD tAccStationaryRequest "" TAB_VERB "%.0" "" COMPU_TAB_REF tAccStationaryRequest /end COMPU_METHOD
/begin COMPU_METHOD tAccFvcmSystemError "" TAB_VERB "%.0" "" COMPU_TAB_REF tAccFvcmSystemError /end COMPU_METHOD
/begin COMPU_METHOD tAccTakeoverRequest "" TAB_VERB "%.0" "" COMPU_TAB_REF tAccTakeoverRequest /end COMPU_METHOD
/begin COMPU_METHOD tAdasDriverTakeoverRequest "" TAB_VERB "%.0" "" COMPU_TAB_REF tAdasDriverTakeoverRequest /end COMPU_METHOD
/begin COMPU_METHOD tAdasDriverTakeoffRequest "" TAB_VERB "%.0" "" COMPU_TAB_REF tAdasDriverTakeoffRequest /end COMPU_METHOD
/begin COMPU_METHOD tAdaptiveCruiseControlState "" TAB_VERB "%.0" "" COMPU_TAB_REF tAdaptiveCruiseControlState /end COMPU_METHOD
/begin COMPU_METHOD tAccActuatorResponse "" TAB_VERB "%.0" "" COMPU_TAB_REF tAccActuatorResponse /end COMPU_METHOD
/begin COMPU_METHOD tAccDistanceLevel "" TAB_VERB "%.0" "" COMPU_TAB_REF tAccDistanceLevel /end COMPU_METHOD
/begin COMPU_METHOD tAccSetVelOrDist "" TAB_VERB "%.0" "" COMPU_TAB_REF tAccSetVelOrDist /end COMPU_METHOD
/begin COMPU_METHOD tAutomatedDriverControlState "" TAB_VERB "%.0" "" COMPU_TAB_REF tAutomatedDriverControlState /end COMPU_METHOD
/begin COMPU_METHOD tAutomatedDriverCycleState "" TAB_VERB "%.0" "" COMPU_TAB_REF tAutomatedDriverCycleState /end COMPU_METHOD
/begin COMPU_METHOD tLvBatteryStatus "" TAB_VERB "%.0" "" COMPU_TAB_REF tLvBatteryStatus /end COMPU_METHOD
/begin COMPU_METHOD tTpmsWarnLamp "" TAB_VERB "%.0" "" COMPU_TAB_REF tTpmsWarnLamp /end COMPU_METHOD
/begin COMPU_METHOD tTpmsSpdLimHit "" TAB_VERB "%.0" "" COMPU_TAB_REF tTpmsSpdLimHit /end COMPU_METHOD
/begin COMPU_METHOD tTpmsWhlMovgDetd "" TAB_VERB "%.0" "" COMPU_TAB_REF tTpmsWhlMovgDetd /end COMPU_METHOD
/begin COMPU_METHOD tBrakeLightRequest "" TAB_VERB "%.0" "" COMPU_TAB_REF tBrakeLightRequest /end COMPU_METHOD
/begin COMPU_METHOD tBrakeFluidLevel "" TAB_VERB "%.0" "" COMPU_TAB_REF tBrakeFluidLevel /end COMPU_METHOD
/begin COMPU_METHOD tMarket "" TAB_VERB "%.0" "" COMPU_TAB_REF tMarket /end COMPU_METHOD
/begin COMPU_METHOD tRotDir "" TAB_VERB "%.0" "" COMPU_TAB_REF tRotDir /end COMPU_METHOD
/begin COMPU_METHOD tIceStartCmd "" TAB_VERB "%.0" "" COMPU_TAB_REF tIceStartCmd /end COMPU_METHOD
/begin COMPU_METHOD tVelocityIndicationType "" TAB_VERB "%.0" "" COMPU_TAB_REF tVelocityIndicationType /end COMPU_METHOD
/begin COMPU_METHOD tPaddlePressSt "" TAB_VERB "%.0" "" COMPU_TAB_REF tPaddlePressSt /end COMPU_METHOD
/begin COMPU_METHOD tCanFTimeoutIndex "" TAB_VERB "%.0" "" COMPU_TAB_REF tCanFTimeoutIndex /end COMPU_METHOD
/begin COMPU_METHOD tCanATimeoutIndex "" TAB_VERB "%.0" "" COMPU_TAB_REF tCanATimeoutIndex /end COMPU_METHOD
/begin COMPU_METHOD tCanCTimeoutIndex "" TAB_VERB "%.0" "" COMPU_TAB_REF tCanCTimeoutIndex /end COMPU_METHOD
/begin COMPU_METHOD tCanDTimeoutIndex "" TAB_VERB "%.0" "" COMPU_TAB_REF tCanDTimeoutIndex /end COMPU_METHOD
/begin COMPU_METHOD tCanETimeoutIndex "" TAB_VERB "%.0" "" COMPU_TAB_REF tCanETimeoutIndex /end COMPU_METHOD
/begin COMPU_METHOD tCanBTimeoutIndex "" TAB_VERB "%.0" "" COMPU_TAB_REF tCanBTimeoutIndex /end COMPU_METHOD
/begin COMPU_METHOD tLiftBtnSt "" TAB_VERB "%.0" "" COMPU_TAB_REF tLiftBtnSt /end COMPU_METHOD
/begin COMPU_VTAB tQualifier "" TAB_VERB 4 0 "Q_NOT_INITIALIZED" 1 "Q_FAULTY" 2 "Q_NORMAL" 3 "Q_LOW_QUALITY" /end COMPU_VTAB
/begin COMPU_VTAB tSign "" TAB_VERB 2 -1 "SIGN_NEGATIVE" 0 "SIGN_ZERO" 1 "SIGN_POSITIVE" /end COMPU_VTAB
/begin COMPU_VTAB tCluCtrlState "" TAB_VERB 7 0 "CLU_CTRL_DISENGAGED" 1 "CLU_CTRL_TINYFILL" 2 "CLU_CTRL_FASTFILL_PEAK" 3 "CLU_CTRL_FASTFILL_HOLD" 4 "CLU_CTRL_FASTFILL_END" 5 "CLU_CTRL_ENGAGED" 6 "CLU_CTRL_ENGAGED_PWM" /end COMPU_VTAB
/begin COMPU_VTAB tDiagnos_IEB "" TAB_VERB 4 0 "DIAG_IEB_UNKNOWN" 1 "DIAG_IEB_UNAVAILABLE" 2 "DIAG_IEB_ERROR" 3 "DIAG_IEB_OK" /end COMPU_VTAB
/begin COMPU_VTAB tTqMacSt "" TAB_VERB 21 0 "TQ_MAC_ST_UNKNOWN" 1 "TQ_MAC_ST_TQ_OFF" 2 "TQ_MAC_ST_ELEC_IDLE" 3 "TQ_MAC_ST_ELEC_DRIVE" 4 "TQ_MAC_ST_CRK_PARK" 5 "TQ_MAC_ST_CRK_STATY" 6 "TQ_MAC_ST_CRK_DRVG" 7 "TQ_MAC_ST_HYB_IDLE" 8 "TQ_MAC_ST_HYB_DRV" 9 "TQ_MAC_ST_HYB_DECOUPL_IDLE" 10 "TQ_MAC_ST_HYB_DECOUPL_DRV" 11 "TQ_MAC_ST_HYB_RVSG" 12 "TQ_MAC_ST_HYB_LNCH" 13 "TQ_MAC_ST_ICE_IDLE" 14 "TQ_MAC_ST_ICE_DRIVE" 15 "TQ_MAC_ST_ICE_RVSG" 16 "TQ_MAC_ST_ELEC_TURTLE" 17 "TQ_MAC_ST_ELEC_TURTLE_IDLE" 18 "TQ_MAC_ST_ICE_TURTLE" 19 "TQ_MAC_ST_ICE_TURTLE_IDLE" 20 "TQ_MAC_ST_LENGTH" /end COMPU_VTAB
/begin COMPU_VTAB tPropshaftStationaryCrankState "" TAB_VERB 6 0 "STATY_CRK_ST_INIT" 1 "STATY_CRK_ST_COUPLE" 2 "STATY_CRK_ST_SYNC" 3 "STATY_CRK_ST_START" 4 "STATY_CRK_ST_RUNNING" 5 "STATY_CRK_ST_FAULT" /end COMPU_VTAB
/begin COMPU_VTAB tPropshaftDrivingCrankState "" TAB_VERB 4 0 "DRVG_CRK_ST_INIT" 1 "DRVG_CRK_ST_COUPLE" 2 "DRVG_CRK_ST_START" 3 "DRVG_CRK_ST_FAULT" /end COMPU_VTAB
/begin COMPU_VTAB tPropulsionMode "" TAB_VERB 5 0 "PRPL_MOD_UNKNOWN" 1 "PRPL_MOD_ELEC_FORCED" 2 "PRPL_MOD_ELEC" 3 "PRPL_MOD_HYBRID" 4 "PRPL_MOD_ICE_FORCED" /end COMPU_VTAB
/begin COMPU_VTAB tSpeedLimiterState "" TAB_VERB 4 0 "SPD_LIM_ST_OFF" 1 "SPD_LIM_ST_STBY" 2 "SPD_LIM_ST_ACTIVE" 3 "SPD_LIM_ST_ERROR" /end COMPU_VTAB
/begin COMPU_VTAB tDriveConfiguration "" TAB_VERB 4 0 "DRV_CFG_UNKNOWN" 1 "DRV_CFG_AWD" 2 "DRV_CFG_FWD" 3 "DRV_CFG_RWD" /end COMPU_VTAB
/begin COMPU_VTAB tDriveMode "" TAB_VERB 6 0 "DRV_MOD_UNKNOWN" 1 "DRV_MOD_PARK" 2 "DRV_MOD_NEUTRAL" 3 "DRV_MOD_REVERSE" 4 "DRV_MOD_DRIVE" 5 "NUM_OF_DRV_MOD" /end COMPU_VTAB
/begin COMPU_VTAB tShiftRequest "" TAB_VERB 3 0 "SHIFT_REQ_UNKNOWN" 1 "SHIFT_REQ_DOWNSHIFT" 2 "SHIFT_REQ_UPSHIFT" /end COMPU_VTAB
/begin COMPU_VTAB tGear "" TAB_VERB 11 0 "GEAR_INVALID" 1 "GEAR_1" 2 "GEAR_2" 3 "GEAR_3" 4 "GEAR_4" 5 "GEAR_5" 6 "GEAR_6" 7 "GEAR_7" 8 "GEAR_8" 9 "GEAR_9" 10 "GEAR_N" /end COMPU_VTAB
/begin COMPU_VTAB tPerformanceMode "" TAB_VERB 8 0 "PERF_MOD_UNKNOWN" 1 "PERF_MOD_GHOST_EV" 2 "PERF_MOD_COMFORT" 3 "PERF_MOD_WET_SNOW" 4 "PERF_MOD_SPORT" 5 "PERF_MOD_TRACK" 6 "PERF_MOD_INDIVIDUAL" 7 "NUM_OF_PERF_MOD" /end COMPU_VTAB
/begin COMPU_VTAB tHandlingAttitudeMode "" TAB_VERB 8 0 "HNDLG_ATTD_MOD_UKWN" 1 "HNDLG_ATTD_MOD_1" 2 "HNDLG_ATTD_MOD_2" 3 "HNDLG_ATTD_MOD_3" 4 "HNDLG_ATTD_MOD_4" 5 "HNDLG_ATTD_MOD_5" 6 "HNDLG_ATTD_MOD_BURNOUT" 7 "HNDLG_ATTD_MOD_DRIFT" /end COMPU_VTAB
/begin COMPU_VTAB tTractionControlMode "" TAB_VERB 7 0 "TRAC_CTRL_MOD_UKWN" 1 "TRAC_CTRL_MOD_1" 2 "TRAC_CTRL_MOD_2" 3 "TRAC_CTRL_MOD_3" 4 "TRAC_CTRL_MOD_4" 5 "TRAC_CTRL_MOD_5" 6 "TRAC_CTRL_MOD_OFF" /end COMPU_VTAB
/begin COMPU_VTAB tYawTorqueRequestMode "" TAB_VERB 8 0 "YAW_TQ_REQ_MOD_UKWN" 1 "YAW_TQ_REQ_MOD_1" 2 "YAW_TQ_REQ_MOD_2" 3 "YAW_TQ_REQ_MOD_3" 4 "YAW_TQ_REQ_MOD_4" 5 "YAW_TQ_REQ_MOD_5" 6 "YAW_TQ_REQ_MOD_OFF" 7 "YAW_TQ_REQ_MOD_DRIFT" /end COMPU_VTAB
/begin COMPU_VTAB tPerformanceModeSwitchState "" TAB_VERB 3 0 "PERF_MOD_SWT_ST_UKWN" 1 "PERF_MOD_SWT_ST_PND" 2 "PERF_MOD_SWT_ST_CFMD" /end COMPU_VTAB
/begin COMPU_VTAB tPerformanceModeRequestInhibitReason "" TAB_VERB 9 0 "PERF_MOD_REQ_INHB_UKWN" 1 "PERF_MOD_REQ_INHB_NONE" 2 "PERF_MOD_REQ_INHB_IGN_OFF" 3 "PERF_MOD_REQ_INHB_IGN_RISNG_EDGE" 4 "PERF_MOD_REQ_INHB_AUTO_CALIB" 5 "PERF_MOD_REQ_INHB_LIFT_FLT" 6 "PERF_MOD_REQ_INHB_LIFT_MOVG" 7 "PERF_MOD_REQ_INHB_REQ_HOLD" 8 "PERF_MOD_REQ_INHB_REQ_REJCTD" /end COMPU_VTAB
/begin COMPU_VTAB tPedalMapMode "" TAB_VERB 7 0 "PEDL_MAP_MOD_UKWN" 1 "PEDL_MAP_MOD_EV" 2 "PEDL_MAP_MOD_SLUGGISH" 3 "PEDL_MAP_MOD_NORMAL" 4 "PEDL_MAP_MOD_RESPONSIVE" 5 "PEDL_MAP_MOD_TRACK_ONLY" 6 "PEDL_MAP_MOD_COUNT" /end COMPU_VTAB
/begin COMPU_VTAB tRegenMode "" TAB_VERB 4 0 "RGN_MOD_UKWN" 1 "RGN_MOD_NO_RGN" 2 "RGN_MOD_MID_RGN" 3 "RGN_MOD_HIGH_RGN" /end COMPU_VTAB
/begin COMPU_VTAB tPerformanceModeRHC "" TAB_VERB 4 0 "RHC_PERF_MOD_UKWN" 1 "RHC_PERF_MOD_LOW" 2 "RHC_PERF_MOD_MED" 3 "RHC_PERF_MOD_HIGH" /end COMPU_VTAB
/begin COMPU_VTAB tAutoShiftMode "" TAB_VERB 4 0 "AUTO_SHIFT_MOD_UKWN" 1 "AUTO_SHIFT_MOD_EARLY" 2 "AUTO_SHIFT_MOD_MID" 3 "AUTO_SHIFT_MOD_LATE" /end COMPU_VTAB
/begin COMPU_VTAB tPerformanceModeDDC "" TAB_VERB 7 0 "DDC_PERF_MOD_UKWN" 1 "DDC_PERF_MOD_1" 2 "DDC_PERF_MOD_2" 3 "DDC_PERF_MOD_3" 4 "DDC_PERF_MOD_4" 5 "DDC_PERF_MOD_5" 6 "DDC_PERF_MOD_6" /end COMPU_VTAB
/begin COMPU_VTAB tChangeModeEnableIEB "" TAB_VERB 3 0 "IEB_CHG_MOD_UKWN" 1 "IEB_CHG_MOD_DISABLED" 2 "IEB_CHG_MOD_ENABLED" /end COMPU_VTAB
/begin COMPU_VTAB tPerformanceModeVDC "" TAB_VERB 5 0 "VDC_PERF_MOD_UKWN" 1 "VDC_PERF_MOD_UNAVL" 2 "VDC_PERF_MOD_ON" 3 "VDC_PERF_MOD_INTER" 4 "VDC_PERF_MOD_OFF" /end COMPU_VTAB
/begin COMPU_VTAB tPerformanceModeEPS "" TAB_VERB 4 0 "EPS_PERF_MOD_UKWN" 1 "EPS_PERF_MOD_SOFT" 2 "EPS_PERF_MOD_MED" 3 "EPS_PERF_MOD_HARD" /end COMPU_VTAB
/begin COMPU_VTAB tPerformanceModeTPMS "" TAB_VERB 3 0 "TPMS_PERF_MOD_UKWN" 1 "TPMS_PERF_MOD_NORM" 2 "TPMS_PERF_MOD_PERF" /end COMPU_VTAB
/begin COMPU_VTAB tPerformanceModeSpeedLimiter "" TAB_VERB 7 0 "SPD_LIM_PERF_MOD_UKWN" 1 "SPD_LIM_PERF_MOD_LOW_RVRS" 2 "SPD_LIM_PERF_MOD_LOW_DRV" 3 "SPD_LIM_PERF_MOD_NORM" 4 "SPD_LIM_PERF_MOD_HIGH" 5 "SPD_LIM_PERF_MOD_TRACK_UNLCKD" 6 "NUM_OF_SPD_LIM_PERF_MOD" /end COMPU_VTAB
/begin COMPU_VTAB tEnableState "" TAB_VERB 4 0 "ENA_ST_UNKNOWN" 1 "ENA_ST_OFF" 2 "ENA_ST_ON" 3 "ENA_ST_FLT" /end COMPU_VTAB
/begin COMPU_VTAB tButtonState "" TAB_VERB 4 0 "BTN_ST_UKWN" 1 "BTN_ST_RELD" 2 "BTN_ST_PSD" 3 "BTN_ST_ERR" /end COMPU_VTAB
/begin COMPU_VTAB tPaddleComb "" TAB_VERB 5 0 "PADDLE_UNKNOWN" 1 "PADDLE_RELEASED" 2 "PADDLE_DOWN" 3 "PADDLE_UP" 4 "PADDLE_BOTH" /end COMPU_VTAB
/begin COMPU_VTAB tPerformanceStrategy "" TAB_VERB 4 0 "PERF_STGY_UKWN" 1 "PERF_STGY_ENDURANCE" 2 "PERF_STGY_POWER" 3 "PERF_STGY_HOT_LAP" /end COMPU_VTAB
/begin COMPU_VTAB tPanelStatus "" TAB_VERB 7 0 "PANEL_UNKNOWN" 1 "PANEL_OPEN" 2 "PANEL_OPENING" 3 "PANEL_IDLE" 4 "PANEL_CLOSING" 5 "PANEL_CLOSED" 6 "PANEL_CLOSED_AND_LATCHED" /end COMPU_VTAB
/begin COMPU_VTAB tImmobilizerState "" TAB_VERB 3 0 "IMOB_UNKNOWN" 1 "IMOB_INACTIVE" 2 "IMOB_ACTIVE" /end COMPU_VTAB
/begin COMPU_VTAB tIceSystemState "" TAB_VERB 5 0 "ICE_SYS_ST_UNKNOWN" 1 "ICE_SYS_ST_CRITICAL_FAULT" 2 "ICE_SYS_ST_LIMP" 3 "ICE_SYS_ST_NOT_READY" 4 "ICE_SYS_ST_READY" /end COMPU_VTAB
/begin COMPU_VTAB tElectricalSystemState "" TAB_VERB 6 0 "EL_SYS_ST_UNKNOWN" 1 "EL_SYS_ST_OFF" 2 "EL_SYS_ST_NORMAL" 3 "EL_SYS_ST_LIMP" 4 "EL_SYS_ST_MOTOR_FAULT" 5 "EL_SYS_ST_FORCE_SHUTDOWN" /end COMPU_VTAB
/begin COMPU_VTAB tAxleSystemState "" TAB_VERB 4 0 "AXLE_SYS_ST_UNKNOWN" 1 "AXLE_SYS_ST_CRITICAL_FAULT" 2 "AXLE_SYS_ST_LIMP" 3 "AXLE_SYS_ST_NORMAL" /end COMPU_VTAB
/begin COMPU_VTAB tTorqueSystemState "" TAB_VERB 6 0 "TQ_SYS_ST_UNKNOWN" 1 "TQ_SYS_ST_CRITICAL_FAULT" 2 "TQ_SYS_ST_TURTLE_ELEC" 3 "TQ_SYS_ST_TURTLE_ICE" 4 "TQ_SYS_ST_LIMP" 5 "TQ_SYS_ST_NORMAL" /end COMPU_VTAB
/begin COMPU_VTAB tPowerState "" TAB_VERB 16 0 "PWR_ST_UNAVL" 1 "PWR_ST_SLEEP" 2 "PWR_ST_THERM_MNGT" 3 "PWR_ST_POST_CRASH" 4 "PWR_ST_INTRUSION" 5 "PWR_ST_BATT_CHRGN" 6 "PWR_ST_USR_ACS" 7 "PWR_ST_IGN" 8 "PWR_ST_FLASHING" 15 "PWR_ST_INVLD" /end COMPU_VTAB
/begin COMPU_VTAB tEBrakeState "" TAB_VERB 6 0 "E_BRAKE_SM_UNKNOWN" 1 "E_BRAKE_SM_ENGAGING" 2 "E_BRAKE_SM_ENGAGED" 3 "E_BRAKE_SM_DISENGAGING" 4 "E_BRAKE_SM_DISENGAGED" 5 "E_BRAKE_SM_FAULT" /end COMPU_VTAB
/begin COMPU_VTAB tParkingBrakeRequest "" TAB_VERB 3 0 "PRKG_BRK_REQ_UNKNOWN" 1 "PRKG_BRK_REQ_DISENGAGE" 2 "PRKG_BRK_REQ_ENGAGE" /end COMPU_VTAB
/begin COMPU_VTAB tRollingState "" TAB_VERB 5 0 "ROLLING_UNKNOWN" 1 "ROLLING_STATIONARY" 2 "ROLLING_FORWARD" 3 "ROLLING_REARWARD" 4 "ROLLING_OVERSPEED" /end COMPU_VTAB
/begin COMPU_VTAB tEngineRunning "" TAB_VERB 4 0 "ENG_RUNNG_SIGNAL_UNQUALIFIED" 1 "ENG_RUNNG_RESERVED" 2 "ENG_RUNNG_FALSE" 3 "ENG_RUNNG_TRUE" /end COMPU_VTAB
/begin COMPU_VTAB tClutchState "" TAB_VERB 8 0 "CLU_ST_UNKNOWN" 1 "CLU_ST_DISENGAGED" 2 "CLU_ST_TQ_CTRL" 3 "CLU_ST_SLIP_CTRL" 4 "CLU_ST_ENGAGED" 5 "CLU_ST_FAULT_ENGAGED" 6 "CLU_ST_FAULT_DISENGAGED" 7 "CLU_ST_FAULT_SHUTDOWN" /end COMPU_VTAB
/begin COMPU_VTAB tTakeoffState "" TAB_VERB 5 0 "TAKEOFF_ST_SPD_RAMP" 1 "TAKEOFF_ST_COUPLE" 2 "TAKEOFF_ST_READY" 3 "TAKEOFF_ST_TQ_RAMP" 4 "TAKEOFF_ST_DRIVE" /end COMPU_VTAB
/begin COMPU_VTAB tCombustionEngineControlState "" TAB_VERB 7 0 "ICE_ST_UNKNOWN" 1 "ICE_ST_OFF" 2 "ICE_ST_DECOUPL_IDLE" 3 "ICE_ST_DECOUPL_SPD_CTRL" 4 "ICE_ST_COUPL_TQ_CTRL" 5 "ICE_ST_COUPL_SPD_CTRL" 6 "ICE_ST_UNAVAILABLE" /end COMPU_VTAB
/begin COMPU_VTAB tTireModel "" TAB_VERB 5 0 "TIRE_MDL_UNKNOWN" 1 "TIRE_MDL_CUP2" 2 "TIRE_MDL_CUP2R" 3 "TIRE_MDL_ALPIN" 4 "NUM_OF_TIRE_MDLS" /end COMPU_VTAB
/begin COMPU_VTAB tSupportingMode "" TAB_VERB 7 0 "SUPPG_MOD_UNKNOWN" 1 "SUPPG_MOD_NONE" 2 "SUPPG_MOD_LIFT" 3 "SUPPG_MOD_DYNO" 4 "SUPPG_MOD_DAMP_SERV" 5 "SUPPG_MOD_TRANSPORT" 6 "SUPPG_MOD_STAGE" /end COMPU_VTAB
/begin COMPU_VTAB tOccupancyStatus "" TAB_VERB 4 0 "OCCPT_UNKNOWN" 1 "OCCPT_NONE" 2 "OCCPT_CHILD" 3 "OCCPT_ADULT" /end COMPU_VTAB
/begin COMPU_VTAB tTelltale "" TAB_VERB 3 0 "TELLTALE_UNKNOWN" 1 "TELLTALE_ENABLED" 2 "TELLTALE_DISABLED" /end COMPU_VTAB
/begin COMPU_VTAB tFrictionBrakeTorqueArbitrationMode "" TAB_VERB 6 0 "FRIC_BRK_TQ_ARBN_MODE_UNKNOWN" 1 "FRIC_BRK_TQ_ARBN_MODE_UNAVL" 2 "FRIC_BRK_TQ_ARBN_MODE_VECT_FRNT_AXLE" 3 "FRIC_BRK_TQ_ARBN_MODE_VECT_RE_AXLE" 4 "FRIC_BRK_TQ_ARBN_MODE_RECUP_FRNT_AXLE" 5 "FRIC_BRK_TQ_ARBN_MODE_RECUP_RE_AXLE" /end COMPU_VTAB
/begin COMPU_VTAB tFunctionStatus "" TAB_VERB 4 0 "FCT_STS_UNKNOWN" 1 "FCT_STS_UNAVAILABLE" 2 "FCT_STS_AVAILABLE" 3 "FCT_STS_ACTIVE" /end COMPU_VTAB
/begin COMPU_VTAB tAbsStatus "" TAB_VERB 5 0 "ABS_STS_UNKNOWN" 1 "ABS_STS_UNAVAILABLE" 2 "ABS_STS_PARTIALLY_UNAVAILABLE" 3 "ABS_STS_AVAILABLE" 4 "ABS_STS_ACTIVE" /end COMPU_VTAB
/begin COMPU_VTAB tHapticFeedbackSteering "" TAB_VERB 5 0 "HPT_FDB_UNKNOWN" 1 "HPT_FDB_UNAVAILABLE" 2 "HPT_FDB_STANDARD" 3 "HPT_FDB_LOWINTENS" 4 "HPT_FDB_HIGHINTENS" /end COMPU_VTAB
/begin COMPU_VTAB tAdasRequest "" TAB_VERB 3 0 "ADAS_UNKNOWN" 1 "ADAS_NO_REQUEST" 2 "ADAS_REQUEST" /end COMPU_VTAB
/begin COMPU_VTAB tSensorCalibration "" TAB_VERB 3 0 "SNSR_CAL_UNKNOWN" 1 "SNSR_CAL_NOT_CALIBRATED" 2 "SNSR_CAL_CALIBRATED" /end COMPU_VTAB
/begin COMPU_VTAB tSensorStatusAdv "" TAB_VERB 5 0 "SNSR_ADV_UNKNOWN" 1 "SNSR_ADV_UNAVAILABLE" 2 "SNSR_ADV_SHORT_TO_GND" 3 "SNSR_ADV_OPEN_CIRCUIT" 4 "SNSR_ADV_OPERATIONAL" /end COMPU_VTAB
/begin COMPU_VTAB tSteeringSystemStatus "" TAB_VERB 4 0 "STEER_SYS_UNKNOWN" 1 "STEER_SYS_FUNCTION_MITIGATION" 2 "STEER_SYS_SYSTEM_FAILURE" 3 "STEER_SYS_NO_FAILURE" /end COMPU_VTAB
/begin COMPU_VTAB tWheelSpeedSensorStatus "" TAB_VERB 7 0 "WHEEL_SNSR_UNKNOWN" 1 "WHEEL_SNSR_SHORT_TO_GND" 2 "WHEEL_SNSR_OPEN_CIRCUIT" 3 "WHEEL_SNSR_GAP_TOO_BIG" 4 "WHEEL_SNSR_GAP_TOO_SMALL" 5 "WHEEL_SNSR_ENCODER_WHEEL_DAMAGED" 6 "WHEEL_SENSOR_OPERATIONAL" /end COMPU_VTAB
/begin COMPU_VTAB tAutoHillHoldState "" TAB_VERB 8 0 "AHH_ST_UKWN" 1 "AHH_ST_OFF" 2 "AHH_ST_AUTO_HOLD_DEACTVD" 3 "AHH_ST_AUTO_HOLD_ACTV" 4 "AHH_ST_AUTO_HOLD_UNAVL" 5 "AHH_ST_HILL_HOLD_ACTV" 6 "AHH_ST_HILL_HOLD_UNAVL" 7 "AHH_ST_NUM_OF_ST" /end COMPU_VTAB
/begin COMPU_VTAB tAutoHillHoldDirection "" TAB_VERB 10 0 "AHH_DIR_UKWN" 1 "AHH_DIR_DRV_LVL" 2 "AHH_DIR_DRV_UPHILL" 3 "AHH_DIR_DRV_DWNHILL" 4 "AHH_DIR_RVRS_LVL" 5 "AHH_DIR_RVRS_UPHILL" 6 "AHH_DIR_RVRS_DWNHILL" 7 "AHH_DIR_NEUT" 8 "AHH_DIR_PARKD" 9 "AHH_DIR_OVRSPD" /end COMPU_VTAB
/begin COMPU_VTAB tHillHoldSts "" TAB_VERB 5 0 "HHC_STS_UNKNOWN" 1 "HHC_STS_UNAVAILABLE" 2 "HHC_STS_DEACTIVATED" 3 "HHC_STS_STANDBY" 4 "HHC_STS_HOLD_PRESSURE" /end COMPU_VTAB
/begin COMPU_VTAB tLeakage "" TAB_VERB 4 0 "LKG_UNKNOWN" 1 "LKG_UNAVAILABLE" 2 "LKG_LEAKAGE_DETECTED" 3 "LKG_NO_LEAKAGE" /end COMPU_VTAB
/begin COMPU_VTAB tBrakeActiveStatus "" TAB_VERB 6 0 "BRK_STS_UNKNOWN" 1 "BRK_STS_UNAVAILABLE" 2 "BRK_STS_NORMAL_BRAKE_ASSIST" 3 "BRK_STS_PRESSURE_REDUCTION" 4 "BRK_STS_REGEN_BRAKING" 5 "BRK_STS_NO_ACTIVE_MODE" /end COMPU_VTAB
/begin COMPU_VTAB tRegenStatus "" TAB_VERB 3 0 "RGN_UNKNOWN" 1 "RGN_NOT_ACTIVE" 2 "RGN_ACTIVE" /end COMPU_VTAB
/begin COMPU_VTAB tHybSmState "" TAB_VERB 7 0 "HYB_SM_OFF" 1 "HYB_SM_SHUTDOWN" 2 "HYB_SM_SAFESTATE" 3 "HYB_SM_PRECHARGING" 4 "HYB_SM_LIVE" 5 "HYB_SM_RUNNING" 6 "HYB_SM_CHARGING" /end COMPU_VTAB
/begin COMPU_VTAB tBMSState "" TAB_VERB 7 0 "BMS_STATE_UNKNOWN" 1 "BMS_STATE_IDLE" 2 "BMS_STATE_PRECHARGING" 3 "BMS_STATE_RUNNING" 4 "BMS_STATE_CHARGING" 5 "BMS_STATE_SHUTDOWN" 6 "BMS_STATE_SAFESTATE" /end COMPU_VTAB
/begin COMPU_VTAB tInvSmStatus "" TAB_VERB 6 0 "INV_SM_INIT" 1 "INV_SM_SELFCHECK" 2 "INV_SM_READY" 3 "INV_SM_RUNNING" 4 "INV_SM_SHUTDOWN" 5 "INV_SM_SAFESTATE" /end COMPU_VTAB
/begin COMPU_VTAB tChargePortStatus "" TAB_VERB 4 0 "CHARGE_PORT_STATUS_UNKNOWN" 1 "CHARGE_PORT_STATUS_UNPLUGGED" 2 "CHARGE_PORT_STATUS_PLUGGED" 3 "CHARGE_PORT_STATUS_MAX" /end COMPU_VTAB
/begin COMPU_VTAB tInvCtrlMode "" TAB_VERB 4 0 "INV_CTRL_MODE_NONE" 1 "INV_CTRL_MODE_TORQUE" 2 "INV_CTRL_MODE_SPEED" 3 "INV_CTRL_MODE_MAX" /end COMPU_VTAB
/begin COMPU_VTAB tInvSpdCtrlGainSet "" TAB_VERB 8 0 "INV_GAIN_SET_0" 1 "INV_GAIN_SET_1" 2 "INV_GAIN_SET_2" 3 "INV_GAIN_SET_3" 4 "INV_GAIN_SET_4" 5 "INV_GAIN_SET_5" 6 "INV_GAIN_SET_6" 7 "INV_GAIN_SET_NUM" /end COMPU_VTAB
/begin COMPU_VTAB tLiftIndication "" TAB_VERB 6 0 "LIFT_IND_OFF" 1 "LIFT_IND_UP" 2 "LIFT_IND_LIFTING" 3 "LIFT_IND_PAUSED" 4 "LIFT_IND_LOWERING" 5 "LIFT_IND_DOWN" /end COMPU_VTAB
/begin COMPU_VTAB tLiftState "" TAB_VERB 7 0 "LIFT_ST_UNKNOWN" 1 "LIFT_ST_UP" 2 "LIFT_ST_CONTROL" 3 "LIFT_ST_LIFTING" 4 "LIFT_ST_PARTLYUP" 5 "LIFT_ST_LOWERING" 6 "LIFT_ST_PARTLYDOWN" /end COMPU_VTAB
/begin COMPU_VTAB tLiftMovement "" TAB_VERB 3 0 "LIFT_HOLD" 1 "LIFT_LOWER" 2 "LIFT_RAISE" /end COMPU_VTAB
/begin COMPU_VTAB tIEBDegState "" TAB_VERB 5 0 "IEB_DEG_UNKNOWN" 1 "IEB_DEG_DEGRADE_1" 2 "IEB_DEG_DEGRADE_2" 3 "IEB_DEG_HYDRAULIC_BACKUP" 4 "IEB_DEG_NORMAL_OPERATION" /end COMPU_VTAB
/begin COMPU_VTAB tLaunchControlStMac "" TAB_VERB 8 0 "LC_ST_UNKNOWN" 1 "LC_ST_UNAVL" 2 "LC_ST_AVL" 3 "LC_ST_REQD" 4 "LC_ST_REGULATE" 5 "LC_ST_TAKEOFF" 6 "LC_ST_ABORTD" 7 "LC_ST_ABORTD_USR" /end COMPU_VTAB
/begin COMPU_VTAB tLaunchControlMode "" TAB_VERB 4 0 "LC_MOD_UNKNOWN" 1 "LC_MOD_UNAVL" 2 "LC_MOD_AVL" 3 "LC_MOD_ACTV" /end COMPU_VTAB
/begin COMPU_VTAB tPressureReqRsn "" TAB_VERB 6 0 "PRR_UNKNOWN" 1 "PRR_NO_REQUEST" 2 "PRR_REGEN_COMPENSATION" 3 "PRR_YAW_TORQUE" 4 "PRR_COMP_YAW_TORQUE" 5 "PRR_AUTO_HILL_HOLD" /end COMPU_VTAB
/begin COMPU_VTAB tAccVehicleDetection "" TAB_VERB 3 0 "ACC_DETN_UNKNOWN" 1 "ACC_DETN_FALSE" 2 "ACC_DETN_TRUE" /end COMPU_VTAB
/begin COMPU_VTAB tAccStationaryRequest "" TAB_VERB 3 0 "ACC_STATY_REQ_UNKNOWN" 1 "ACC_STATY_REQ_STATY" 2 "ACC_STATY_REQ_GO" /end COMPU_VTAB
/begin COMPU_VTAB tAccFvcmSystemError "" TAB_VERB 4 0 "FVCM_ERR_UNKNOWN" 1 "FVCM_ERR_NO_ERR" 2 "FVCM_ERR_TEMP_UNAVL" 3 "FVCM_ERR_SRV_REQD" /end COMPU_VTAB
/begin COMPU_VTAB tAccTakeoverRequest "" TAB_VERB 3 0 "TAKEOVER_REQ_UNKNOWN" 1 "TAKEOVER_REQ_NONE" 2 "TAKEOVER_REQ_TRUE" /end COMPU_VTAB
/begin COMPU_VTAB tAdasDriverTakeoverRequest "" TAB_VERB 4 0 "ADAS_TAKEOVER_REQ_UNKNOWN" 1 "ADAS_TAKEOVER_REQ_FALSE" 2 "ADAS_TAKEOVER_REQ_WARN" 3 "ADAS_TAKEOVER_REQ_EM" /end COMPU_VTAB
/begin COMPU_VTAB tAdasDriverTakeoffRequest "" TAB_VERB 3 0 "ACC_TAKEOFF_REQ_UNKNOWN" 1 "ACC_TAKEOFF_REQ_FALSE" 2 "ACC_TAKEOFF_REQ_TRUE" /end COMPU_VTAB
/begin COMPU_VTAB tAdaptiveCruiseControlState "" TAB_VERB 9 0 "ACC_ST_UNKNOWN" 1 "ACC_ST_OFF" 2 "ACC_ST_PASSIVE" 3 "ACC_ST_STBY" 4 "ACC_ST_ACTV_VEL_CTRL" 5 "ACC_ST_ACTV_FOL_CTRL" 6 "ACC_ST_ACTV_STANDG_ACTV" 7 "ACC_ST_OVRD" 8 "ACC_ST_ERROR" /end COMPU_VTAB
/begin COMPU_VTAB tAccActuatorResponse "" TAB_VERB 6 0 "ACC_ACTR_UNKNOWN" 1 "ACC_ACTR_NO_REQ" 2 "ACC_ACTR_HONORED" 3 "ACC_ACTR_LOST_ARBN" 4 "ACC_ACTR_NOT_ALLWD" 5 "ACC_ACTR_CDN_NOT_OK" /end COMPU_VTAB
/begin COMPU_VTAB tAccDistanceLevel "" TAB_VERB 5 0 "ACC_DIST_LVL_UNKNOWN" 1 "ACC_DIST_LVL_0" 2 "ACC_DIST_LVL_1" 3 "ACC_DIST_LVL_2" 4 "ACC_DIST_LVL_3" /end COMPU_VTAB
/begin COMPU_VTAB tAccSetVelOrDist "" TAB_VERB 5 0 "ACC_SET_UNKNOWN" 1 "ACC_SET_NONE" 2 "ACC_SET_VEL" 3 "ACC_SET_VEL_ONLY" 4 "ACC_SET_DIST" /end COMPU_VTAB
/begin COMPU_VTAB tAutomatedDriverControlState "" TAB_VERB 6 0 "AUT_DRVR_CTRL_ST_UKWN" 1 "AUT_DRVR_CTRL_ST_OFF" 2 "AUT_DRVR_CTRL_ST_RDY" 3 "AUT_DRVR_CTRL_ST_ACTV" 4 "AUT_DRVR_CTRL_ST_OVRD" 5 "AUT_DRVR_CTRL_ST_SHUTDWN" /end COMPU_VTAB
/begin COMPU_VTAB tAutomatedDriverCycleState "" TAB_VERB 6 0 "AUT_DRVR_CYC_ST_UKWN" 1 "AUT_DRVR_CYC_ST_OFF" 2 "AUT_DRVR_CYC_ST_STBY" 3 "AUT_DRVR_CYC_ST_ON" 4 "AUT_DRVR_CYC_ST_END" 5 "AUT_DRVR_CYC_ST_USR_STOP" /end COMPU_VTAB
/begin COMPU_VTAB tLvBatteryStatus "" TAB_VERB 4 0 "LV_BATTERY_STATUS_UNKNOWN" 1 "LV_BATTERY_STATUS_NORMAL" 2 "LV_BATTERY_STATUS_WARNING" 3 "LV_BATTERY_STATUS_FAULT" /end COMPU_VTAB
/begin COMPU_VTAB tTpmsWarnLamp "" TAB_VERB 4 0 "TPMS_WARN_LAMP_UNKNOWN" 1 "TPMS_WARN_LAMP_OFF" 2 "TPMS_WARN_LAMP_FLASHING" 3 "TPMS_WARN_LAMP_ON" /end COMPU_VTAB
/begin COMPU_VTAB tTpmsSpdLimHit "" TAB_VERB 3 0 "TPMS_SPD_LIM_HIT_UNKNOWN" 1 "TPMS_SPD_LIM_HIT_TRUE" 2 "TPMS_SPD_LIM_HIT_FALSE" /end COMPU_VTAB
/begin COMPU_VTAB tTpmsWhlMovgDetd "" TAB_VERB 3 0 "TPMS_WHL_MOVG_UNKNOWN" 1 "TPMS_WHL_MOVG_STATY" 2 "TPMS_WHL_MOVG_MOVG" /end COMPU_VTAB
/begin COMPU_VTAB tBrakeLightRequest "" TAB_VERB 4 0 "BRK_LI_REQ_UNKNOWN" 1 "BRK_LI_REQ_OFF" 2 "BRK_LI_REQ_ON" 3 "BRK_LI_REQ_ESS_BRKG" /end COMPU_VTAB
/begin COMPU_VTAB tBrakeFluidLevel "" TAB_VERB 4 0 "BRK_FLUID_LVL_UNKNOWN" 1 "BRK_FLUID_LVL_LOW" 2 "BRK_FLUID_LVL_OK" 3 "BRK_FLUID_LVL_FAULT" /end COMPU_VTAB
/begin COMPU_VTAB tMarket "" TAB_VERB 2 0 "MARKET_EU" 1 "MARKET_US" /end COMPU_VTAB
/begin COMPU_VTAB tRotDir "" TAB_VERB 2 0 "ROT_DIR_CCW" 1 "ROT_DIR_CW" /end COMPU_VTAB
/begin COMPU_VTAB tIceStartCmd "" TAB_VERB 3 0 "ICE_START_NONE" 1 "ICE_START_NOW" 2 "ICE_START_AT_STOP" /end COMPU_VTAB
/begin COMPU_VTAB tVelocityIndicationType "" TAB_VERB 2 0 "VEL_INDCN_TYP_HOMOLOGATED" 1 "VEL_INDCN_TYP_TRUE" /end COMPU_VTAB
/begin COMPU_VTAB tPaddlePressSt "" TAB_VERB 4 0 "PADDLE_ST_NONE" 1 "PADDLE_ST_SNG" 2 "PADDLE_ST_LNCH_REQ" 3 "PADDLE_ST_BOTH" /end COMPU_VTAB
/begin COMPU_VTAB tCanFTimeoutIndex "" TAB_VERB 37 0 "SLIPRING_STEER_ANGLE_TIMEOUT_INDEX" 1 "ROTRONICS_SPD_TIMEOUT_INDEX" 2 "ROTRONICS_LIN_ACCEL_TIMEOUT_INDEX" 3 "WHEEL_RATES_FRONT_TIMEOUT_INDEX" 4 "WHEEL_RATES_REAR_TIMEOUT_INDEX" 5 "WHEEL_SENSOR_STATUS_TIMEOUT_INDEX" 6 "STATUS_IEB_01_TIMEOUT_INDEX" 7 "STATUS_IEB_02_TIMEOUT_INDEX" 8 "WHEEL_ROTATION_COUNTER_TIMEOUT_INDEX" 9 "BRAKE_PEDAL_TIMEOUT_INDEX" 10 "TARGET_BRAKE_PRESSURE_TIMEOUT_INDEX" 11 "BRAKE_PRESSURE_ACTUAL_TIMEOUT_INDEX" 12 "REGEN_01_TIMEOUT_INDEX" 13 "ACC_ACTUATOR_CONTROL_TIMEOUT_INDEX" 14 "ACC_FORWARD_VEHICLE_TIMEOUT_INDEX" 15 "ACC_DETD_VEH_ID2_TIMEOUT_INDEX" 16 "ACC_DETD_VEH_ID3_TIMEOUT_INDEX" 17 "ACC_DETD_VEH_ID4_TIMEOUT_INDEX" 18 "ACC_ERR_MSG_TIMEOUT_INDEX" 19 "ACC_LANE0_DETN_INFO_TIMEOUT_INDEX" 20 "ACC_LANE0_DETN_PARAM_TIMEOUT_INDEX" 21 "ACC_LANE1_DETN_INFO_TIMEOUT_INDEX" 22 "ACC_LANE1_DETN_PARAM_TIMEOUT_INDEX" 23 "ACC_LANE2_DETN_INFO_TIMEOUT_INDEX" 24 "ACC_LANE2_DETN_PARAM_TIMEOUT_INDEX" 25 "ACC_LANE3_DETN_INFO_TIMEOUT_INDEX" 26 "ACC_LANE3_DETN_PARAM_TIMEOUT_INDEX" 27 "SEC_STAT_IEB_TIMEOUT_INDEX" 28 "SEC_STAT_ACC_TIMEOUT_INDEX" 29 "NM_STATUS_IEB_TIMEOUT_INDEX" 30 "NM_STATUS_ACC_TIMEOUT_INDEX" 31 "DYNAMICS_SENSOR_01_TIMEOUT_INDEX" 32 "DYNAMICS_SENSOR_02_TIMEOUT_INDEX" 33 "DYNAMICS_SENSOR_03_TIMEOUT_INDEX" 34 "DYNAMICS_SENSOR_IDENT_01_TIMEOUT_INDEX" 35 "DYNAMICS_SENSOR_IDENT_02_TIMEOUT_INDEX" 36 "CANF_TIMEOUT_INDEX_COUNT" /end COMPU_VTAB
/begin COMPU_VTAB tCanATimeoutIndex "" TAB_VERB 45 0 "ACU_01_G1_TIMEOUT_INDEX" 1 "VEH_PWR_ST_TIMEOUT_INDEX" 2 "DCDC_DATA_TIMEOUT_INDEX" 3 "DCDC_DATA_2_TIMEOUT_INDEX" 4 "CHARGER_DATA_TIMEOUT_INDEX" 5 "HPDM3_HV_STATUS_TIMEOUT_INDEX" 6 "HPDM3_HV_STATUS_2_TIMEOUT_INDEX" 7 "HPDM3_HV_STATUS_3_TIMEOUT_INDEX" 8 "ECM2_BROADCAST_2_TIMEOUT_INDEX" 9 "STEER_WHL_REPACK_TIMEOUT_INDEX" 10 "HPDM2_BODY_VEH_REQ_2_TIMEOUT_INDEX" 11 "HMI_TO_BCC_2_TIMEOUT_INDEX" 12 "HPDM2_GENERIC_BCC_2_TIMEOUT_INDEX" 13 "HPDM4_COOLING_STATUS1_TIMEOUT_INDEX" 14 "HPDM4_COOLING_STATUS2_TIMEOUT_INDEX" 15 "AC_SYSTEM_STATUS_TIMEOUT_INDEX" 16 "DYNO_AUT_DRVR_TIMEOUT_INDEX" 17 "LPDM1_HYD_BLOCK_TIMEOUT_INDEX" 18 "IMU_DATA_REAR_TIMEOUT_INDEX" 19 "IMU_DATA_FRNT_TIMEOUT_INDEX" 20 "HPDM1_COOLING_STATUS1_TIMEOUT_INDEX" 21 "HPDM1_COOLING_STATUS2_TIMEOUT_INDEX" 22 "HPDM1_COOLING_STATUS3_TIMEOUT_INDEX" 23 "HPDM1_COOLING_STATUS4_TIMEOUT_INDEX" 24 "HPDM1_COOLING_STATUS5_TIMEOUT_INDEX" 25 "HPDM1_COOLING_STATUS6_TIMEOUT_INDEX" 26 "HPDM4_COOLING_STATUS3_TIMEOUT_INDEX" 27 "HPDM4_COOLING_STATUS4_TIMEOUT_INDEX" 28 "LV_BATT_STS_TIMEOUT_INDEX" 29 "FRONT_LIFT_STATUS_TIMEOUT_INDEX" 30 "REAR_LIFT_STATUS_TIMEOUT_INDEX" 31 "LIFT_MOVEMENT_TIMEOUT_INDEX" 32 "TPMS_FRONT_DATA_TIMEOUT_INDEX" 33 "TPMS_FRONT_DIAG_TIMEOUT_INDEX" 34 "TPMS_REAR_DATA_TIMEOUT_INDEX" 35 "TPMS_REAR_DIAG_TIMEOUT_INDEX" 36 "SCU_HMI_VEH_REQ_TIMEOUT_INDEX" 37 "LPDM2_GPS_DATA_1_TIMEOUT_INDEX" 38 "LPDM2_GPS_DATA_2_TIMEOUT_INDEX" 39 "LPDM2_BODY_VEH_REQ_TIMEOUT_INDEX" 40 "HU_PERF_MOD_REQ_G1_TIMEOUT_INDEX" 41 "SYSTEM_TIME_SCU_TIMEOUT_INDEX" 42 "ECM_VIN_SENDING1_TIMEOUT_INDEX" 43 "ECM_VIN_SENDING2_TIMEOUT_INDEX" 44 "CANA_TIMEOUT_INDEX_COUNT" /end COMPU_VTAB
/begin COMPU_VTAB tCanCTimeoutIndex "" TAB_VERB 13 0 "LST_OUTP_SHAFT_TIMEOUT_INDEX" 1 "LST_TQ_STS_1_TIMEOUT_INDEX" 2 "LST_TQ_STS_2_TIMEOUT_INDEX" 3 "ENG_REQUEST_SPEED_TIMEOUT_INDEX" 4 "ENG_SPD_AVL_TIMEOUT_INDEX" 5 "LST_STATUS_TIMEOUT_INDEX" 6 "ENG_STATUS_TIMEOUT_INDEX" 7 "LST_VEH_STATUS_TIMEOUT_INDEX" 8 "ENG_FLAGS_TIMEOUT_INDEX" 9 "ECM_THERMAL_REQUEST_TIMEOUT_INDEX" 10 "LST_THERMAL_REQUEST_TIMEOUT_INDEX" 11 "REAR_PUMP_MOTOR_FEEDBACK1_TIMEOUT_INDEX" 12 "CANC_TIMEOUT_INDEX_COUNT" /end COMPU_VTAB
/begin COMPU_VTAB tCanDTimeoutIndex "" TAB_VERB 9 0 "INV_TEMPERATURE_1_TIMEOUT_INDEX" 1 "INV_TEMPERATURE_2_TIMEOUT_INDEX" 2 "INV_STATUS_FEEDBACK_TIMEOUT_INDEX" 3 "INV_TRQ_FEEDBACK_TIMEOUT_INDEX" 4 "INV_SPD_FEEDBACK_TIMEOUT_INDEX" 5 "INV_FAULT_1_TIMEOUT_INDEX" 6 "INV_FAULT_2_TIMEOUT_INDEX" 7 "INV_PWR_FEEDBACK_TIMEOUT_INDEX" 8 "CAND_TIMEOUT_INDEX_COUNT" /end COMPU_VTAB
/begin COMPU_VTAB tCanETimeoutIndex "" TAB_VERB 2 0 "DUMMY_MESSAGE_0002_TIMEOUT_INDEX" 1 "CANE_TIMEOUT_INDEX_COUNT" /end COMPU_VTAB
/begin COMPU_VTAB tCanBTimeoutIndex "" TAB_VERB 13 0 "PWR_STEER_STS_TIMEOUT_INDEX" 1 "PWR_STEER_VAL_TIMEOUT_INDEX" 2 "SUSPENSION_STAT_TIMEOUT_INDEX" 3 "CHASSIS_VEL_COG_TIMEOUT_INDEX" 4 "DAMPER_VEL_FRONT_TIMEOUT_INDEX" 5 "DAMPER_VEL_REAR_TIMEOUT_INDEX" 6 "VALVE_CURR_FRONT_TIMEOUT_INDEX" 7 "VALVE_CURR_REAR_TIMEOUT_INDEX" 8 "SEC_STAT_EPS_TIMEOUT_INDEX" 9 "ERR_CNT_DDC_TIMEOUT_INDEX" 10 "NM_STATUS_EPS_TIMEOUT_INDEX" 11 "NM_STATUS_DDC_TIMEOUT_INDEX" 12 "CANB_TIMEOUT_INDEX_COUNT" /end COMPU_VTAB
/begin COMPU_VTAB tLiftBtnSt "" TAB_VERB 3 0 "LIFT_BTN_UP" 1 "LIFT_BTN_DOWN" 2 "LIFT_BTN_WAIT" /end COMPU_VTAB
/begin GROUP setup ""
 /begin REF_MEASUREMENT shared sharedObjMutexRam taskDem taskDiagManager100ms taskDynamicsGateway taskDynDmr /end REF_MEASUREMENT
/end GROUP
/end MODULE
/end PROJECT
