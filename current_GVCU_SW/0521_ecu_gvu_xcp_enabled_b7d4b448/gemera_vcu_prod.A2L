/* generated by ASAP2 Studio 19.0.20.60 */
ASAP2_VERSION 1 71
/begin PROJECT GEMERA ""
/begin MODULE GVCU ""
/begin MOD_COMMON "" BYTE_ORDER MSB_FIRST ALIGNMENT_BYTE 1 ALIGNMENT_WORD 2 ALIGNMENT_LONG 4 ALIGNMENT_FLOAT16_IEEE 2 ALIGNMENT_FLOAT32_IEEE 4 ALIGNMENT_FLOAT64_IEEE 8 ALIGNMENT_INT64 8 /end MOD_COMMON
/begin IF_DATA XCP
 /begin PROTOCOL_LAYER 0x0104 0x07D0 0x0A 0x00 0x00 0x00 0x00 0x00 0xFF 0x01E2 BYTE_ORDER_MSB_FIRST ADDRESS_GRANULARITY_BYTE OPTIONAL_CMD PROGRAM_NEXT OPTIONAL_CMD GET_SECTOR_INFO OPTIONAL_CMD PROGRAM_RESET OPTIONAL_CMD PROGRAM OPTIONAL_CMD PROGRAM_CLEAR OPTIONAL_CMD PROGRAM_START OPTIONAL_CMD ALLOC_ODT_ENTRY OPTIONAL_CMD ALLOC_ODT OPTIONAL_CMD ALLOC_DAQ OPTIONAL_CMD FREE_DAQ OPTIONAL_CMD GET_DAQ_EVENT_INFO OPTIONAL_CMD GET_DAQ_LIST_INFO OPTIONAL_CMD GET_DAQ_RESOLUTION_INFO OPTIONAL_CMD GET_DAQ_PROCESSOR_INFO OPTIONAL_CMD START_STOP_SYNCH OPTIONAL_CMD START_STOP_DAQ_LIST OPTIONAL_CMD GET_DAQ_LIST_MODE OPTIONAL_CMD SET_DAQ_LIST_MODE OPTIONAL_CMD WRITE_DAQ OPTIONAL_CMD SET_DAQ_PTR OPTIONAL_CMD CLEAR_DAQ_LIST OPTIONAL_CMD DOWNLOAD_NEXT OPTIONAL_CMD DOWNLOAD OPTIONAL_CMD SHORT_UPLOAD OPTIONAL_CMD UPLOAD OPTIONAL_CMD SET_MTA OPTIONAL_CMD UNLOCK OPTIONAL_CMD GET_SEED OPTIONAL_CMD GET_ID OPTIONAL_CMD GET_COMM_MODE_INFO /end PROTOCOL_LAYER
 /begin DAQ DYNAMIC 0x00 0x06 0x00 OPTIMISATION_TYPE_DEFAULT ADDRESS_EXTENSION_FREE IDENTIFICATION_FIELD_TYPE_RELATIVE_BYTE GRANULARITY_ODT_ENTRY_SIZE_DAQ_BYTE 0xFF OVERLOAD_INDICATION_EVENT /begin STIM GRANULARITY_ODT_ENTRY_SIZE_STIM_BYTE 0xFF /end STIM /begin TIMESTAMP_SUPPORTED 0x01 SIZE_DWORD UNIT_10NS /end TIMESTAMP_SUPPORTED /begin EVENT "1ms" "1ms" 0x00 DAQ 0x01 0x01 0x06 0x04 /end EVENT /begin EVENT "5ms" "5ms" 0x01 DAQ 0x01 0x05 0x06 0x03 /end EVENT /begin EVENT "10ms" "10ms" 0x02 DAQ 0x01 0x0A 0x06 0x02 /end EVENT /begin EVENT "100ms" "100ms" 0x03 DAQ 0x01 0x64 0x06 0x01 /end EVENT /begin EVENT "1000ms" "1000ms" 0x04 DAQ 0x01 0x01 0x09 0x00 /end EVENT /begin EVENT "TaskTrace" "TaskTrace" 0x19 DAQ 0xFF 0x01 0x05 0x05 /end EVENT /end DAQ
 /begin PAG 0x00 /end PAG
 /begin PGM PGM_MODE_ABSOLUTE 0x00 0x00 /end PGM
 /begin XCP_ON_CAN 0x0104 CAN_ID_BROADCAST 0x0100 CAN_ID_MASTER 0x0125 CAN_ID_SLAVE 0x0124 BAUDRATE 0x07A120 SAMPLE_POINT 0x4B SAMPLE_RATE SINGLE BTL_CYCLES 0x08 SJW 0x03 SYNC_EDGE SINGLE MAX_DLC_REQUIRED /end XCP_ON_CAN
 /begin XCP_ON_TCP_IP 0x0104 0x15B3 ADDRESS "192.168.0.2" /end XCP_ON_TCP_IP
/end IF_DATA
/begin RECORD_LAYOUT __Float32_Axis AXIS_PTS_X 1 FLOAT32_IEEE INDEX_INCR DIRECT /end RECORD_LAYOUT
/begin RECORD_LAYOUT __Float32_Value FNC_VALUES 1 FLOAT32_IEEE ROW_DIR DIRECT /end RECORD_LAYOUT
/begin RECORD_LAYOUT __SByte_Axis AXIS_PTS_X 1 SBYTE INDEX_INCR DIRECT /end RECORD_LAYOUT
/begin RECORD_LAYOUT __SByte_Value FNC_VALUES 1 SBYTE ROW_DIR DIRECT /end RECORD_LAYOUT
/begin RECORD_LAYOUT __UByte_Axis AXIS_PTS_X 1 UBYTE INDEX_INCR DIRECT /end RECORD_LAYOUT
/begin RECORD_LAYOUT __UByte_Value FNC_VALUES 1 UBYTE ROW_DIR DIRECT /end RECORD_LAYOUT
/begin RECORD_LAYOUT __SLong_Axis AXIS_PTS_X 1 SLONG INDEX_INCR DIRECT /end RECORD_LAYOUT
/begin RECORD_LAYOUT __SLong_Value FNC_VALUES 1 SLONG ROW_DIR DIRECT /end RECORD_LAYOUT
/begin RECORD_LAYOUT __ULong_Axis AXIS_PTS_X 1 ULONG INDEX_INCR DIRECT /end RECORD_LAYOUT
/begin RECORD_LAYOUT __ULong_Value FNC_VALUES 1 ULONG ROW_DIR DIRECT /end RECORD_LAYOUT
/begin RECORD_LAYOUT __SWord_Axis AXIS_PTS_X 1 SWORD INDEX_INCR DIRECT /end RECORD_LAYOUT
/begin RECORD_LAYOUT __SWord_Value FNC_VALUES 1 SWORD ROW_DIR DIRECT /end RECORD_LAYOUT
/begin RECORD_LAYOUT __UWord_Axis AXIS_PTS_X 1 UWORD INDEX_INCR DIRECT /end RECORD_LAYOUT
/begin RECORD_LAYOUT __SInt64_Axis AXIS_PTS_X 1 A_INT64 INDEX_INCR DIRECT /end RECORD_LAYOUT
/begin RECORD_LAYOUT __SInt64_Value FNC_VALUES 1 A_INT64 ROW_DIR DIRECT /end RECORD_LAYOUT
/begin MOD_PAR "" SUPPLIER "Koenigsegg Automotive AB" ECU "GVCU" CPU_TYPE "MPC5777C" ADDR_EPK 0x40037BA4 EPK "7cc1014e" /end MOD_PAR
/begin CHARACTERISTIC flash_name "" ASCII 0xA00000 __UByte_Value 0 NO_COMPU_METHOD 0 255 READ_ONLY NUMBER 4 /end CHARACTERISTIC
/begin MEASUREMENT flash_csum1 "" ULONG NO_COMPU_METHOD 0 0 0 0 ECU_ADDRESS 0xA00008 /end MEASUREMENT
/begin MEASUREMENT flash_csum2 "" ULONG NO_COMPU_METHOD 0 0 0 0 ECU_ADDRESS 0xA0000C /end MEASUREMENT
/begin MEASUREMENT flash_crc_size "" ULONG NO_COMPU_METHOD 0 0 0 0 ECU_ADDRESS 0xA00010 /end MEASUREMENT
/begin MEASUREMENT common_rev "" ULONG NO_COMPU_METHOD 0 0 0 0 ECU_ADDRESS 0xA00014 /end MEASUREMENT
/begin MEASUREMENT app_rev "" ULONG NO_COMPU_METHOD 0 0 0 0 ECU_ADDRESS 0xA00018 /end MEASUREMENT
/begin MEASUREMENT req_boot_rev "" ULONG NO_COMPU_METHOD 0 0 0 0 ECU_ADDRESS 0xA0001C /end MEASUREMENT
/begin MEASUREMENT req_appx_rev "" ULONG NO_COMPU_METHOD 0 0 0 0 ECU_ADDRESS 0xA00020 /end MEASUREMENT
/begin MEASUREMENT pre_build_rev "" ULONG NO_COMPU_METHOD 0 0 0 0 ECU_ADDRESS 0xA00024 /end MEASUREMENT
/begin MEASUREMENT post_build_rev "" ULONG NO_COMPU_METHOD 0 0 0 0 ECU_ADDRESS 0xA00028 /end MEASUREMENT
/begin CHARACTERISTIC app_tag_rev "" ASCII 0xA00040 __UByte_Value 0 NO_COMPU_METHOD 0 255 READ_ONLY NUMBER 16 /end CHARACTERISTIC
/begin CHARACTERISTIC app_sha_rev "" ASCII 0xA00050 __UByte_Value 0 NO_COMPU_METHOD 0 255 READ_ONLY NUMBER 16 /end CHARACTERISTIC
/begin CHARACTERISTIC app_dirty_rev "" ASCII 0xA00060 __UByte_Value 0 NO_COMPU_METHOD 0 255 READ_ONLY NUMBER 32 /end CHARACTERISTIC
/begin CHARACTERISTIC sub_module1_rev "" ASCII 0xA000B0 __UByte_Value 0 NO_COMPU_METHOD 0 255 READ_ONLY NUMBER 16 /end CHARACTERISTIC
/begin CHARACTERISTIC sub_module2_rev "" ASCII 0xA000C0 __UByte_Value 0 NO_COMPU_METHOD 0 255 READ_ONLY NUMBER 16 /end CHARACTERISTIC
/begin CHARACTERISTIC sub_module3_rev "" ASCII 0xA000D0 __UByte_Value 0 NO_COMPU_METHOD 0 255 READ_ONLY NUMBER 16 /end CHARACTERISTIC
/begin CHARACTERISTIC sub_module4_rev "" ASCII 0xA000E0 __UByte_Value 0 NO_COMPU_METHOD 0 255 READ_ONLY NUMBER 16 /end CHARACTERISTIC
/begin CHARACTERISTIC sub_module5_rev "" ASCII 0xA000F0 __UByte_Value 0 NO_COMPU_METHOD 0 255 READ_ONLY NUMBER 16 /end CHARACTERISTIC
/begin CHARACTERISTIC sub_module6_rev "" ASCII 0xA00100 __UByte_Value 0 NO_COMPU_METHOD 0 255 READ_ONLY NUMBER 16 /end CHARACTERISTIC
/begin CHARACTERISTIC sub_module7_rev "" ASCII 0xA00110 __UByte_Value 0 NO_COMPU_METHOD 0 255 READ_ONLY NUMBER 16 /end CHARACTERISTIC
/begin CHARACTERISTIC sub_module8_rev "" ASCII 0xA00120 __UByte_Value 0 NO_COMPU_METHOD 0 255 READ_ONLY NUMBER 16 /end CHARACTERISTIC
/begin CHARACTERISTIC sub_module9_rev "" ASCII 0xA00130 __UByte_Value 0 NO_COMPU_METHOD 0 255 READ_ONLY NUMBER 16 /end CHARACTERISTIC
/begin CHARACTERISTIC sub_module10_rev "" ASCII 0xA00140 __UByte_Value 0 NO_COMPU_METHOD 0 255 READ_ONLY NUMBER 16 /end CHARACTERISTIC
/begin CHARACTERISTIC sub_module11_rev "" ASCII 0xA00150 __UByte_Value 0 NO_COMPU_METHOD 0 255 READ_ONLY NUMBER 16 /end CHARACTERISTIC
/begin CHARACTERISTIC sub_module12_rev "" ASCII 0xA00160 __UByte_Value 0 NO_COMPU_METHOD 0 255 READ_ONLY NUMBER 16 /end CHARACTERISTIC
/begin CHARACTERISTIC sub_module13_rev "" ASCII 0xA00170 __UByte_Value 0 NO_COMPU_METHOD 0 255 READ_ONLY NUMBER 16 /end CHARACTERISTIC
/begin CHARACTERISTIC sub_module14_rev "" ASCII 0xA00180 __UByte_Value 0 NO_COMPU_METHOD 0 255 READ_ONLY NUMBER 16 /end CHARACTERISTIC
/begin CHARACTERISTIC sub_module15_rev "" ASCII 0xA00190 __UByte_Value 0 NO_COMPU_METHOD 0 255 READ_ONLY NUMBER 16 /end CHARACTERISTIC
/begin CHARACTERISTIC sub_module16_rev "" ASCII 0xA001A0 __UByte_Value 0 NO_COMPU_METHOD 0 255 READ_ONLY NUMBER 16 /end CHARACTERISTIC
/begin TYPEDEF_MEASUREMENT tBar_10_S16 "" SWORD tBar_10_S16 0 0 -1.0 1000.0 /end TYPEDEF_MEASUREMENT
/begin TYPEDEF_MEASUREMENT tMegaJoule "" FLOAT32_IEEE tMegaJoule 0 0 -3.40282346639E+38 3.40282346639E+38 /end TYPEDEF_MEASUREMENT
/begin TYPEDEF_MEASUREMENT tRadianPerSecond "" FLOAT32_IEEE tRadianPerSecond 0 0 -1000 1000 /end TYPEDEF_MEASUREMENT
/begin TYPEDEF_MEASUREMENT tPercent_S8 "" SBYTE tPercent_S8 0 0 0 100 /end TYPEDEF_MEASUREMENT
/begin TYPEDEF_MEASUREMENT tDegree_10_S16 "" SWORD tDegree_10_S16 0 0 -720.0 720.0 /end TYPEDEF_MEASUREMENT
/begin TYPEDEF_MEASUREMENT tPercent "" FLOAT32_IEEE tPercent 0 0 0 100 /end TYPEDEF_MEASUREMENT
/begin TYPEDEF_MEASUREMENT tMillimetre_10_S16 "" SWORD tMillimetre_10_S16 0 0 -1000.0 1000.0 /end TYPEDEF_MEASUREMENT
/begin TYPEDEF_MEASUREMENT tNewtonMetre "" FLOAT32_IEEE tNewtonMetre 0 0 -100000 100000 /end TYPEDEF_MEASUREMENT
/begin TYPEDEF_MEASUREMENT tBar "" FLOAT32_IEEE tBar 0 0 -1 1000 /end TYPEDEF_MEASUREMENT
/begin TYPEDEF_MEASUREMENT tSign "" SLONG tSign 0 0 -1 1 /end TYPEDEF_MEASUREMENT
/begin TYPEDEF_MEASUREMENT tDegree "" FLOAT32_IEEE tDegree 0 0 -720 720 /end TYPEDEF_MEASUREMENT
/begin TYPEDEF_MEASUREMENT tAccDistanceLevel "" ULONG tAccDistanceLevel 0 0 0 4 /end TYPEDEF_MEASUREMENT
/begin TYPEDEF_MEASUREMENT tSecond "" FLOAT32_IEEE tSecond 0 0 0 3600 /end TYPEDEF_MEASUREMENT
/begin TYPEDEF_MEASUREMENT tQualifier "" ULONG tQualifier 0 0 0 3 /end TYPEDEF_MEASUREMENT
/begin TYPEDEF_MEASUREMENT tBar_100_S16 "" SWORD tBar_100_S16 0 0 -1.0 1000.0 /end TYPEDEF_MEASUREMENT
/begin TYPEDEF_MEASUREMENT tLowPassFilterType "" ULONG tLowPassFilterType 0 0 0 1 /end TYPEDEF_MEASUREMENT
/begin TYPEDEF_MEASUREMENT tTpmsWarnLampRsn "" ULONG tTpmsWarnLampRsn 0 0 0 3 /end TYPEDEF_MEASUREMENT
/begin TYPEDEF_MEASUREMENT tEnableState "" ULONG tEnableState 0 0 0 3 /end TYPEDEF_MEASUREMENT
/begin TYPEDEF_MEASUREMENT tFactor_1000_S16 "" SWORD tFactor_1000_S16 0 0 -32.768 32.767 /end TYPEDEF_MEASUREMENT
/begin TYPEDEF_MEASUREMENT tVolt "" FLOAT32_IEEE tVolt 0 0 0 1000 /end TYPEDEF_MEASUREMENT
/begin TYPEDEF_MEASUREMENT tKilometrePerHour "" FLOAT32_IEEE tKilometrePerHour 0 0 -600 600 /end TYPEDEF_MEASUREMENT
/begin TYPEDEF_MEASUREMENT tRadian "" FLOAT32_IEEE tRadian 0 0 -20 20 /end TYPEDEF_MEASUREMENT
/begin TYPEDEF_MEASUREMENT tCelsius "" FLOAT32_IEEE tCelsius 0 0 -400 10000 /end TYPEDEF_MEASUREMENT
/begin TYPEDEF_MEASUREMENT tNewtonMetre_100_S32 "" SLONG tNewtonMetre_100_S32 0 0 -100000.0 100000.0 /end TYPEDEF_MEASUREMENT
/begin TYPEDEF_MEASUREMENT tPerformanceMode "" ULONG tPerformanceMode 0 0 0 7 /end TYPEDEF_MEASUREMENT
/begin TYPEDEF_MEASUREMENT tNewtonMetrePerBar "" FLOAT32_IEEE tNewtonMetrePerBar 0 0 0 150 /end TYPEDEF_MEASUREMENT
/begin TYPEDEF_MEASUREMENT tBar_1000_S16 "" SWORD tBar_1000_S16 0 0 -0.1 100.0 /end TYPEDEF_MEASUREMENT
/begin TYPEDEF_MEASUREMENT tRevolutionPerMinute_S16 "" SWORD tRevolutionPerMinute_S16 0 0 -32768 32767 /end TYPEDEF_MEASUREMENT
/begin TYPEDEF_MEASUREMENT tAscii "" UBYTE tAscii 0 0 0 255 /end TYPEDEF_MEASUREMENT
/begin TYPEDEF_MEASUREMENT tKilowattHour "" FLOAT32_IEEE tKilowattHour 0 0 -10000 10000 /end TYPEDEF_MEASUREMENT
/begin TYPEDEF_MEASUREMENT tMetrePerSquareSecond "" FLOAT32_IEEE tMetrePerSquareSecond 0 0 -50 50 /end TYPEDEF_MEASUREMENT
/begin TYPEDEF_MEASUREMENT tKilowatt "" FLOAT32_IEEE tKilowatt 0 0 -10000 10000 /end TYPEDEF_MEASUREMENT
/begin TYPEDEF_MEASUREMENT tMillisecond_U32 "" ULONG tMillisecond_U32 0 0 0 3600000 /end TYPEDEF_MEASUREMENT
/begin TYPEDEF_MEASUREMENT tHertz_10_S16 "" SWORD tHertz_10_S16 0 0 0.0 30000.0 /end TYPEDEF_MEASUREMENT
/begin TYPEDEF_MEASUREMENT tKilometrePerHour_10_S16 "" SWORD tKilometrePerHour_10_S16 0 0 -600.0 600.0 /end TYPEDEF_MEASUREMENT
/begin TYPEDEF_MEASUREMENT tKilometrePerHour_10_S32 "" SLONG tKilometrePerHour_10_S32 0 0 -600.0 600.0 /end TYPEDEF_MEASUREMENT
/begin TYPEDEF_MEASUREMENT tPercent_100_S16 "" SWORD tPercent_100_S16 0 0 0.0 100.0 /end TYPEDEF_MEASUREMENT
/begin TYPEDEF_MEASUREMENT tFactor "" FLOAT32_IEEE tFactor 0 0 -3.40282346639E+38 3.40282346639E+38 /end TYPEDEF_MEASUREMENT
/begin TYPEDEF_MEASUREMENT tMetre "" FLOAT32_IEEE tMetre 0 0 -1000 1000 /end TYPEDEF_MEASUREMENT
/begin TYPEDEF_MEASUREMENT tCelsius_10_S16 "" SWORD tCelsius_10_S16 0 0 -400.0 10000.0 /end TYPEDEF_MEASUREMENT
/begin TYPEDEF_MEASUREMENT tEBrakeState "" ULONG tEBrakeState 0 0 0 5 /end TYPEDEF_MEASUREMENT
/begin TYPEDEF_MEASUREMENT tCelsius_100_S16 "" SWORD tCelsius_100_S16 0 0 -4000.0 100000.0 /end TYPEDEF_MEASUREMENT
/begin TYPEDEF_MEASUREMENT tMetrePerSecond "" FLOAT32_IEEE tMetrePerSecond 0 0 -200 200 /end TYPEDEF_MEASUREMENT
/begin TYPEDEF_MEASUREMENT tKilometrePerHour_S16 "" SWORD tKilometrePerHour_S16 0 0 -600 600 /end TYPEDEF_MEASUREMENT
/begin TYPEDEF_MEASUREMENT tMegaJoule_U32 "" ULONG tMegaJoule_U32 0 0 0 4294967295 /end TYPEDEF_MEASUREMENT
/begin TYPEDEF_MEASUREMENT tKilometre "" FLOAT32_IEEE tKilometre 0 0 0 2147483 /end TYPEDEF_MEASUREMENT
/begin TYPEDEF_MEASUREMENT tMillivolt_S16 "" SWORD tMillivolt_S16 0 0 0 10000 /end TYPEDEF_MEASUREMENT
/begin TYPEDEF_MEASUREMENT tRevolutionPerMinute "" FLOAT32_IEEE tRevolutionPerMinute 0 0 -10000 10000 /end TYPEDEF_MEASUREMENT
/begin TYPEDEF_MEASUREMENT tCluIdx "" ULONG tCluIdx 0 0 0 4 /end TYPEDEF_MEASUREMENT
/begin CHARACTERISTIC ALastKwnVin "Odometer saved VIN for detecting VIN has changed" CURVE 1073873428 __UByte_Value 0 tAscii 0 255 STEP_SIZE 1
 /begin AXIS_DESCR FIX_AXIS NO_INPUT_QUANTITY NO_COMPU_METHOD 4 0 3 FIX_AXIS_PAR_DIST 0 1 4 /end AXIS_DESCR
/end CHARACTERISTIC
/begin CHARACTERISTIC AOdoVal "Odometer adaption value" VALUE 1073873424 __Float32_Value 0 tKilometre 0 2147483 STEP_SIZE 1 /end CHARACTERISTIC
/begin CHARACTERISTIC APerfModIndUsrSeln "************************************************************************************************************************************************* * Driver-vehicle interface ************************** Performance mode Individual driver configuration" CURVE 1073873408 __UByte_Value 0 NO_COMPU_METHOD 0 255 STEP_SIZE 1 FORMAT "%.0"
 /begin AXIS_DESCR FIX_AXIS NO_INPUT_QUANTITY NO_COMPU_METHOD 13 0 12 FIX_AXIS_PAR_DIST 0 1 13 /end AXIS_DESCR
/end CHARACTERISTIC
/begin CHARACTERISTIC APerfModRgnModUsrSeln "Regen Performance mode driver configuration, available for every Performance Mode" MAP 1073873400 __UByte_Value 0 NO_COMPU_METHOD 0 255 STEP_SIZE 1 FORMAT "%.0"
 /begin AXIS_DESCR FIX_AXIS NO_INPUT_QUANTITY NO_COMPU_METHOD 6 0 5 FIX_AXIS_PAR_DIST 0 1 6 /end AXIS_DESCR
 /begin AXIS_DESCR FIX_AXIS NO_INPUT_QUANTITY NO_COMPU_METHOD 2 0 1 FIX_AXIS_PAR_DIST 0 1 2 /end AXIS_DESCR
/end CHARACTERISTIC
/begin CHARACTERISTIC AEBrakeStMac "Ebrake last state, can either be ENGAGED, DISENGAGED or FAULT, if moving then is UNKNOWN so that calibration can be triggered" VALUE 1073873396 __ULong_Value 0 tEBrakeState 0 5 STEP_SIZE 1 /end CHARACTERISTIC
/begin CHARACTERISTIC ALiftCylEndstopsFL "Front Left lift cylinder endstops mV [compressed, extended]" CURVE 1073873392 __SWord_Value 0 tMillivolt_S16 0 10000 STEP_SIZE 1
 /begin AXIS_DESCR FIX_AXIS NO_INPUT_QUANTITY NO_COMPU_METHOD 2 0 1 FIX_AXIS_PAR_DIST 0 1 2 /end AXIS_DESCR
/end CHARACTERISTIC
/begin CHARACTERISTIC ALiftCylEndstopsFR "Front Right lift cylinder endstops mV [compressed, extended]" CURVE 1073873388 __SWord_Value 0 tMillivolt_S16 0 10000 STEP_SIZE 1
 /begin AXIS_DESCR FIX_AXIS NO_INPUT_QUANTITY NO_COMPU_METHOD 2 0 1 FIX_AXIS_PAR_DIST 0 1 2 /end AXIS_DESCR
/end CHARACTERISTIC
/begin CHARACTERISTIC ALiftCylEndstopsRL "Rear Left lift cylinder endstops mV [compressed, extended]" CURVE 1073873384 __SWord_Value 0 tMillivolt_S16 0 10000 STEP_SIZE 1
 /begin AXIS_DESCR FIX_AXIS NO_INPUT_QUANTITY NO_COMPU_METHOD 2 0 1 FIX_AXIS_PAR_DIST 0 1 2 /end AXIS_DESCR
/end CHARACTERISTIC
/begin CHARACTERISTIC ALiftCylEndstopsRR "Rear Right lift cylinder endstops mV [compressed, extended]" CURVE 1073873380 __SWord_Value 0 tMillivolt_S16 0 10000 STEP_SIZE 1
 /begin AXIS_DESCR FIX_AXIS NO_INPUT_QUANTITY NO_COMPU_METHOD 2 0 1 FIX_AXIS_PAR_DIST 0 1 2 /end AXIS_DESCR
/end CHARACTERISTIC
/begin CHARACTERISTIC AWishboneAgEndstopsFL "Front left wishbone angle mV at endstops [full droop, lift up, lift down, full bump]" CURVE 1073873372 __SWord_Value 0 tMillivolt_S16 0 10000 STEP_SIZE 1
 /begin AXIS_DESCR FIX_AXIS NO_INPUT_QUANTITY NO_COMPU_METHOD 4 0 3 FIX_AXIS_PAR_DIST 0 1 4 /end AXIS_DESCR
/end CHARACTERISTIC
/begin CHARACTERISTIC AWishboneAgEndstopsFR "Front right wishbone angle mV at endstops [full droop, lift up, lift down, full bump]" CURVE 1073873364 __SWord_Value 0 tMillivolt_S16 0 10000 STEP_SIZE 1
 /begin AXIS_DESCR FIX_AXIS NO_INPUT_QUANTITY NO_COMPU_METHOD 4 0 3 FIX_AXIS_PAR_DIST 0 1 4 /end AXIS_DESCR
/end CHARACTERISTIC
/begin CHARACTERISTIC AWishboneAgEndstopsRL "Rear left wishbone angle mV at endstops [full droop, lift up, lift down, full bump]" CURVE 1073873356 __SWord_Value 0 tMillivolt_S16 0 10000 STEP_SIZE 1
 /begin AXIS_DESCR FIX_AXIS NO_INPUT_QUANTITY NO_COMPU_METHOD 4 0 3 FIX_AXIS_PAR_DIST 0 1 4 /end AXIS_DESCR
/end CHARACTERISTIC
/begin CHARACTERISTIC AWishboneAgEndstopsRR "Rear right wishbone angle mV at endstops [full droop, lift up, lift down, full bump]" CURVE 1073873348 __SWord_Value 0 tMillivolt_S16 0 10000 STEP_SIZE 1
 /begin AXIS_DESCR FIX_AXIS NO_INPUT_QUANTITY NO_COMPU_METHOD 4 0 3 FIX_AXIS_PAR_DIST 0 1 4 /end AXIS_DESCR
/end CHARACTERISTIC
/begin CHARACTERISTIC ADamprTrvlRatio "Wishbone sensor angle to damper travel ratio suspension[mm/deg]" CURVE 1073873332 __Float32_Value 0 tFactor -3.40282346639E+38 3.40282346639E+38 STEP_SIZE 1
 /begin AXIS_DESCR FIX_AXIS NO_INPUT_QUANTITY NO_COMPU_METHOD 4 0 3 FIX_AXIS_PAR_DIST 0 1 4 /end AXIS_DESCR
/end CHARACTERISTIC
/begin CHARACTERISTIC ARideHeightLiftCalibDone "True if the lift calibration has been done successfully and is stored. Otherwise false." VALUE 1073873328 __UByte_Value 0 NO_COMPU_METHOD 0 1 STEP_SIZE 1 FORMAT "%.2" /end CHARACTERISTIC
/begin CHARACTERISTIC ATpmsWarnLampRsn "TPMS warning lamp reason saved at sleep" VALUE 1073873324 __ULong_Value 0 tTpmsWarnLampRsn 0 3 STEP_SIZE 1 /end CHARACTERISTIC
/begin CHARACTERISTIC AVsoImuRotCalRqrd "IMU rotation calibration required" VALUE 1073873320 __UByte_Value 0 NO_COMPU_METHOD 0 1 STEP_SIZE 1 FORMAT "%.2" /end CHARACTERISTIC
/begin CHARACTERISTIC AVsoImuAccelGainSnsr1 "IMU acceleration vector gain, sensor 1" VALUE 1073873316 __Float32_Value 0 NO_COMPU_METHOD -3.40282346639E+38 3.40282346639E+38 STEP_SIZE 1 FORMAT "%.6" /end CHARACTERISTIC
/begin CHARACTERISTIC AVsoImuAccelGainSnsr2 "IMU acceleration vector gain, sensor 2" VALUE 1073873312 __Float32_Value 0 NO_COMPU_METHOD -3.40282346639E+38 3.40282346639E+38 STEP_SIZE 1 FORMAT "%.6" /end CHARACTERISTIC
/begin CHARACTERISTIC AVsoImuAccelGainSnsr3 "IMU acceleration vector gain, sensor 3" VALUE 1073873308 __Float32_Value 0 NO_COMPU_METHOD -3.40282346639E+38 3.40282346639E+38 STEP_SIZE 1 FORMAT "%.6" /end CHARACTERISTIC
/begin CHARACTERISTIC AVsoImuRotCalSnsr1 "IMU rotation matrix from auto-calibration, sensor 1" MAP 1073873272 __Float32_Value 0 NO_COMPU_METHOD -3.40282346639E+38 3.40282346639E+38 STEP_SIZE 1 FORMAT "%.6"
 /begin AXIS_DESCR FIX_AXIS NO_INPUT_QUANTITY NO_COMPU_METHOD 3 0 2 FIX_AXIS_PAR_DIST 0 1 3 /end AXIS_DESCR
 /begin AXIS_DESCR FIX_AXIS NO_INPUT_QUANTITY NO_COMPU_METHOD 3 0 2 FIX_AXIS_PAR_DIST 0 1 3 /end AXIS_DESCR
/end CHARACTERISTIC
/begin CHARACTERISTIC AVsoImuRotCalSnsr2 "IMU rotation matrix from auto-calibration, sensor 2" MAP 1073873236 __Float32_Value 0 NO_COMPU_METHOD -3.40282346639E+38 3.40282346639E+38 STEP_SIZE 1 FORMAT "%.6"
 /begin AXIS_DESCR FIX_AXIS NO_INPUT_QUANTITY NO_COMPU_METHOD 3 0 2 FIX_AXIS_PAR_DIST 0 1 3 /end AXIS_DESCR
 /begin AXIS_DESCR FIX_AXIS NO_INPUT_QUANTITY NO_COMPU_METHOD 3 0 2 FIX_AXIS_PAR_DIST 0 1 3 /end AXIS_DESCR
/end CHARACTERISTIC
/begin CHARACTERISTIC AVsoImuRotCalSnsr3 "IMU rotation matrix from auto-calibration, sensor 3" MAP 1073873200 __Float32_Value 0 NO_COMPU_METHOD -3.40282346639E+38 3.40282346639E+38 STEP_SIZE 1 FORMAT "%.6"
 /begin AXIS_DESCR FIX_AXIS NO_INPUT_QUANTITY NO_COMPU_METHOD 3 0 2 FIX_AXIS_PAR_DIST 0 1 3 /end AXIS_DESCR
 /begin AXIS_DESCR FIX_AXIS NO_INPUT_QUANTITY NO_COMPU_METHOD 3 0 2 FIX_AXIS_PAR_DIST 0 1 3 /end AXIS_DESCR
/end CHARACTERISTIC
/begin CHARACTERISTIC AWhlAlignmentDone "Wheel alignment has been completed" VALUE 1073873196 __UByte_Value 0 NO_COMPU_METHOD 0 1 STEP_SIZE 1 FORMAT "%.2" /end CHARACTERISTIC
/begin CHARACTERISTIC AVsoStatyWhlLoad "Corner weights with stationary car, no driver and empty fuel tank Input from scales at the end of wheel alignment" CURVE 1073873188 __SWord_Value 0 tKilogram_S16 0 10000 STEP_SIZE 1
 /begin AXIS_DESCR FIX_AXIS NO_INPUT_QUANTITY NO_COMPU_METHOD 4 0 3 FIX_AXIS_PAR_DIST 0 1 4 /end AXIS_DESCR
/end CHARACTERISTIC
/begin CHARACTERISTIC AVsoSprgPackPreloadTrvl "Suspension's spring pack preloaded deflection, constant delta travel between damper and spring pack Value saved at wheel alignment based on corner weights in lift down position" CURVE 1073873180 __SWord_Value 0 tMillimetre_10_S16 -1000.0 1000.0 STEP_SIZE 1
 /begin AXIS_DESCR FIX_AXIS NO_INPUT_QUANTITY NO_COMPU_METHOD 4 0 3 FIX_AXIS_PAR_DIST 0 1 4 /end AXIS_DESCR
/end CHARACTERISTIC
/begin CHARACTERISTIC AVsoWhlRdAdaption "Wheel rolling radius adaption" CURVE 1073873164 __Float32_Value 0 tFactor -3.40282346639E+38 3.40282346639E+38 STEP_SIZE 1
 /begin AXIS_DESCR FIX_AXIS NO_INPUT_QUANTITY NO_COMPU_METHOD 4 0 3 FIX_AXIS_PAR_DIST 0 1 4 /end AXIS_DESCR
/end CHARACTERISTIC
/begin CHARACTERISTIC ASlipringSteerAgOffset "Steering angle offset for sliping" VALUE 1073873160 __Float32_Value 0 tDegree -720 720 STEP_SIZE 1 /end CHARACTERISTIC
/begin CHARACTERISTIC ACluWearEgyStorg "Wheel clutch lifetime wear energy, integer counter megajoule format [MJ]" CURVE 1073873144 __ULong_Value 0 tMegaJoule_U32 0 4294967295 STEP_SIZE 1
 /begin AXIS_DESCR FIX_AXIS NO_INPUT_QUANTITY NO_COMPU_METHOD 4 0 3 FIX_AXIS_PAR_DIST 0 1 4 /end AXIS_DESCR
/end CHARACTERISTIC
/begin CHARACTERISTIC ACluWearEgyRem "Wheel clutch lifetime wear energy, floatremainder megajoule format [MJ]" CURVE 1073873128 __Float32_Value 0 tMegaJoule -3.40282346639E+38 3.40282346639E+38 STEP_SIZE 1
 /begin AXIS_DESCR FIX_AXIS NO_INPUT_QUANTITY NO_COMPU_METHOD 4 0 3 FIX_AXIS_PAR_DIST 0 1 4 /end AXIS_DESCR
/end CHARACTERISTIC
/begin CHARACTERISTIC ACluKissPress "Wheel clutch kiss point pressure [bar]" CURVE 1073873120 __SWord_Value 0 tBar_100_S16 -1.0 1000.0 STEP_SIZE 1
 /begin AXIS_DESCR FIX_AXIS NO_INPUT_QUANTITY NO_COMPU_METHOD 4 0 3 FIX_AXIS_PAR_DIST 0 1 4 /end AXIS_DESCR
/end CHARACTERISTIC
/begin CHARACTERISTIC AValveCMD_Map "Pressure lookup Map" MAP 1073873462 __SWord_Value 0 tPercent_100_S16 0.0 100.0 STEP_SIZE 1
 /begin AXIS_DESCR COM_AXIS NO_INPUT_QUANTITY tBar_100_S16 2 0 0 AXIS_PTS_REF CValveCMD_XSP /end AXIS_DESCR
 /begin AXIS_DESCR FIX_AXIS NO_INPUT_QUANTITY NO_COMPU_METHOD 4 0 3 FIX_AXIS_PAR_DIST 0 1 4 /end AXIS_DESCR
/end CHARACTERISTIC
/begin CHARACTERISTIC AElecCnsCdIceOnLifetime "Grid energy consumed in CD mode with engine on lifetime" VALUE 1073873116 __Float32_Value 0 tKilowattHour -10000 10000 STEP_SIZE 1 /end CHARACTERISTIC
/begin CHARACTERISTIC AElecCnsCdIceOffLifetime "Grid energy consumed in CD mode with engine off lifetime" VALUE 1073873112 __Float32_Value 0 tKilowattHour -10000 10000 STEP_SIZE 1 /end CHARACTERISTIC
/begin CHARACTERISTIC CTireMaxLgtF "" CURVE 1073887456 __Float32_Value 0 tNewtonMetre -100000 100000 STEP_SIZE 1
 /begin AXIS_DESCR FIX_AXIS NO_INPUT_QUANTITY NO_COMPU_METHOD 4 0 3 FIX_AXIS_PAR_DIST 0 1 4 /end AXIS_DESCR
/end CHARACTERISTIC
/begin CHARACTERISTIC CWhlCluReqEna "Enable wheel clutch request engaged" CURVE 1073887436 __UByte_Value 0 NO_COMPU_METHOD 0 1 STEP_SIZE 1 FORMAT "%.2"
 /begin AXIS_DESCR FIX_AXIS NO_INPUT_QUANTITY NO_COMPU_METHOD 4 0 3 FIX_AXIS_PAR_DIST 0 1 4 /end AXIS_DESCR
/end CHARACTERISTIC
/begin CHARACTERISTIC CAvasVehVelThd "AVAS upper vehicle speed threshold [km/h]" VALUE 1073887412 __Float32_Value 0 tKilometrePerHour -600 600 STEP_SIZE 1 /end CHARACTERISTIC
/begin CHARACTERISTIC CAvasFanStbyReqEna "AVAS fan standby request enable" VALUE 1073887408 __UByte_Value 0 NO_COMPU_METHOD 0 1 STEP_SIZE 1 FORMAT "%.2" /end CHARACTERISTIC
/begin CHARACTERISTIC CAvasFanStbyVehVelThd "AVAS fan standby upper vehicle speed threshold [km/h]" VALUE 1073887404 __Float32_Value 0 tKilometrePerHour -600 600 STEP_SIZE 1 /end CHARACTERISTIC
/begin CHARACTERISTIC CAvasFanStbyReqPerc "AVAS fan standby request percentage [%]" VALUE 1073887402 __SByte_Value 0 tPercent_S8 0 100 STEP_SIZE 1 /end CHARACTERISTIC
/begin CHARACTERISTIC CAvasFanFrntReqPercTab "AVAS fan front request [%]" CURVE 1073887396 __SWord_Value 0 tPercent_S16 0 100 STEP_SIZE 10
 /begin AXIS_DESCR COM_AXIS NO_INPUT_QUANTITY tKilometrePerHour_S16 3 0 0 AXIS_PTS_REF CAvasFanReqPercXsp /end AXIS_DESCR
/end CHARACTERISTIC
/begin CHARACTERISTIC CAvasFanReReqPercTab "AVAS fan rear request [%]" CURVE 1073887390 __SWord_Value 0 tPercent_S16 0 100 STEP_SIZE 10
 /begin AXIS_DESCR COM_AXIS NO_INPUT_QUANTITY tKilometrePerHour_S16 3 0 0 AXIS_PTS_REF CAvasFanReqPercXsp /end AXIS_DESCR
/end CHARACTERISTIC
/begin AXIS_PTS CAvasFanReqPercXsp "AVAS fan request percentage interpolation axis [km/h]" 1073887384 NO_INPUT_QUANTITY __SWord_Axis 0 tKilometrePerHour_S16 3 0 100 STEP_SIZE 10 /end AXIS_PTS
/begin CHARACTERISTIC CAdpvCrsCtrlDftActvToFolCtrl "Default active state to following control, if != UNKNOWN overrides value from HU ENA_ST_OFF || ENA_ST_FLT => VEL_CTRL as default, ENA_ST_ON => FOL_CTRL as default" VALUE 1073887084 __ULong_Value 0 tEnableState 0 3 STEP_SIZE 1 /end CHARACTERISTIC
/begin CHARACTERISTIC CAdpvCrsCtrlDftDistLvl "Default distance level, if != UNKNOWN overrides value from HU" VALUE 1073887080 __ULong_Value 0 tAccDistanceLevel 0 4 STEP_SIZE 1 /end CHARACTERISTIC
/begin CHARACTERISTIC CAdpvCrsCtrlDistLvl0ToVelCtrlEna "Enable distance level0 request into velocity control request" VALUE 1073887079 __UByte_Value 0 NO_COMPU_METHOD 0 1 STEP_SIZE 1 FORMAT "%.2" /end CHARACTERISTIC
/begin CHARACTERISTIC CAdpvCrsCtrlZeroVehVelEna "Enable Velocity Control zero speed minimum" VALUE 1073887078 __UByte_Value 0 NO_COMPU_METHOD 0 1 STEP_SIZE 1 FORMAT "%.2" /end CHARACTERISTIC
/begin CHARACTERISTIC CAdpvCrsCtrlEnaIntgtrInin "Enable cruise control integral part back-calculation at transition from STBY to ACTIVE" VALUE 1073887068 __UByte_Value 0 NO_COMPU_METHOD 0 1 STEP_SIZE 1 FORMAT "%.2" /end CHARACTERISTIC
/begin CHARACTERISTIC CAdpvCrsCtrlEnaOvrdIntgtrReset "Enable integrator reset when in override, instead of freeze" VALUE 1073887067 __UByte_Value 0 NO_COMPU_METHOD 0 1 STEP_SIZE 1 FORMAT "%.2" /end CHARACTERISTIC
/begin CHARACTERISTIC CAdpvCrsCtrlEnaTranFromOvrdToActvIntgtrRst "Enable cruise control integral part reset if set speed increased at transition from ACTIVE to OVERRIDE" VALUE 1073887066 __UByte_Value 0 NO_COMPU_METHOD 0 1 STEP_SIZE 1 FORMAT "%.2" /end CHARACTERISTIC
/begin CHARACTERISTIC CAdpvCrsCtrlEnaTranFromActvToStbyIntgtrFreeze "Enable cruise control integral part freeze if bEnteredStbyFromActive is true" VALUE 1073887065 __UByte_Value 0 NO_COMPU_METHOD 0 1 STEP_SIZE 1 FORMAT "%.2" /end CHARACTERISTIC
/begin CHARACTERISTIC CAdpvCrsCtrlStbyAllwdMaskOvrd "Override standby inhibit mask, if true locals->bAccStbyAllwd becomes true after CAdpvCrsCtrlNotAllwdHoldTime" VALUE 1073887064 __UByte_Value 0 NO_COMPU_METHOD 0 1 STEP_SIZE 1 FORMAT "%.2" /end CHARACTERISTIC
/begin CHARACTERISTIC CAdpvCrsCtrlVelCtrlAllwdMaskOvrd "Override velocity control inhibit mask, if true locals->bAccVelCtrlActvAllwd becomes true after CAdpvCrsCtrlNotAllwdHoldTime" VALUE 1073887063 __UByte_Value 0 NO_COMPU_METHOD 0 1 STEP_SIZE 1 FORMAT "%.2" /end CHARACTERISTIC
/begin CHARACTERISTIC CAdpvCrsCtrlFolCtrlAllwdMaskOvrd "Override following control inhibit mask, if true locals->bAccFolCtrlActvAllwd becomes true after CAdpvCrsCtrlNotAllwdHoldTime" VALUE 1073887062 __UByte_Value 0 NO_COMPU_METHOD 0 1 STEP_SIZE 1 FORMAT "%.2" /end CHARACTERISTIC
/begin CHARACTERISTIC CAdpvCrsCtrlAlwdBrkPerc "Maximum allowed brake pedal percentage to keep Cruise Control active" VALUE 1073887060 __SWord_Value 0 tPercent_100_S16 0.0 100.0 STEP_SIZE 1 /end CHARACTERISTIC
/begin CHARACTERISTIC CAdpvCrsCtrlMaxAlwdSteerAbsTab "Steering degree limit for Cruise Control to be active [deg]" CURVE 1073887046 __SWord_Value 0 tDegree_10_S16 -720.0 720.0 STEP_SIZE 1
 /begin AXIS_DESCR COM_AXIS NO_INPUT_QUANTITY tKilometrePerHour_10_S16 7 0 0 AXIS_PTS_REF CAdpvCrsCtrlMaxSteerVelXsp /end AXIS_DESCR
/end CHARACTERISTIC
/begin AXIS_PTS CAdpvCrsCtrlMaxSteerVelXsp "Requested speed error setpoint for cruise control target speed ramp up rate [km/h]" 1073887032 NO_INPUT_QUANTITY __SWord_Axis 0 tKilometrePerHour_10_S16 7 -600.0 600.0 STEP_SIZE 1 /end AXIS_PTS
/begin CHARACTERISTIC CAdpvCrsCtrlFfWhlTqReqMin "Minimum wheel torque from cruise control feedforward" VALUE 1073887028 __SLong_Value 0 tNewtonMetre_100_S32 -100000.0 100000.0 STEP_SIZE 1 /end CHARACTERISTIC
/begin CHARACTERISTIC CAdpvCrsCtrlFfWhlTqReqMax "Maximum wheel torque from cruise control feedforward" VALUE 1073887024 __SLong_Value 0 tNewtonMetre_100_S32 -100000.0 100000.0 STEP_SIZE 1 /end CHARACTERISTIC
/begin CHARACTERISTIC CAdpvCrsCtrlIntglWhlTqMin "Minimum wheel torque from integral part of cruise controller" VALUE 1073887020 __SLong_Value 0 tNewtonMetre_100_S32 -100000.0 100000.0 STEP_SIZE 1 /end CHARACTERISTIC
/begin CHARACTERISTIC CAdpvCrsCtrlIntglWhlTqMax "Maximum wheel torque from integral part of cruise controller" VALUE 1073887016 __SLong_Value 0 tNewtonMetre_100_S32 -100000.0 100000.0 STEP_SIZE 1 /end CHARACTERISTIC
/begin CHARACTERISTIC CAdpvCrsCtrlFbWhlTqReqMin "Minimum wheel torque from cruise control feedback" VALUE 1073887012 __SLong_Value 0 tNewtonMetre_100_S32 -100000.0 100000.0 STEP_SIZE 1 /end CHARACTERISTIC
/begin CHARACTERISTIC CAdpvCrsCtrlFbWhlTqReqMax "Maximum wheel torque from cruise control feedback" VALUE 1073887008 __SLong_Value 0 tNewtonMetre_100_S32 -100000.0 100000.0 STEP_SIZE 1 /end CHARACTERISTIC
/begin CHARACTERISTIC CAdpvCrsCtrlTotWhlTqReqMin "Cruise Controller wheel torque request lower limit [Nm]" VALUE 1073887004 __SLong_Value 0 tNewtonMetre_100_S32 -100000.0 100000.0 STEP_SIZE 1 /end CHARACTERISTIC
/begin CHARACTERISTIC CAdpvCrsCtrlTotWhlTqReqMax "Cruise Controller wheel torque request upper limit [Nm]" VALUE 1073887000 __SLong_Value 0 tNewtonMetre_100_S32 -100000.0 100000.0 STEP_SIZE 1 /end CHARACTERISTIC
/begin CHARACTERISTIC CAdpvCrsCtrlScrollBtnPosnDeltaMin "Minimum scroll button delta accepted as scroll, to filter out noise [inct]" VALUE 1073886999 __UByte_Value 0 NO_COMPU_METHOD 0 255 STEP_SIZE 1 FORMAT "%.0" /end CHARACTERISTIC
/begin CHARACTERISTIC CAdpvCrsCtrlSetVelDisIncEna "Enable discretized increases for set velocity request" VALUE 1073886998 __UByte_Value 0 NO_COMPU_METHOD 0 1 STEP_SIZE 1 FORMAT "%.2" /end CHARACTERISTIC
/begin CHARACTERISTIC CAdpvCrsCtrlLongScrollPosnDelta "Scroll button delta position treshold to identify a long scroll [inct]" VALUE 1073886997 __SByte_Value 0 NO_COMPU_METHOD -128 127 STEP_SIZE 1 FORMAT "%.0" /end CHARACTERISTIC
/begin CHARACTERISTIC CAdpvCrsCtrlLongestScrollPosnDelta "Scroll button delta position treshold to identify the longest scroll [inct]" VALUE 1073886996 __SByte_Value 0 NO_COMPU_METHOD -128 127 STEP_SIZE 1 FORMAT "%.0" /end CHARACTERISTIC
/begin CHARACTERISTIC CAdpvCrsCtrlScrollBtnPosnStatyPerd "Period for which scroll position needs to be constant to identify a full scroll" VALUE 1073886992 __ULong_Value 0 tMillisecond_U32 0 3600000 STEP_SIZE 1 /end CHARACTERISTIC
/begin CHARACTERISTIC CAdpvCrsCtrlShoScrollSetVelInc "Set velocity increase/decrease when scroll button is swiped up/down less than CAdpvCrsCtrlLongScrollPosnDelta" VALUE 1073886988 __SWord_Value 0 tKilometrePerHour_10_S16 -600.0 600.0 STEP_SIZE 1 /end CHARACTERISTIC
/begin CHARACTERISTIC CAdpvCrsCtrlLongScrollSetVelInc "Set velocity increase/decrease when scroll button is swiped up/down equal or more than CAdpvCrsCtrlLongScrollPosnDelta but less than CAdpvCrsCtrlLongestScrollPosnDelta" VALUE 1073886986 __SWord_Value 0 tKilometrePerHour_10_S16 -600.0 600.0 STEP_SIZE 1 /end CHARACTERISTIC
/begin CHARACTERISTIC CAdpvCrsCtrlLongestScrollSetVelInc "Set velocity increase/decrease when scroll button is swiped up/down equal or more than CAdpvCrsCtrlLongestScrollPosnDelta" VALUE 1073886984 __SWord_Value 0 tKilometrePerHour_10_S16 -600.0 600.0 STEP_SIZE 1 /end CHARACTERISTIC
/begin CHARACTERISTIC CAdpvCrsCtrlSetVelPropIncStep "Proportional increase for set velocity request step unit [kph/inct] TODO (PWTSW-8736)" VALUE 1073886982 __UByte_Value 0 NO_COMPU_METHOD 0 255 STEP_SIZE 1 FORMAT "%.0" /end CHARACTERISTIC
/begin CHARACTERISTIC CAdpvCrsCtrlSetVelPropIncMin "Minimum proportional increase for set velocity request [km/h]" VALUE 1073886980 __SWord_Value 0 tKilometrePerHour_10_S16 -600.0 600.0 STEP_SIZE 1 /end CHARACTERISTIC
/begin CHARACTERISTIC CAdpvCrsCtrlSetVelPropIncMax "Maximum proportional increase for set velocity request [km/h]" VALUE 1073886978 __SWord_Value 0 tKilometrePerHour_10_S16 -600.0 600.0 STEP_SIZE 1 /end CHARACTERISTIC
/begin CHARACTERISTIC CAdpvCrsCtrlSetVelResl "Set velocity resolution" VALUE 1073886976 __SWord_Value 0 NO_COMPU_METHOD -32768 32767 STEP_SIZE 1 FORMAT "%.0" /end CHARACTERISTIC
/begin CHARACTERISTIC CAdpvCrsCtrlVelCtrlAlwdRefVelMin "Minimum allowed vehicle speed for ACC to be allowed in Velocity Control mode [km/h]" VALUE 1073886974 __SWord_Value 0 tKilometrePerHour_10_S16 -600.0 600.0 STEP_SIZE 1 /end CHARACTERISTIC
/begin CHARACTERISTIC CAdpvCrsCtrlVelCtrlAlwdRefVelMax "Maximum allowed vehicle speed for ACC to be allowed in Velocity Control mode [km/h]" VALUE 1073886972 __SWord_Value 0 tKilometrePerHour_10_S16 -600.0 600.0 STEP_SIZE 1 /end CHARACTERISTIC
/begin CHARACTERISTIC CAdpvCrsCtrlFolCtrlAlwdRefVelMax "Maximum allowed vehicle speed for ACC to be allowed in Following Control mode [km/h]" VALUE 1073886970 __SWord_Value 0 tKilometrePerHour_10_S16 -600.0 600.0 STEP_SIZE 1 /end CHARACTERISTIC
/begin CHARACTERISTIC CAdpvCrsCtrlVehVelTol "Adaptive Cruise Control vehicle speed tolerance [km/h]" VALUE 1073886968 __SWord_Value 0 tKilometrePerHour_10_S16 -600.0 600.0 STEP_SIZE 1 /end CHARACTERISTIC
/begin CHARACTERISTIC CAdpvCrsCtrlRefVelGrdtLimLowr "Ramped set speed gradient lower limit [km/h per s] 6.5 equals 0.18 g acceleration, 3.6 equals 0.1 g" VALUE 1073886966 __SWord_Value 0 tKilometrePerHour_10_S16 -600.0 600.0 STEP_SIZE 1 /end CHARACTERISTIC
/begin CHARACTERISTIC CAdpvCrsCtrlRefVelGrdtLimUppr "Ramped set speed gradient upper limit [km/h per s] 6.5 equals 0.18 g acceleration, 3.6 equals 0.1 g" VALUE 1073886964 __SWord_Value 0 tKilometrePerHour_10_S16 -600.0 600.0 STEP_SIZE 1 /end CHARACTERISTIC
/begin CHARACTERISTIC CAdpvCrsCtrlRefVelGrdtWetLimLowr "Ramped set speed gradient lower limit for wet conditions [km/h per s] 3.6 equals 0.1 g acceleration" VALUE 1073886962 __SWord_Value 0 tKilometrePerHour_10_S16 -600.0 600.0 STEP_SIZE 1 /end CHARACTERISTIC
/begin CHARACTERISTIC CAdpvCrsCtrlRefVelGrdtWetLimUppr "Ramped set speed gradient upper limit for wet conditions [km/h per s] 3.6 equals 0.1 g acceleration" VALUE 1073886960 __SWord_Value 0 tKilometrePerHour_10_S16 -600.0 600.0 STEP_SIZE 1 /end CHARACTERISTIC
/begin CHARACTERISTIC CAdpvCrsCtrlGrdtVelErrLowrTab "Cruise control limit speed ramp down rate [km/h per s] 6.5 equals 0.18 g acceleration, 1.0 equals 0.03 g" CURVE 1073886944 __SWord_Value 0 tKilometrePerHour_10_S16 -600.0 600.0 STEP_SIZE 1
 /begin AXIS_DESCR COM_AXIS NO_INPUT_QUANTITY tKilometrePerHour_10_S16 8 0 0 AXIS_PTS_REF CAdpvCrsCtrlReqVelErrXsp /end AXIS_DESCR
/end CHARACTERISTIC
/begin CHARACTERISTIC CAdpvCrsCtrlGrdtVelErrUpprTab "Cruise control limit speed ramp up rate [km/h per s] 6.5 equals 0.18 g acceleration, 1.0 equals 0.03 g" CURVE 1073886928 __SWord_Value 0 tKilometrePerHour_10_S16 -600.0 600.0 STEP_SIZE 1
 /begin AXIS_DESCR COM_AXIS NO_INPUT_QUANTITY tKilometrePerHour_10_S16 8 0 0 AXIS_PTS_REF CAdpvCrsCtrlReqVelErrXsp /end AXIS_DESCR
/end CHARACTERISTIC
/begin AXIS_PTS CAdpvCrsCtrlReqVelErrXsp "Requested speed error setpoint for cruise control target speed ramp up/down rate [km/h]" 1073886912 NO_INPUT_QUANTITY __SWord_Axis 0 tKilometrePerHour_10_S16 8 -600.0 600.0 STEP_SIZE 1 /end AXIS_PTS
/begin CHARACTERISTIC CAdpvCrsCtrlRefAccelLimLowr "Target acceleration lower limit in Following control" VALUE 1073886908 __Float32_Value 0 tMetrePerSquareSecond -5 0 STEP_SIZE 0.1 /end CHARACTERISTIC
/begin CHARACTERISTIC CAdpvCrsCtrlRefAccelLimUppr "Target acceleration upper limit in Following control" VALUE 1073886904 __Float32_Value 0 tMetrePerSquareSecond 0 3 STEP_SIZE 0.1 /end CHARACTERISTIC
/begin CHARACTERISTIC CAdpvCrsCtrlRefJerkLimAbsTab "Adaptive Cruise Control reference acceleration gradient limit (jerk) [m/s^3]" CURVE 1073886876 __Float32_Value 0 tMetrePerSquareSecond -50 50 STEP_SIZE 1
 /begin AXIS_DESCR COM_AXIS NO_INPUT_QUANTITY tMetrePerSquareSecond 7 0 0 AXIS_PTS_REF CAdpvCrsCtrlRefAccelXsp /end AXIS_DESCR
/end CHARACTERISTIC
/begin AXIS_PTS CAdpvCrsCtrlRefAccelXsp "Adaptive Cruise Control target acceleration [m/s^2]" 1073886848 NO_INPUT_QUANTITY __Float32_Axis 0 tMetrePerSquareSecond 7 -50 50 STEP_SIZE 1 /end AXIS_PTS
/begin CHARACTERISTIC CAdpvCrsCtrlActrReqTolr "Adaptive Cruise Control Actuator Request tolerance [m/s^2]" VALUE 1073886844 __Float32_Value 0 tMetrePerSquareSecond -50 50 STEP_SIZE 1 /end CHARACTERISTIC
/begin CHARACTERISTIC CAdpvCrsCtrlStandgActvStTranVehVel "Minimum vehicle velocity to transition to STANDING ACTIVE state [km/h]" VALUE 1073886840 __SWord_Value 0 tKilometrePerHour_10_S16 -600.0 600.0 STEP_SIZE 1 /end CHARACTERISTIC
/begin CHARACTERISTIC CAdpvCrsCtrlStandgActvPerd "Standing active period, after which ACC state machine transitions to standby [ms]" VALUE 1073886836 __ULong_Value 0 tMillisecond_U32 0 3600000 STEP_SIZE 1 /end CHARACTERISTIC
/begin CHARACTERISTIC CAdpvCrsCtrlStandgActvTakeOffReqPerd "Standing active Driver Takeoff request period, after which Driver needs to press accelerator pedal slightly to allow the vehicle to takeoff autonomously [ms]" VALUE 1073886832 __ULong_Value 0 tMillisecond_U32 0 3600000 STEP_SIZE 1 /end CHARACTERISTIC
/begin CHARACTERISTIC CAdpvCrsCtrlOvrdInhbPerd "Override Inhibit Period [ms]" VALUE 1073886828 __ULong_Value 0 tMillisecond_U32 0 3600000 STEP_SIZE 1 /end CHARACTERISTIC
/begin CHARACTERISTIC CAdpvCrsCtrlGoReqAccrPedlPercThd "Accelerator Pedal percentage requested by the driver to enable autonomous takeoff after ACC was in Standing Active for more than CAdpvCrsCtrlStandgActvTakeOffReqPerd [%]" VALUE 1073886824 __SWord_Value 0 tPercent_100_S16 0.0 100.0 STEP_SIZE 1 /end CHARACTERISTIC
/begin CHARACTERISTIC CAdpvCrsCtrlSetVelGrdtIncFiltCoeff "Ramped gradient velocity increase filter coefficient [-]" VALUE 1073886820 __Float32_Value 0 NO_COMPU_METHOD -3.40282346639E+38 3.40282346639E+38 STEP_SIZE 1 FORMAT "%.6" /end CHARACTERISTIC
/begin CHARACTERISTIC CAdpvCrsCtrlSetVelGrdtDecFiltCoeff "Ramped gradient velocity increase filter coefficient [-]" VALUE 1073886816 __Float32_Value 0 NO_COMPU_METHOD -3.40282346639E+38 3.40282346639E+38 STEP_SIZE 1 FORMAT "%.6" /end CHARACTERISTIC
/begin CHARACTERISTIC CAdpvCrsCtrlFbCtrlrEna "Feedback control enable" VALUE 1073886813 __UByte_Value 0 NO_COMPU_METHOD 0 1 STEP_SIZE 1 FORMAT "%.2" /end CHARACTERISTIC
/begin CHARACTERISTIC CAdpvCrsCtrlFfCtrlrEna "Feedback control enable" VALUE 1073886812 __UByte_Value 0 NO_COMPU_METHOD 0 1 STEP_SIZE 1 FORMAT "%.2" /end CHARACTERISTIC
/begin CHARACTERISTIC CAdpvCrsCtrlGainP "Proportional gain of Cruise Controller [Ns]" VALUE 1073886808 __Float32_Value 0 NO_COMPU_METHOD -3.40282346639E+38 3.40282346639E+38 STEP_SIZE 1 FORMAT "%.6" /end CHARACTERISTIC
/begin CHARACTERISTIC CAdpvCrsCtrlGainI "Integral gain of Cruise Controller [N]" VALUE 1073886804 __Float32_Value 0 NO_COMPU_METHOD -3.40282346639E+38 3.40282346639E+38 STEP_SIZE 1 FORMAT "%.6" /end CHARACTERISTIC
/begin CHARACTERISTIC CAdpvCrsCtrlGainD "Derivative gain of Cruise Controller [Ns^2]" VALUE 1073886800 __Float32_Value 0 NO_COMPU_METHOD -3.40282346639E+38 3.40282346639E+38 STEP_SIZE 1 FORMAT "%.6" /end CHARACTERISTIC
/begin CHARACTERISTIC CAdpvCrsCtrlVelCtrlEnaDfdFil "Enable velocity controller velocity error derivative calculation" VALUE 1073886796 __UByte_Value 0 NO_COMPU_METHOD 0 1 STEP_SIZE 1 FORMAT "%.2" /end CHARACTERISTIC
/begin CHARACTERISTIC CAdpvCrsCtrlVelErrDerivIncFiltCoeff "Velocity Error Derivative Increase filter coefficient [-]" VALUE 1073886792 __Float32_Value 0 NO_COMPU_METHOD -3.40282346639E+38 3.40282346639E+38 STEP_SIZE 1 FORMAT "%.6" /end CHARACTERISTIC
/begin CHARACTERISTIC CAdpvCrsCtrlVelErrDerivDecFiltCoeff "Velocity Error Derivative Decrease filter coefficient [-]" VALUE 1073886788 __Float32_Value 0 NO_COMPU_METHOD -3.40282346639E+38 3.40282346639E+38 STEP_SIZE 1 FORMAT "%.6" /end CHARACTERISTIC
/begin CHARACTERISTIC CAdpvCrsCtrlWhlTqReqFilEna "Enable wheel torque filtering" VALUE 1073886784 __UByte_Value 0 NO_COMPU_METHOD 0 1 STEP_SIZE 1 FORMAT "%.2" /end CHARACTERISTIC
/begin CHARACTERISTIC CAdpvCrsCtrlWhlTqReqFilType "Wheel torque filter type" VALUE 1073886780 __ULong_Value 0 tLowPassFilterType 0 1 STEP_SIZE 1 /end CHARACTERISTIC
/begin CHARACTERISTIC CAdpvCrsCtrlWhlTqReqIncFiltCoeff "Cruise Control Troque Request Increase filter coefficient [-]" VALUE 1073886776 __Float32_Value 0 NO_COMPU_METHOD -3.40282346639E+38 3.40282346639E+38 STEP_SIZE 1 FORMAT "%.6" /end CHARACTERISTIC
/begin CHARACTERISTIC CAdpvCrsCtrlWhlTqReqDecFiltCoeff "Cruise Control Troque Request Decrease filter coefficient [-]" VALUE 1073886772 __Float32_Value 0 NO_COMPU_METHOD -3.40282346639E+38 3.40282346639E+38 STEP_SIZE 1 FORMAT "%.6" /end CHARACTERISTIC
/begin CHARACTERISTIC CAdpvCrsCtrlNotAllwdHoldTime "Cruise standby or active allowed false hold [ms]" VALUE 1073886768 __ULong_Value 0 tMillisecond_U32 0 3600000 STEP_SIZE 1 /end CHARACTERISTIC
/begin CHARACTERISTIC CAdpvCrsCtrlBtnDebPerd "Button debounce period [ms]" VALUE 1073886764 __ULong_Value 0 tMillisecond_U32 0 3600000 STEP_SIZE 1 /end CHARACTERISTIC
/begin CHARACTERISTIC CAdpvCrsCtrlBtnLongPsdPerd "Long pressed button period [ms]" VALUE 1073886760 __ULong_Value 0 tMillisecond_U32 0 3600000 STEP_SIZE 1 /end CHARACTERISTIC
/begin CHARACTERISTIC CAdpvCrsCtrlStateDropMaskRsnTime "Keep sending out mask for CAdpvCrsCtrlStateDropMaskRsnTime [ms]" VALUE 1073886756 __ULong_Value 0 tMillisecond_U32 0 3600000 STEP_SIZE 1 /end CHARACTERISTIC
/begin CHARACTERISTIC CAdpvCrsCtrlErrStResetWaitPerd "Keep Error state after camera blocked reason has disappeared [ms]" VALUE 1073886752 __ULong_Value 0 tMillisecond_U32 0 3600000 STEP_SIZE 1 /end CHARACTERISTIC
/begin CHARACTERISTIC CAutDrvrCtrlMstSwt "************************************************************************************************************************************************* * Automated Driver ******************************* Automated Driver Control master switch" VALUE 1073886748 __ULong_Value 0 tAutDrvrCtrlMstSwt 0 3 STEP_SIZE 1 /end CHARACTERISTIC
/begin CHARACTERISTIC CAutDrvrCtrlAllwdPerfMod "Perfomance modes for which it's allowed to run Automated Driver COntrol" CURVE 1073886716 __ULong_Value 0 tPerformanceMode 0 7 STEP_SIZE 1
 /begin AXIS_DESCR FIX_AXIS NO_INPUT_QUANTITY NO_COMPU_METHOD 7 0 6 FIX_AXIS_PAR_DIST 0 1 7 /end AXIS_DESCR
/end CHARACTERISTIC
/begin CHARACTERISTIC CAutDrvrCtrlMaskOvrd "Override Automated Driver Control OFF reason Mask" VALUE 1073886712 __UByte_Value 0 NO_COMPU_METHOD 0 1 STEP_SIZE 1 FORMAT "%.2" /end CHARACTERISTIC
/begin CHARACTERISTIC CAutDrvrCtrlRdyNotAllwdHoldPerd "Do not allow transition to RDY state for CAutDrvrCtrlRdyNotAllwdHoldPerd if an OFF reason is present" VALUE 1073886708 __ULong_Value 0 tMillisecond_U32 0 3600000 STEP_SIZE 1 /end CHARACTERISTIC
/begin CHARACTERISTIC CAutDrvrDrvModReqHoldPerd "Request drive mode Drive after holding the Neutral request when activating auto driver in auto-start mode" VALUE 1073886704 __ULong_Value 0 tMillisecond_U32 0 3600000 STEP_SIZE 1 /end CHARACTERISTIC
/begin CHARACTERISTIC CAutDrvrCtrlFbCtrlrEna "Enable Feedback controller for Automated Driver Control" VALUE 1073886702 __UByte_Value 0 NO_COMPU_METHOD 0 1 STEP_SIZE 1 FORMAT "%.2" /end CHARACTERISTIC
/begin CHARACTERISTIC CAutDrvrCtrlFfCtrlrEna "Enable Feedforward controller for Automated Driver Control" VALUE 1073886701 __UByte_Value 0 NO_COMPU_METHOD 0 1 STEP_SIZE 1 FORMAT "%.2" /end CHARACTERISTIC
/begin CHARACTERISTIC CAutDrvrCtrlAllwManModShift "Allow Automated Driver Control also in manual mode" VALUE 1073886700 __UByte_Value 0 NO_COMPU_METHOD 0 1 STEP_SIZE 1 FORMAT "%.2" /end CHARACTERISTIC
/begin CHARACTERISTIC CAutDrvrCtrlShutdwnStFbCtrlrEna "Keep Feedback controller active to control speed to 0 when in Shutdown state" VALUE 1073886699 __UByte_Value 0 NO_COMPU_METHOD 0 1 STEP_SIZE 1 FORMAT "%.2" /end CHARACTERISTIC
/begin CHARACTERISTIC CAutDrvrCtrlOvrdStFbCtrlrRstEna "Reset Feedback controller when in override state" VALUE 1073886698 __UByte_Value 0 NO_COMPU_METHOD 0 1 STEP_SIZE 1 FORMAT "%.2" /end CHARACTERISTIC
/begin CHARACTERISTIC CAutDrvrCtrlStOvrdIntgtrRstEna "If true reset the integrator when in override state, otherwise freeze" VALUE 1073886697 __UByte_Value 0 NO_COMPU_METHOD 0 1 STEP_SIZE 1 FORMAT "%.2" /end CHARACTERISTIC
/begin CHARACTERISTIC CAutDrvrCtrlEnaIntgtrInin "Enable Integrator initialization" VALUE 1073886696 __UByte_Value 0 NO_COMPU_METHOD 0 1 STEP_SIZE 1 FORMAT "%.2" /end CHARACTERISTIC
/begin CHARACTERISTIC CAutDrvrCtrlTarAccelFromCycEna "Enable using target acceleration coming from automated driver" VALUE 1073886695 __UByte_Value 0 NO_COMPU_METHOD 0 1 STEP_SIZE 1 FORMAT "%.2" /end CHARACTERISTIC
/begin CHARACTERISTIC CAutDrvrCtrlFfTqCmpRefVel "Use target velocity and acceleration to evaluate feedforward compensation torque" VALUE 1073886694 __UByte_Value 0 NO_COMPU_METHOD 0 1 STEP_SIZE 1 FORMAT "%.2" /end CHARACTERISTIC
/begin CHARACTERISTIC CAutDrvrCtrlTarVelMin "Minimum target velocity accepted by Automated Driver Control" VALUE 1073886692 __SWord_Value 0 tKilometrePerHour_10_S16 -600.0 600.0 STEP_SIZE 1 /end CHARACTERISTIC
/begin CHARACTERISTIC CAutDrvrCtrlTarVelMax "Maximum target velocity accepted by Automated Driver Control" VALUE 1073886690 __SWord_Value 0 tKilometrePerHour_10_S16 -600.0 600.0 STEP_SIZE 1 /end CHARACTERISTIC
/begin CHARACTERISTIC CAutDrvrCtrlTarAccelMin "Minimum target acceleration accepted by Automated Driver Control" VALUE 1073886688 __SWord_Value 0 tKilometrePerHour_10_S16 -600.0 600.0 STEP_SIZE 1 /end CHARACTERISTIC
/begin CHARACTERISTIC CAutDrvrCtrlTarAccelMax "Maximum target acceleration accepted by Automated Driver Control" VALUE 1073886686 __SWord_Value 0 tKilometrePerHour_10_S16 -600.0 600.0 STEP_SIZE 1 /end CHARACTERISTIC
/begin CHARACTERISTIC CAutDrvrCtrlRefAccelMinTab "Automated Driver Control limit speed ramp down rate [km/h per s] 6.5 equals 0.18 g acceleration, 1.0 equals 0.03 g" CURVE 1073886670 __SWord_Value 0 tKilometrePerHour_10_S16 -600.0 600.0 STEP_SIZE 1
 /begin AXIS_DESCR COM_AXIS NO_INPUT_QUANTITY tKilometrePerHour_10_S16 8 0 0 AXIS_PTS_REF CAutDrvrCtrlRefVelErrXsp /end AXIS_DESCR
/end CHARACTERISTIC
/begin CHARACTERISTIC CAutDrvrCtrlRefAccelMaxTab "Automated Driver Control limit speed ramp up rate [km/h per s] 6.5 equals 0.18 g acceleration, 1.0 equals 0.03 g" CURVE 1073886654 __SWord_Value 0 tKilometrePerHour_10_S16 -600.0 600.0 STEP_SIZE 1
 /begin AXIS_DESCR COM_AXIS NO_INPUT_QUANTITY tKilometrePerHour_10_S16 8 0 0 AXIS_PTS_REF CAutDrvrCtrlRefVelErrXsp /end AXIS_DESCR
/end CHARACTERISTIC
/begin AXIS_PTS CAutDrvrCtrlRefVelErrXsp "Requested speed error setpoint for Automated Driver Control target speed ramp up/down rate [km/h]" 1073886638 NO_INPUT_QUANTITY __SWord_Axis 0 tKilometrePerHour_10_S16 8 -600.0 600.0 STEP_SIZE 1 /end AXIS_PTS
/begin CHARACTERISTIC CAutDrvrCtrlTarVelFiltEna "Target velocity filter enable" VALUE 1073886636 __UByte_Value 0 NO_COMPU_METHOD 0 1 STEP_SIZE 1 FORMAT "%.2" /end CHARACTERISTIC
/begin CHARACTERISTIC CAutDrvrCtrlTarVelFiltCoeff "Target velocity filter cutoff frequency" VALUE 1073886632 __Float32_Value 0 tFactor -3.40282346639E+38 3.40282346639E+38 STEP_SIZE 1 /end CHARACTERISTIC
/begin CHARACTERISTIC CAutDrvrCtrlRefAccelFiltEna "Enable filter for reference acceleration signal" VALUE 1073886628 __UByte_Value 0 NO_COMPU_METHOD 0 1 STEP_SIZE 1 FORMAT "%.2" /end CHARACTERISTIC
/begin CHARACTERISTIC CAutDrvrCtrlSetVelGrdtFiltCoeff "Reference acceleration signal filter coefficient [-]" VALUE 1073886624 __Float32_Value 0 tFactor 0 0.5 STEP_SIZE 0.01 /end CHARACTERISTIC
/begin CHARACTERISTIC CAutDrvrCtrlVelErrDerivIncFiltCoeff "Velocity Error Derivative Increase filter coefficient [-]" VALUE 1073886620 __Float32_Value 0 tFactor -3.40282346639E+38 3.40282346639E+38 STEP_SIZE 1 /end CHARACTERISTIC
/begin CHARACTERISTIC CAutDrvrCtrlVelErrDerivDecFiltCoeff "Velocity Error Derivative Decrease filter coefficient [-]" VALUE 1073886616 __Float32_Value 0 tFactor -3.40282346639E+38 3.40282346639E+38 STEP_SIZE 1 /end CHARACTERISTIC
/begin CHARACTERISTIC CAutDrvrCtrlWhlTqReqFilEna "Enable output wheel torque filtering" VALUE 1073886612 __UByte_Value 0 NO_COMPU_METHOD 0 1 STEP_SIZE 1 FORMAT "%.2" /end CHARACTERISTIC
/begin CHARACTERISTIC CAutDrvrCtrlWhlTqReqFilType "Wheel torque request filter type" VALUE 1073886608 __ULong_Value 0 tLowPassFilterType 0 1 STEP_SIZE 1 /end CHARACTERISTIC
/begin CHARACTERISTIC CAutDrvrCtrlWhlTqReqFiltCoeff "Automated Driver Control Troque Request filter coefficient [-]" VALUE 1073886604 __Float32_Value 0 tFactor -3.40282346639E+38 3.40282346639E+38 STEP_SIZE 1 /end CHARACTERISTIC
/begin CHARACTERISTIC CAutDrvrCtrlGainP "Proportional gain of Automated Driver Controller [Ns]" VALUE 1073886600 __Float32_Value 0 NO_COMPU_METHOD -3.40282346639E+38 3.40282346639E+38 STEP_SIZE 1 FORMAT "%.6" /end CHARACTERISTIC
/begin CHARACTERISTIC CAutDrvrCtrlGainI "Integral gain of Automated Driver Controller [N]" VALUE 1073886596 __Float32_Value 0 NO_COMPU_METHOD -3.40282346639E+38 3.40282346639E+38 STEP_SIZE 1 FORMAT "%.6" /end CHARACTERISTIC
/begin CHARACTERISTIC CAutDrvrCtrlGainD "Derivative gain of Automated Driver Controller [Ns^2]" VALUE 1073886592 __Float32_Value 0 NO_COMPU_METHOD -3.40282346639E+38 3.40282346639E+38 STEP_SIZE 1 FORMAT "%.6" /end CHARACTERISTIC
/begin CHARACTERISTIC CAutDrvrCtrlFfWhlTqReqMin "Minimum wheel torque from Automated Driver Control feedforward" VALUE 1073886588 __SLong_Value 0 tNewtonMetre_100_S32 -100000.0 100000.0 STEP_SIZE 1 /end CHARACTERISTIC
/begin CHARACTERISTIC CAutDrvrCtrlFfWhlTqReqMax "Maximum wheel torque from Automated Driver Control feedforward" VALUE 1073886584 __SLong_Value 0 tNewtonMetre_100_S32 -100000.0 100000.0 STEP_SIZE 1 /end CHARACTERISTIC
/begin CHARACTERISTIC CAutDrvrCtrlIntglWhlTqMin "Minimum wheel torque from integral part of Automated Driver Controller" VALUE 1073886580 __SLong_Value 0 tNewtonMetre_100_S32 -100000.0 100000.0 STEP_SIZE 1 /end CHARACTERISTIC
/begin CHARACTERISTIC CAutDrvrCtrlIntglWhlTqMax "Maximum wheel torque from integral part of Automated Driver Controller" VALUE 1073886576 __SLong_Value 0 tNewtonMetre_100_S32 -100000.0 100000.0 STEP_SIZE 1 /end CHARACTERISTIC
/begin CHARACTERISTIC CAutDrvrCtrlFbWhlTqReqMin "Minimum wheel torque from Automated Driver Control feedback" VALUE 1073886572 __SLong_Value 0 tNewtonMetre_100_S32 -100000.0 100000.0 STEP_SIZE 1 /end CHARACTERISTIC
/begin CHARACTERISTIC CAutDrvrCtrlFbWhlTqReqMax "Maximum wheel torque from Automated Driver Control feedback" VALUE 1073886568 __SLong_Value 0 tNewtonMetre_100_S32 -100000.0 100000.0 STEP_SIZE 1 /end CHARACTERISTIC
/begin CHARACTERISTIC CAutDrvrCtrlTotWhlTqReqMin "Automated Driver Controller wheel torque request lower limit [Nm]" VALUE 1073886564 __SLong_Value 0 tNewtonMetre_100_S32 -100000.0 100000.0 STEP_SIZE 1 /end CHARACTERISTIC
/begin CHARACTERISTIC CAutDrvrCtrlTotWhlTqReqMax "Automated Driver Controller wheel torque request upper limit [Nm]" VALUE 1073886560 __SLong_Value 0 tNewtonMetre_100_S32 -100000.0 100000.0 STEP_SIZE 1 /end CHARACTERISTIC
/begin CHARACTERISTIC CAutDrvrCtrlStatySpd "Minimum speed threshold for automated driver to 'hold the brakes'" VALUE 1073886556 __Float32_Value 0 tKilometrePerHour -600 600 STEP_SIZE 1 /end CHARACTERISTIC
/begin CHARACTERISTIC CAutDrvrCtrlStatyTq "Automated driver 'hold the brakes' torque" VALUE 1073886552 __Float32_Value 0 tNewtonMetre -100000 100000 STEP_SIZE 1 /end CHARACTERISTIC
/begin CHARACTERISTIC CAuxBrkLiDecelAccActvnThres "Deceleration Brake Light request - longitudinal acceleration threshold for activation" VALUE 1073886544 __Float32_Value 0 tMetrePerSquareSecond -50 50 STEP_SIZE 1 /end CHARACTERISTIC
/begin CHARACTERISTIC CAuxBrkLiDecelAccDeactvnThres "Deceleration Brake Light request - longitudinal acceleration threshold for deactivation" VALUE 1073886540 __Float32_Value 0 tMetrePerSquareSecond -50 50 STEP_SIZE 1 /end CHARACTERISTIC
/begin CHARACTERISTIC CAuxBrkLiDecelTiMinActv "Deceleration Brake Light request - shortest time it shall be active, to avoid oscillating brake light" VALUE 1073886536 __ULong_Value 0 tMillisecond_U32 0 3600000 STEP_SIZE 1 /end CHARACTERISTIC
/begin CHARACTERISTIC CAuxBrkLiEssVehSpdThres "Emergency Stop Signal (ESS) minimum vehicle speed for activation" VALUE 1073886532 __SLong_Value 0 tKilometrePerHour_10_S32 -600.0 600.0 STEP_SIZE 1 /end CHARACTERISTIC
/begin CHARACTERISTIC CAuxBrkLiEssAccActvnThres "Emergency Stop Signal (ESS) longitudinal acceleration threshold for activation" VALUE 1073886528 __Float32_Value 0 tMetrePerSquareSecond -50 50 STEP_SIZE 1 /end CHARACTERISTIC
/begin CHARACTERISTIC CAuxBrkLiEssAccDeactvnThres "Emergency Stop Signal (ESS) longitudinal acceleration threshold for deactivation" VALUE 1073886524 __Float32_Value 0 tMetrePerSquareSecond -50 50 STEP_SIZE 1 /end CHARACTERISTIC
/begin CHARACTERISTIC CAuxOdoCntPerRev "Count per revolution, based on trigger wheel 48 teeth per rev, counts raising and falling edge" CURVE 1073886516 __UByte_Value 0 NO_COMPU_METHOD 0 255 STEP_SIZE 1 FORMAT "%.0"
 /begin AXIS_DESCR FIX_AXIS NO_INPUT_QUANTITY NO_COMPU_METHOD 4 0 3 FIX_AXIS_PAR_DIST 0 1 4 /end AXIS_DESCR
/end CHARACTERISTIC
/begin CHARACTERISTIC CChargingMaxSoC "HV battery Soc threshold to stop charging" VALUE 1073886512 __Float32_Value 0 tPercent 0 100 STEP_SIZE 5 /end CHARACTERISTIC
/begin CHARACTERISTIC CAsfStartupDelay "ASF startup delay" VALUE 1073886428 __ULong_Value 0 tMillisecond_U32 0 3600000 STEP_SIZE 1 /end CHARACTERISTIC
/begin CHARACTERISTIC CAsfEnaRideHeight "ASF Enable bit, RideHeight" VALUE 1073886427 __UByte_Value 0 NO_COMPU_METHOD 0 1 STEP_SIZE 1 FORMAT "%.2" /end CHARACTERISTIC
/begin CHARACTERISTIC CAsfEnaBrake "ASF Enable bit, Brake" VALUE 1073886426 __UByte_Value 0 NO_COMPU_METHOD 0 1 STEP_SIZE 1 FORMAT "%.2" /end CHARACTERISTIC
/begin CHARACTERISTIC CAsfEnaDamper "ASF Enable bit, Damper" VALUE 1073886425 __UByte_Value 0 NO_COMPU_METHOD 0 1 STEP_SIZE 1 FORMAT "%.2" /end CHARACTERISTIC
/begin CHARACTERISTIC CAsfEnaHydraulicPress "ASF Enable bit, HydraulicPress" VALUE 1073886424 __UByte_Value 0 NO_COMPU_METHOD 0 1 STEP_SIZE 1 FORMAT "%.2" /end CHARACTERISTIC
/begin CHARACTERISTIC CAsfEnaSteering "ASF Enable bit, Steering" VALUE 1073886423 __UByte_Value 0 NO_COMPU_METHOD 0 1 STEP_SIZE 1 FORMAT "%.2" /end CHARACTERISTIC
/begin CHARACTERISTIC CAsfEnaTpms "ASF Enable bit, Tpms" VALUE 1073886422 __UByte_Value 0 NO_COMPU_METHOD 0 1 STEP_SIZE 1 FORMAT "%.2" /end CHARACTERISTIC
/begin CHARACTERISTIC CAsfEnaImu "ASF Enable bit, Imu" VALUE 1073886421 __UByte_Value 0 NO_COMPU_METHOD 0 1 STEP_SIZE 1 FORMAT "%.2" /end CHARACTERISTIC
/begin CHARACTERISTIC CAsfEnaVehicleSpeed "ASF Enable bit, VehicleSpeed" VALUE 1073886420 __UByte_Value 0 NO_COMPU_METHOD 0 1 STEP_SIZE 1 FORMAT "%.2" /end CHARACTERISTIC
/begin CHARACTERISTIC CDrvrBrkSwtChoice "Decide if iebBrkSwtSt and/or brkLiSwtSt are taken for brkSwtFusedSt" VALUE 1073886416 __ULong_Value 0 tBrakeSwitchChoice 0 2 STEP_SIZE 1 /end CHARACTERISTIC
/begin AXIS_PTS CStatyRecupBrkWhlTqXsp "Stationary and low speed recuperation request limit setpoint" 1073886400 NO_INPUT_QUANTITY __SLong_Axis 0 tKilometrePerHour_10_S32 3 0 500 STEP_SIZE 1 /end AXIS_PTS
/begin CHARACTERISTIC CStatyRecupBrkWhlTqLim "Stationary and low speed recuperation request limit" CURVE 1073886388 __SLong_Value 0 tNewtonMetre_100_S32 -50000 0 STEP_SIZE 100
 /begin AXIS_DESCR COM_AXIS NO_INPUT_QUANTITY tKilometrePerHour_10_S32 3 0 0 AXIS_PTS_REF CStatyRecupBrkWhlTqXsp /end AXIS_DESCR
/end CHARACTERISTIC
/begin CHARACTERISTIC CDrvrAccrPedlPercMax "Maximum driver accelerator pedal" VALUE 1073886384 __SWord_Value 0 tPercent_100_S16 0.0 100.0 STEP_SIZE 1 /end CHARACTERISTIC
/begin CHARACTERISTIC CDrvrWhlTqReqFiltCoeff "Driver wheel torque request filter coefficient [-]" VALUE 1073886376 __Float32_Value 0 NO_COMPU_METHOD -3.40282346639E+38 3.40282346639E+38 STEP_SIZE 1 FORMAT "%.6" /end CHARACTERISTIC
/begin CHARACTERISTIC CDrvrWhlTqReqValLimUppr "Driver wheel torque request upper limit [Nm]" VALUE 1073886372 __Float32_Value 0 tNewtonMetre -100000 100000 STEP_SIZE 1 /end CHARACTERISTIC
/begin CHARACTERISTIC CDrvrWhlTqReqValLimLowr "Driver wheel torque request lower limit [Nm]" VALUE 1073886368 __Float32_Value 0 tNewtonMetre -100000 100000 STEP_SIZE 1 /end CHARACTERISTIC
/begin CHARACTERISTIC CDrvrWhlTqReqValLimRvsUppr "Driver wheel torque request upper limit for Reverse drive mode [Nm] OBS: Torque inversion in Reverse, Safe limit" VALUE 1073886364 __Float32_Value 0 tNewtonMetre -100000 100000 STEP_SIZE 1 /end CHARACTERISTIC
/begin CHARACTERISTIC CDrvrWhlTqReqValLimRvsLowr "Driver wheel torque request lower limit for Reverse drive mode [Nm] OBS: Torque inversion in Reverse, Safe limit" VALUE 1073886360 __Float32_Value 0 tNewtonMetre -100000 100000 STEP_SIZE 1 /end CHARACTERISTIC
/begin CHARACTERISTIC CDrvrWhlTqReqTranGrdtLimUppr "Driver wheel torque request at perf mode transition gradient upper limit [Nm/s] OBS: Safe limit" VALUE 1073886356 __SLong_Value 0 tNewtonMetre_100_S32 -100000.0 100000.0 STEP_SIZE 1 /end CHARACTERISTIC
/begin CHARACTERISTIC CDrvrWhlTqReqTranGrdtLimLowr "Driver wheel torque request at perf mode transition gradient lower limit [Nm/s] OBS: Safe limit" VALUE 1073886352 __SLong_Value 0 tNewtonMetre_100_S32 -100000.0 100000.0 STEP_SIZE 1 /end CHARACTERISTIC
/begin CHARACTERISTIC CDrvrWhlTqReqBtoTranGrdtLimUppr "Driver wheel torque request at BTO transition gradient upper limit [Nm/s] OBS: Safe limit" VALUE 1073886348 __SLong_Value 0 tNewtonMetre_100_S32 -100000.0 100000.0 STEP_SIZE 1 /end CHARACTERISTIC
/begin CHARACTERISTIC CDrvrWhlTqReqBtoTranGrdtLimLowr "Driver wheel torque request at BTO transition gradient lower limit [Nm/s] OBS: Safe limit" VALUE 1073886344 __SLong_Value 0 tNewtonMetre_100_S32 -100000.0 100000.0 STEP_SIZE 1 /end CHARACTERISTIC
/begin AXIS_PTS CDrvrWhlTqReqGrdtLimXsp "Vehicle speed absolute setpoint for driver wheel torque gradient limit" 1073886304 NO_INPUT_QUANTITY __SLong_Axis 0 tKilometrePerHour_10_S32 9 -600.0 600.0 STEP_SIZE 1 /end AXIS_PTS
/begin AXIS_PTS CDrvrWhlTqReqGrdtLimYsp "Driver wheel torque request setpoint for driver wheel torque gradient limit" 1073886276 NO_INPUT_QUANTITY __SLong_Axis 0 tNewtonMetre_100_S32 7 -15000.0 15000.0 STEP_SIZE 25 /end AXIS_PTS
/begin CHARACTERISTIC CDrvrWhlTqReqGrdtLimUpprMap "Driver wheel torque request gradient upper limit map [Nm/s]" MAP 1073886024 __SLong_Value 0 tNewtonMetre_100_S32 0 200000.0 STEP_SIZE 5
 /begin AXIS_DESCR COM_AXIS NO_INPUT_QUANTITY tKilometrePerHour_10_S32 9 0 0 AXIS_PTS_REF CDrvrWhlTqReqGrdtLimXsp /end AXIS_DESCR
 /begin AXIS_DESCR COM_AXIS NO_INPUT_QUANTITY tNewtonMetre_100_S32 7 0 0 AXIS_PTS_REF CDrvrWhlTqReqGrdtLimYsp /end AXIS_DESCR
/end CHARACTERISTIC
/begin CHARACTERISTIC CDrvrWhlTqReqGrdtLimLowrMap "Driver wheel torque request gradient lower limit map [Nm/s]" MAP 1073885772 __SLong_Value 0 tNewtonMetre_100_S32 -200000.0 0 STEP_SIZE 5
 /begin AXIS_DESCR COM_AXIS NO_INPUT_QUANTITY tKilometrePerHour_10_S32 9 0 0 AXIS_PTS_REF CDrvrWhlTqReqGrdtLimXsp /end AXIS_DESCR
 /begin AXIS_DESCR COM_AXIS NO_INPUT_QUANTITY tNewtonMetre_100_S32 7 0 0 AXIS_PTS_REF CDrvrWhlTqReqGrdtLimYsp /end AXIS_DESCR
/end CHARACTERISTIC
/begin CHARACTERISTIC CDrvrBrkPedlPercBasBto "Brake pedal percent threshold for Brake-throttle override in base pedal map" VALUE 1073885770 __SWord_Value 0 tPercent_100_S16 0.0 100.0 STEP_SIZE 1 /end CHARACTERISTIC
/begin CHARACTERISTIC CDrvrBrkPedlPercTrackBto "Brake pedal percent threshold for Brake-throttle override in track pedal map" VALUE 1073885768 __SWord_Value 0 tPercent_100_S16 0.0 100.0 STEP_SIZE 1 /end CHARACTERISTIC
/begin CHARACTERISTIC CDrvrWhlTqBasLimBto "Wheel torque request limit when brake-throttle override is active" VALUE 1073885764 __SLong_Value 0 tNewtonMetre_100_S32 0 5000 STEP_SIZE 100 /end CHARACTERISTIC
/begin CHARACTERISTIC CDrvrWhlTqTrackLimBto "Wheel torque request limit when brake-throttle override is active in track mode" VALUE 1073885760 __SLong_Value 0 tNewtonMetre_100_S32 0 5000 STEP_SIZE 100 /end CHARACTERISTIC
/begin CHARACTERISTIC CDrvrWhlTqPedlMapRespvPeak "Peak Pedal Map Torque for Responsive and Track_Only perfModPedlMapMod" VALUE 1073885756 __SLong_Value 0 tNewtonMetre_100_S32 2500 13000 STEP_SIZE 100 /end CHARACTERISTIC
/begin CHARACTERISTIC CDrvrWhlTqPedlMapNormPeak "Peak Pedal Map Torque for Normal perfModPedlMapMod" VALUE 1073885752 __SLong_Value 0 tNewtonMetre_100_S32 2500 13000 STEP_SIZE 100 /end CHARACTERISTIC
/begin CHARACTERISTIC CDrvrWhlTqPedlMapSlugPeak "Peak Pedal Map Torque for Sluggish perfModPedlMapMod" VALUE 1073885748 __SLong_Value 0 tNewtonMetre_100_S32 2500 13000 STEP_SIZE 100 /end CHARACTERISTIC
/begin CHARACTERISTIC CDrvrWhlTqPedlMapElecPeak "Peak Pedal Map Torque for Ev perfModPedlMapMod" VALUE 1073885744 __SLong_Value 0 tNewtonMetre_100_S32 2500 13000 STEP_SIZE 100 /end CHARACTERISTIC
/begin CHARACTERISTIC CDrvrWhlTqPedlMapRegenLow "Pedal Map Regen target at 0 pedal, perfModRgnMod = NO_RGN" VALUE 1073885740 __SLong_Value 0 tNewtonMetre_100_S32 -4000 0 STEP_SIZE 100 /end CHARACTERISTIC
/begin CHARACTERISTIC CDrvrWhlTqPedlMapRegenMid "Pedal Map Regen target at 0 pedal, perfModRgnMod = MID_RGN" VALUE 1073885736 __SLong_Value 0 tNewtonMetre_100_S32 -4000 0 STEP_SIZE 100 /end CHARACTERISTIC
/begin CHARACTERISTIC CDrvrWhlTqPedlMapRegenHigh "Pedal Map Regen target at 0 pedal, perfModRgnMod = HIGH_RGN" VALUE 1073885732 __SLong_Value 0 tNewtonMetre_100_S32 -4000 0 STEP_SIZE 100 /end CHARACTERISTIC
/begin CHARACTERISTIC CDrvrWhlTqPedlMapSpdLim "Pedal Map speed limits" CURVE 1073885708 __SLong_Value 0 tKilometrePerHour_10_S32 -600.0 600.0 STEP_SIZE 1
 /begin AXIS_DESCR FIX_AXIS NO_INPUT_QUANTITY NO_COMPU_METHOD 6 0 5 FIX_AXIS_PAR_DIST 0 1 6 /end AXIS_DESCR
/end CHARACTERISTIC
/begin CHARACTERISTIC CDrvrWhlTqPedlMapSpdLimRampUppr "Pedal Map speed limit ramp limit upper limit" VALUE 1073885704 __SLong_Value 0 tKilometrePerHour_10_S32 -600.0 600.0 STEP_SIZE 1 /end CHARACTERISTIC
/begin CHARACTERISTIC CDrvrWhlTqPedlMapSpdLimRampLowr "Pedal Map speed limit ramp limit lower limit" VALUE 1073885700 __SLong_Value 0 tKilometrePerHour_10_S32 -600.0 600.0 STEP_SIZE 1 /end CHARACTERISTIC
/begin CHARACTERISTIC CDrvrWhlTqPedlMapTireRd "Fixed tire rolling radius for pedal map calculations [m]" VALUE 1073885696 __Float32_Value 0 tMetre 0.2 0.5 STEP_SIZE 0.001 /end CHARACTERISTIC
/begin CHARACTERISTIC CDrvrWhlTqPedlMapSpdPedCoeff "Pedal target at maximum speed [%]" VALUE 1073885692 __Float32_Value 0 NO_COMPU_METHOD -3.40282346639E+38 3.40282346639E+38 STEP_SIZE 1 FORMAT "%.6" /end CHARACTERISTIC
/begin CHARACTERISTIC CDrvrWhlTqPedlMapEngDragCompEna "Enable engine drag torque compensation" VALUE 1073885688 __UByte_Value 0 NO_COMPU_METHOD 0 1 STEP_SIZE 1 FORMAT "%.2" /end CHARACTERISTIC
/begin CHARACTERISTIC CDrvrWhlTqPedlMapEngDragCompPoly "Engine drag polynomial coefficients" CURVE 1073885676 __Float32_Value 0 NO_COMPU_METHOD -3.40282346639E+38 3.40282346639E+38 STEP_SIZE 1 FORMAT "%.6"
 /begin AXIS_DESCR FIX_AXIS NO_INPUT_QUANTITY NO_COMPU_METHOD 3 0 2 FIX_AXIS_PAR_DIST 0 1 3 /end AXIS_DESCR
/end CHARACTERISTIC
/begin CHARACTERISTIC CDrvrWhlTqPedlMapRegenRampInRate "Ramp-in rate of regen torque from 10kph '0' point [Nm/kph]" VALUE 1073885672 __Float32_Value 0 NO_COMPU_METHOD -3.40282346639E+38 3.40282346639E+38 STEP_SIZE 1 FORMAT "%.6" /end CHARACTERISTIC
/begin AXIS_PTS CDrvrRevIceSpdTarXsp "Pedal setpoint for driver ICE rev torque request [%]" 1073885666 NO_INPUT_QUANTITY __SWord_Axis 0 tPercent_100_S16 2 0.0 100.0 STEP_SIZE 1 /end AXIS_PTS
/begin CHARACTERISTIC CDrvModParkNeutralIgnOffEna "Enable transitions between Park and Neutral when ignition is off, using the park button" VALUE 1073885652 __UByte_Value 0 NO_COMPU_METHOD 0 1 STEP_SIZE 1 FORMAT "%.2" /end CHARACTERISTIC
/begin CHARACTERISTIC CDrvCfgSelnTime "Time threshold to accept drive configuration change from Headunit [ms]" VALUE 1073885648 __ULong_Value 0 tMillisecond_U32 0 3600000 STEP_SIZE 1 /end CHARACTERISTIC
/begin CHARACTERISTIC CDrvrModReqSteerWhlKnobStep "Steering wheel knob encoder increments" VALUE 1073885613 __UByte_Value 0 NO_COMPU_METHOD 0 255 STEP_SIZE 1 FORMAT "%.0" /end CHARACTERISTIC
/begin CHARACTERISTIC CDrvrModReqSteerWhlKnobRollovrEna "Enable to do a rollover of the selection order array if the index is at the first or last position" VALUE 1073885612 __UByte_Value 0 NO_COMPU_METHOD 0 1 STEP_SIZE 1 FORMAT "%.2" /end CHARACTERISTIC
/begin CHARACTERISTIC CPerfModReqSelnOrder "Performance mode selection order array" CURVE 1073885588 __SLong_Value 0 NO_COMPU_METHOD -2147483648 2147483647 STEP_SIZE 1 FORMAT "%.0"
 /begin AXIS_DESCR FIX_AXIS NO_INPUT_QUANTITY NO_COMPU_METHOD 6 0 5 FIX_AXIS_PAR_DIST 0 1 6 /end AXIS_DESCR
/end CHARACTERISTIC
/begin CHARACTERISTIC CPerfModCptSwtReqEna "Performance mode component switches enable in HU: if false disable the switch in HU so driver can't make a selection in any perfMod" CURVE 1073885560 __UByte_Value 0 NO_COMPU_METHOD 0 1 STEP_SIZE 1 FORMAT "%.2"
 /begin AXIS_DESCR FIX_AXIS NO_INPUT_QUANTITY NO_COMPU_METHOD 13 0 12 FIX_AXIS_PAR_DIST 0 1 13 /end AXIS_DESCR
/end CHARACTERISTIC
/begin CHARACTERISTIC CDisableAutoMod "Force the car into manual mode" VALUE 1073885534 __UByte_Value 0 NO_COMPU_METHOD 0 1 STEP_SIZE 1 FORMAT "%.2" /end CHARACTERISTIC
/begin CHARACTERISTIC CAutoModeReturnLim "Pedal limit to return to automatic mode again after pressing paddles [%]" VALUE 1073885532 __SWord_Value 0 tPercent_100_S16 0.0 100.0 STEP_SIZE 1 /end CHARACTERISTIC
/begin CHARACTERISTIC CAutoHillHoldMod "Auto Hill Hold mode" VALUE 1073885460 __ULong_Value 0 tAutoHillHoldMode 0 4 STEP_SIZE 1 /end CHARACTERISTIC
/begin CHARACTERISTIC CTestAutoHillHoldBrkPReqVal "Brake pressure request override" CURVE 1073885442 __SWord_Value 0 tBar_10_S16 0 255 STEP_SIZE 10
 /begin AXIS_DESCR FIX_AXIS NO_INPUT_QUANTITY NO_COMPU_METHOD 4 0 3 FIX_AXIS_PAR_DIST 0 1 4 /end AXIS_DESCR
/end CHARACTERISTIC
/begin CHARACTERISTIC CAutoHillHoldIebCtrlPrkgBrkEngdDurgHoldP "Use parking brake as IEB's HHC backup" VALUE 1073885441 __UByte_Value 0 NO_COMPU_METHOD 0 1 STEP_SIZE 1 FORMAT "%.2" /end CHARACTERISTIC
/begin CHARACTERISTIC CAutoHillHoldPrkgBrkReqEna "Enable use of parking brakes" VALUE 1073885440 __UByte_Value 0 NO_COMPU_METHOD 0 1 STEP_SIZE 1 FORMAT "%.2" /end CHARACTERISTIC
/begin CHARACTERISTIC CAutoHillHoldDrvModNeutralStCtrl "Enable auto hold state control in Neutral using brake pedal steps" VALUE 1073885439 __UByte_Value 0 NO_COMPU_METHOD 0 1 STEP_SIZE 1 FORMAT "%.2" /end CHARACTERISTIC
/begin CHARACTERISTIC CAutoHillHoldDrvgWhlTqEna "Enable using the vso wheel torque as driving torque instead of the driver's request" VALUE 1073885438 __UByte_Value 0 NO_COMPU_METHOD 0 1 STEP_SIZE 1 FORMAT "%.2" /end CHARACTERISTIC
/begin CHARACTERISTIC CAutoHillHoldBrkPedlPercMin "Minimum brake pedal percentage to be considered pressed" VALUE 1073885436 __SWord_Value 0 tPercent_100_S16 0.0 100.0 STEP_SIZE 1 /end CHARACTERISTIC
/begin CHARACTERISTIC CAutoHillHoldBrkPedlPercMax "Maximum brake pedal percentage considered for auto hold activation" VALUE 1073885434 __SWord_Value 0 tPercent_100_S16 0.0 100.0 STEP_SIZE 1 /end CHARACTERISTIC
/begin CHARACTERISTIC CAutoHillHoldActvBrkPedlPercStep "Step in brake pedal percentage to consider a auto hold activation request" VALUE 1073885432 __SWord_Value 0 tPercent_100_S16 0.0 100.0 STEP_SIZE 1 /end CHARACTERISTIC
/begin CHARACTERISTIC CAutoHillHoldStOffVehVelThd "Vehicle velocity treshold to force AHH to OFF (including telltale)" VALUE 1073885430 __SWord_Value 0 tKilometrePerHour_10_S16 -600.0 600.0 STEP_SIZE 1 /end CHARACTERISTIC
/begin CHARACTERISTIC CAutoHillHoldStOffVehVelHyst "Vehicle velocity treshold hysteresis to force AHH to OFF (including telltale)" VALUE 1073885428 __SWord_Value 0 tKilometrePerHour_10_S16 -600.0 600.0 STEP_SIZE 1 /end CHARACTERISTIC
/begin CHARACTERISTIC CAutoHillHoldRoadGrdtMinStartRollg "Minimum road gradient that makes the car start rolling by itself" VALUE 1073885424 __Float32_Value 0 tRadian -20 20 STEP_SIZE 1 /end CHARACTERISTIC
/begin CHARACTERISTIC CAutoHillHoldRoadGrdtMinStartRollgHyst "Minimum road gradient hysteresis that makes the car start rolling by itself" VALUE 1073885420 __Float32_Value 0 tRadian -20 20 STEP_SIZE 1 /end CHARACTERISTIC
/begin CHARACTERISTIC CAutoHillHoldTakeoffWhlTqHyst "Wheel torque hysteresis value to evaluate the necessary torque to takeoff" VALUE 1073885416 __Float32_Value 0 tNewtonMetre -100000 100000 STEP_SIZE 1 /end CHARACTERISTIC
/begin CHARACTERISTIC CAutoHillHoldStatyBrkAbsTqMax "maximum allowed stationary brake torque" VALUE 1073885412 __Float32_Value 0 tNewtonMetre -100000 100000 STEP_SIZE 1 /end CHARACTERISTIC
/begin CHARACTERISTIC CAutoHillHoldDrvgWhlTqMin "Minimum driving torque to consider the driver's request to take off when hill hold or auto hold are active" VALUE 1073885408 __Float32_Value 0 tNewtonMetre -100000 100000 STEP_SIZE 1 /end CHARACTERISTIC
/begin CHARACTERISTIC CAutoHillHoldStatyBrkPMin "Stationary minimum brake pressure" VALUE 1073885406 __SWord_Value 0 tBar_10_S16 -1.0 1000.0 STEP_SIZE 1 /end CHARACTERISTIC
/begin CHARACTERISTIC CAutoHillHoldAddlBrkPRollgStep "Additional brake pressure step in case of unwanted vehicle rolling" VALUE 1073885404 __SWord_Value 0 tBar_10_S16 -1.0 1000.0 STEP_SIZE 1 /end CHARACTERISTIC
/begin CHARACTERISTIC CAutoHillHoldTarBrkPGrdtMin "Minimum ramp down gradient for target brake pressure [bar/s]" VALUE 1073885400 __Float32_Value 0 tBar -1 1000 STEP_SIZE 1 /end CHARACTERISTIC
/begin CHARACTERISTIC CAutoHillHoldTarBrkPGrdtMax "Maximum ramp up gradient for target brake pressure [bar/s]" VALUE 1073885396 __Float32_Value 0 tBar -1 1000 STEP_SIZE 1 /end CHARACTERISTIC
/begin CHARACTERISTIC CAutoHillHoldBrkCoeffMin "Minimum allowed brake coefficient, to avoid 0 division and using overheated brake callipers" VALUE 1073885392 __Float32_Value 0 tFactor -3.40282346639E+38 3.40282346639E+38 STEP_SIZE 1 /end CHARACTERISTIC
/begin CHARACTERISTIC CAutoHillHoldPrkgBrkReqWaitPerd "Wait period before activating parking brakes to support auto/hill hold" VALUE 1073885388 __ULong_Value 0 tMillisecond_U32 0 3600000 STEP_SIZE 1 /end CHARACTERISTIC
/begin CHARACTERISTIC CDisengageLowLimit "Min current to consider ebrakes disengaged. Used together with other requirements" VALUE 1073885384 __SWord_Value 0 tAmpere_100_S16 0.0 10000.0 STEP_SIZE 1 /end CHARACTERISTIC
/begin CHARACTERISTIC CEBrakeOLThres "Current limit gradient for disengaging of EBrake" VALUE 1073885380 __SWord_Value 0 tAmpere_100_S16 0.0 10000.0 STEP_SIZE 1 /end CHARACTERISTIC
/begin CHARACTERISTIC CEBrakeBlankingTimePos "Time where the brakes are only limited by CEBrakeAbsoluteMaxLimit while disengaging" VALUE 1073885376 __ULong_Value 0 tMillisecond_U32 0 3600000 STEP_SIZE 1 /end CHARACTERISTIC
/begin CHARACTERISTIC CEBrakeBlankingTimeNeg "Time where the brakes are only limited by CEBrakeAbsoluteMaxLimit while engaging" VALUE 1073885372 __ULong_Value 0 tMillisecond_U32 0 3600000 STEP_SIZE 1 /end CHARACTERISTIC
/begin CHARACTERISTIC CEBrakeAbsoluteMaxLimit "Absolute max current for EBrakes at any time" VALUE 1073885368 __SWord_Value 0 tAmpere_100_S16 0.0 10000.0 STEP_SIZE 1 /end CHARACTERISTIC
/begin CHARACTERISTIC CEBrakeDisengageTime "Max time to disengage for normal use" VALUE 1073885364 __ULong_Value 0 tMillisecond_U32 0 3600000 STEP_SIZE 1 /end CHARACTERISTIC
/begin CHARACTERISTIC CEBrakeDisengageTimeService "Max time to disengage for service" VALUE 1073885360 __ULong_Value 0 tMillisecond_U32 0 3600000 STEP_SIZE 1 /end CHARACTERISTIC
/begin CHARACTERISTIC CEBrakeEngageTime "Max time to engage" VALUE 1073885356 __ULong_Value 0 tMillisecond_U32 0 3600000 STEP_SIZE 1 /end CHARACTERISTIC
/begin CHARACTERISTIC CEBrakeDeadPeriod "Percent of period to keep low between high side and low side PWM signals alternate (1000 for 10%)" VALUE 1073885350 __SWord_Value 0 NO_COMPU_METHOD -32768 32767 STEP_SIZE 1 FORMAT "%.0" /end CHARACTERISTIC
/begin CHARACTERISTIC CSpdSnsrRearSign "Rear outer clutch speed sensor sign direction" CURVE 1073885316 __SLong_Value 0 tSign -1 1 STEP_SIZE 2
 /begin AXIS_DESCR FIX_AXIS NO_INPUT_QUANTITY NO_COMPU_METHOD 2 0 1 FIX_AXIS_PAR_DIST 0 1 2 /end AXIS_DESCR
/end CHARACTERISTIC
/begin CHARACTERISTIC CSpdSnsrCluManShutoff "Manually disable the use of any outer clutch speed sensors" CURVE 1073885300 __UByte_Value 0 NO_COMPU_METHOD 0 1 STEP_SIZE 1 FORMAT "%.2"
 /begin AXIS_DESCR FIX_AXIS NO_INPUT_QUANTITY NO_COMPU_METHOD 4 0 3 FIX_AXIS_PAR_DIST 0 1 4 /end AXIS_DESCR
/end CHARACTERISTIC
/begin CHARACTERISTIC CCooltSnsrAmphenolTTab "Amphenol GE-2099/GE-2098 temperature sensor temperature values" CURVE 1073885176 __Float32_Value 0 NO_COMPU_METHOD -3.40282346639E+38 3.40282346639E+38 STEP_SIZE 1 FORMAT "%.6"
 /begin AXIS_DESCR FIX_AXIS NO_INPUT_QUANTITY NO_COMPU_METHOD 14 0 13 FIX_AXIS_PAR_DIST 0 1 14 /end AXIS_DESCR
/end CHARACTERISTIC
/begin AXIS_PTS CCooltSnsrAmphenolTXsp "Amphenol GE-2099/GE-2098 temperature sensor resistance setpoint" 1073885120 NO_INPUT_QUANTITY __Float32_Axis 0 NO_COMPU_METHOD 14 -3.40282346639E+38 3.40282346639E+38 STEP_SIZE 1 FORMAT "%.6" /end AXIS_PTS
/begin CHARACTERISTIC CTempSnsrNtcJumoTab "Temperature points for JUMO temperature sensors" CURVE 1073885074 __SWord_Value 0 tCelsius_10_S16 -400.0 10000.0 STEP_SIZE 1
 /begin AXIS_DESCR COM_AXIS NO_INPUT_QUANTITY tMillivolt_S16 23 0 0 AXIS_PTS_REF CTempSnsrNtcJumoXsp /end AXIS_DESCR
/end CHARACTERISTIC
/begin AXIS_PTS CTempSnsrNtcJumoXsp "Millivolt setpoint for JUMO temperature sensors" 1073885028 NO_INPUT_QUANTITY __SWord_Axis 0 tMillivolt_S16 23 0 10000 STEP_SIZE 1 /end AXIS_PTS
/begin CHARACTERISTIC CEBrakeCalibrationUnclampTime "E-Brakes unclamp period for calibration routine [ms]" VALUE 1073885020 __ULong_Value 0 tMillisecond_U32 0 3600000 STEP_SIZE 1 /end CHARACTERISTIC
/begin CHARACTERISTIC CEBrakeCalibrationDeadTime "E-Brakes dead time during calibration [ms]" VALUE 1073885016 __ULong_Value 0 tMillisecond_U32 0 3600000 STEP_SIZE 1 /end CHARACTERISTIC
/begin CHARACTERISTIC CDefaultInvPumpSpeed "Inverter cooling pump speed request [0-100%]" VALUE 1073885009 __SByte_Value 0 tPercent_S8 0 100 STEP_SIZE 1 /end CHARACTERISTIC
/begin CHARACTERISTIC CDefaultInvFanSpeed "Inverter cooling fan speed request [0-100%]" VALUE 1073885008 __SByte_Value 0 tPercent_S8 0 100 STEP_SIZE 1 /end CHARACTERISTIC
/begin AXIS_PTS CInvPumpReqXsp "Inverter cooling pump speed request x-axis, Degree C" 1073884980 NO_INPUT_QUANTITY __Float32_Axis 0 tDegree 7 -720 720 STEP_SIZE 1 /end AXIS_PTS
/begin AXIS_PTS CInvPumpReqYsp "Inverter cooling pump speed request Y-axis, Percentage" 1073884952 NO_INPUT_QUANTITY __Float32_Axis 0 tPercent 7 0 100 STEP_SIZE 1 /end AXIS_PTS
/begin AXIS_PTS CInvFanReqXsp "Inverter cooling fan speed request x-axis, Degree C" 1073884924 NO_INPUT_QUANTITY __Float32_Axis 0 tDegree 7 -720 720 STEP_SIZE 1 /end AXIS_PTS
/begin AXIS_PTS CInvFanReqYsp "Inverter cooling fan speed request Y-axis, Percentage" 1073884896 NO_INPUT_QUANTITY __Float32_Axis 0 tPercent 7 0 100 STEP_SIZE 1 /end AXIS_PTS
/begin CHARACTERISTIC CDefaultMotPumpSpeed "Motor cooling pump speed request [0-100%]" VALUE 1073884893 __SByte_Value 0 tPercent_S8 0 100 STEP_SIZE 1 /end CHARACTERISTIC
/begin CHARACTERISTIC CDefaultMotFanSpeed "Motor cooling fan speed request [0-100%]" VALUE 1073884892 __SByte_Value 0 tPercent_S8 0 100 STEP_SIZE 1 /end CHARACTERISTIC
/begin AXIS_PTS CMotPumpReqXsp "Motor cooling pump speed request x-axis, Degree C" 1073884864 NO_INPUT_QUANTITY __Float32_Axis 0 tDegree 7 -720 720 STEP_SIZE 1 /end AXIS_PTS
/begin AXIS_PTS CMotPumpReqYsp "Motor cooling pump speed request Y-axis, Percentage" 1073884836 NO_INPUT_QUANTITY __Float32_Axis 0 tPercent 7 0 100 STEP_SIZE 1 /end AXIS_PTS
/begin AXIS_PTS CMotFanReqXsp "Motor cooling fan speed request x-axis, Degree C" 1073884808 NO_INPUT_QUANTITY __Float32_Axis 0 tDegree 7 -720 720 STEP_SIZE 1 /end AXIS_PTS
/begin AXIS_PTS CMotFanReqYsp "Motor cooling fan speed request Y-axis, Percentage" 1073884780 NO_INPUT_QUANTITY __Float32_Axis 0 tPercent 7 0 100 STEP_SIZE 1 /end AXIS_PTS
/begin CHARACTERISTIC CElecMotEffTab "eMotor efficiency map function of speed and torque" MAP 1073883748 __Float32_Value 0 NO_COMPU_METHOD 0 1 STEP_SIZE 0.01 FORMAT "%.6"
 /begin AXIS_DESCR COM_AXIS shared.hybrid.elecMotSpd NO_COMPU_METHOD 17 0 0 AXIS_PTS_REF CElecMotEffXsp /end AXIS_DESCR
 /begin AXIS_DESCR COM_AXIS shared.hybrid.elecMotTqEstimd NO_COMPU_METHOD 15 0 0 AXIS_PTS_REF CElecMotEffYsp /end AXIS_DESCR
/end CHARACTERISTIC
/begin AXIS_PTS CElecMotEffXsp "eMotor efficiency map, spped axis [rpm]" 1073883680 shared.hybrid.elecMotSpd __Float32_Axis 0 NO_COMPU_METHOD 17 0 9000 STEP_SIZE 100 FORMAT "%.6" /end AXIS_PTS
/begin AXIS_PTS CElecMotEffYsp "eMotor efficiency map, tprque axis [Nm]" 1073883620 shared.hybrid.elecMotTqEstimd __Float32_Axis 0 NO_COMPU_METHOD 15 0 9000 STEP_SIZE 100 FORMAT "%.6" /end AXIS_PTS
/begin CHARACTERISTIC CBatSoCPowerDemandTab "eMotor power demand vs SOC (negative for discharge) [kW]" CURVE 1073883596 __Float32_Value 0 tKilowatt -200 0 STEP_SIZE 1
 /begin AXIS_DESCR COM_AXIS taskHybridTorque.libHybridTorque.hvBatterySoc tPercent 6 0 0 AXIS_PTS_REF CBatSoCPowerDemandXsp /end AXIS_DESCR
/end CHARACTERISTIC
/begin AXIS_PTS CBatSoCPowerDemandXsp "SOC breakpoints used to define eMotor power demand map [%]" 1073883572 taskHybridTorque.libHybridTorque.hvBatterySoc __Float32_Axis 0 tPercent 6 0 100 STEP_SIZE 5 /end AXIS_PTS
/begin AXIS_PTS CHvBattVocXsp "Voc lookup table Soc axis [%]" 1073883464 NO_INPUT_QUANTITY __Float32_Axis 0 NO_COMPU_METHOD 11 0 100 STEP_SIZE 10 FORMAT "%.6" /end AXIS_PTS
/begin CHARACTERISTIC CHvBattVocTab "Voc lookup table function of Soc @25C [V]" CURVE 1073883420 __Float32_Value 0 tVolt 0 10 STEP_SIZE 1
 /begin AXIS_DESCR COM_AXIS shared.hybrid.elecMotPwrDmd tKilowatt_S16 11 0 0 AXIS_PTS_REF CHybIceSpdXsp /end AXIS_DESCR
/end CHARACTERISTIC
/begin CHARACTERISTIC CDeltaSocHyst "delta Soc hysteresis" VALUE 1073883340 __Float32_Value 0 NO_COMPU_METHOD 0 1 STEP_SIZE 1 FORMAT "%.6" /end CHARACTERISTIC
/begin CHARACTERISTIC CDeltaSocThrUnfreeze "Delta soc threshold to unfreeze the integral correction" VALUE 1073883336 __Float32_Value 0 NO_COMPU_METHOD 0 1 STEP_SIZE 1 FORMAT "%.6" /end CHARACTERISTIC
/begin CHARACTERISTIC CDeplEgyMgrPidKd "Derivative gain for SoC charge-depleting PID controller" VALUE 1073883316 __Float32_Value 0 NO_COMPU_METHOD -1000 1000.0 STEP_SIZE 0.01 FORMAT "%.6" /end CHARACTERISTIC
/begin CHARACTERISTIC CDeplEgyMgrPidKp "Proportional gain for SoC charge-depleting PID controller" VALUE 1073883312 __Float32_Value 0 NO_COMPU_METHOD -1000 1000.0 STEP_SIZE 0.01 FORMAT "%.6" /end CHARACTERISTIC
/begin CHARACTERISTIC CDeplEgyMgrPidKi "Integral gain for SoC charge-depleting PID controller" VALUE 1073883308 __Float32_Value 0 NO_COMPU_METHOD -1000 1000.0 STEP_SIZE 0.01 FORMAT "%.6" /end CHARACTERISTIC
/begin AXIS_PTS CSustSocErrXsp "Delta soc breakpoints used to define different charge-sustaining pid gains" 1073883284 taskEnergyManager.locals.egyMgrPidTimeHrzn __Float32_Axis 0 NO_COMPU_METHOD 6 -1000 1000 STEP_SIZE 0.001 FORMAT "%.6" /end AXIS_PTS
/begin AXIS_PTS CDeplSocErrXsp "Delta soc breakpoints used to define different charge-depleting pid gains" 1073883260 NO_INPUT_QUANTITY __Float32_Axis 0 NO_COMPU_METHOD 6 -1000 1000 STEP_SIZE 0.001 FORMAT "%.6" /end AXIS_PTS
/begin AXIS_PTS CPwrReqYsp "Power request used to define different sustain pid gains" 1073883228 NO_INPUT_QUANTITY __Float32_Axis 0 NO_COMPU_METHOD 8 -1000 1000 STEP_SIZE 0.001 FORMAT "%.6" /end AXIS_PTS
/begin CHARACTERISTIC CSustEgyMgrKpTab "Proportional gain charge-sustaining pid map" MAP 1073883036 __Float32_Value 0 NO_COMPU_METHOD 0 1000 STEP_SIZE 0.001 FORMAT "%.6"
 /begin AXIS_DESCR COM_AXIS taskEnergyManager.locals.egyMgrPidTimeHrzn NO_COMPU_METHOD 8 0 0 AXIS_PTS_REF CSustSocErrXsp /end AXIS_DESCR
 /begin AXIS_DESCR COM_AXIS NO_INPUT_QUANTITY NO_COMPU_METHOD 6 0 0 AXIS_PTS_REF CPwrReqYsp /end AXIS_DESCR
/end CHARACTERISTIC
/begin CHARACTERISTIC CSustEgyMgrKiTab "Integral gain charge-sustaining pid map" MAP 1073882844 __Float32_Value 0 NO_COMPU_METHOD 0 1000 STEP_SIZE 0.001 FORMAT "%.6"
 /begin AXIS_DESCR COM_AXIS taskEnergyManager.locals.egyMgrPidTimeHrzn NO_COMPU_METHOD 8 0 0 AXIS_PTS_REF CSustSocErrXsp /end AXIS_DESCR
 /begin AXIS_DESCR COM_AXIS NO_INPUT_QUANTITY NO_COMPU_METHOD 6 0 0 AXIS_PTS_REF CPwrReqYsp /end AXIS_DESCR
/end CHARACTERISTIC
/begin CHARACTERISTIC CSustEgyMgrKdTab "Derivative gain charge-sustaining pid map" MAP 1073882652 __Float32_Value 0 NO_COMPU_METHOD 0 1000 STEP_SIZE 0.001 FORMAT "%.6"
 /begin AXIS_DESCR COM_AXIS taskEnergyManager.locals.egyMgrPidTimeHrzn NO_COMPU_METHOD 8 0 0 AXIS_PTS_REF CSustSocErrXsp /end AXIS_DESCR
 /begin AXIS_DESCR COM_AXIS NO_INPUT_QUANTITY NO_COMPU_METHOD 6 0 0 AXIS_PTS_REF CPwrReqYsp /end AXIS_DESCR
/end CHARACTERISTIC
/begin CHARACTERISTIC CDeplEgyMgrPidKdTab "Derivative gain charge-depleting pid map" MAP 1073882460 __Float32_Value 0 NO_COMPU_METHOD 0 1000 STEP_SIZE 0.001 FORMAT "%.6"
 /begin AXIS_DESCR COM_AXIS NO_INPUT_QUANTITY NO_COMPU_METHOD 8 0 0 AXIS_PTS_REF CDeplSocErrXsp /end AXIS_DESCR
 /begin AXIS_DESCR COM_AXIS NO_INPUT_QUANTITY NO_COMPU_METHOD 6 0 0 AXIS_PTS_REF CPwrReqYsp /end AXIS_DESCR
/end CHARACTERISTIC
/begin CHARACTERISTIC CDeplEgyMgrPidKpTab "Proportional gain charge-depleting pid map" MAP 1073882268 __Float32_Value 0 NO_COMPU_METHOD 0 1000 STEP_SIZE 0.001 FORMAT "%.6"
 /begin AXIS_DESCR COM_AXIS NO_INPUT_QUANTITY NO_COMPU_METHOD 8 0 0 AXIS_PTS_REF CDeplSocErrXsp /end AXIS_DESCR
 /begin AXIS_DESCR COM_AXIS NO_INPUT_QUANTITY NO_COMPU_METHOD 6 0 0 AXIS_PTS_REF CPwrReqYsp /end AXIS_DESCR
/end CHARACTERISTIC
/begin CHARACTERISTIC CDeplEgyMgrPidKiTab "Integral gain charge-depleting pid map" MAP 1073882076 __Float32_Value 0 NO_COMPU_METHOD 0 1000 STEP_SIZE 0.001 FORMAT "%.6"
 /begin AXIS_DESCR COM_AXIS NO_INPUT_QUANTITY NO_COMPU_METHOD 8 0 0 AXIS_PTS_REF CDeplSocErrXsp /end AXIS_DESCR
 /begin AXIS_DESCR COM_AXIS NO_INPUT_QUANTITY NO_COMPU_METHOD 6 0 0 AXIS_PTS_REF CPwrReqYsp /end AXIS_DESCR
/end CHARACTERISTIC
/begin CHARACTERISTIC CSustEgyMgrPidTimeHrznTab "Delta soc vs time horizon for charge-sustaining mode" CURVE 1073882000 __Float32_Value 0 tSecond -3600 3600 STEP_SIZE 10
 /begin AXIS_DESCR COM_AXIS taskEnergyManager.locals.egyMgrPidTimeHrzn NO_COMPU_METHOD 6 0 0 AXIS_PTS_REF CSustSocErrXsp /end AXIS_DESCR
/end CHARACTERISTIC
/begin CHARACTERISTIC CDepltEgyMgrPidimeHrznTab "Delta soc vs time horizon for charge-depleting mode" CURVE 1073881976 __Float32_Value 0 tSecond -3600 3600 STEP_SIZE 10
 /begin AXIS_DESCR COM_AXIS NO_INPUT_QUANTITY NO_COMPU_METHOD 6 0 0 AXIS_PTS_REF CDeplSocErrXsp /end AXIS_DESCR
/end CHARACTERISTIC
/begin CHARACTERISTIC CCoastPwrReqThr "Power request threshold to detect coast phase" VALUE 1073881968 __Float32_Value 0 tKilowatt 0 1000 STEP_SIZE 1 /end CHARACTERISTIC
/begin CHARACTERISTIC CCoastSpdThr "Speed threshold to detect coast phase" VALUE 1073881964 __Float32_Value 0 tMetrePerSecond 0 500 STEP_SIZE 1 /end CHARACTERISTIC
/begin CHARACTERISTIC CCoastAccThr "Acceleration threshold to detect coast phase" VALUE 1073881960 __Float32_Value 0 tMetrePerSquareSecond 0 100 STEP_SIZE 1 /end CHARACTERISTIC
/begin CHARACTERISTIC CDeplEgyMgrPidGainBlend "Sustain pid gains filter coefficient" VALUE 1073881920 __Float32_Value 0 NO_COMPU_METHOD 0 100 STEP_SIZE 0.1 FORMAT "%.6" /end CHARACTERISTIC
/begin CHARACTERISTIC CBmsTqLimMax "Battery torque limit" VALUE 1073881820 __Float32_Value 0 NO_COMPU_METHOD 0 10000 STEP_SIZE 1 FORMAT "%.6" /end CHARACTERISTIC
/begin AXIS_PTS CVehVelActvSysXsp "Vehicle velocity setpoint for active system controls [km/h]" 1073881786 NO_INPUT_QUANTITY __SWord_Axis 0 tKilometrePerHour_S16 12 -600 600 STEP_SIZE 1 /end AXIS_PTS
/begin CHARACTERISTIC CRideHeiReqLowPosnFrntTab "Gemera Base - Ride height position request front in Low height [mm] 95 mm stationary as per spec sheet: https://koenigseggautomotive-my.sharepoint.com/:x:/g/personal/shak_huq_koenigsegg_com/IQDmPpvKDe6PSqn5lc2MlCjCASeSbffpMBOgeXdOBn5Aack?e=gi3Ihv&CID=a2e6f937-99c3-66a9-fe78-932704e53183" CURVE 1073881762 __SWord_Value 0 tMillimetre_10_S16 -1000.0 1000.0 STEP_SIZE 1
 /begin AXIS_DESCR COM_AXIS NO_INPUT_QUANTITY tKilometrePerHour_S16 12 0 0 AXIS_PTS_REF CVehVelActvSysXsp /end AXIS_DESCR
/end CHARACTERISTIC
/begin CHARACTERISTIC CRideHeiReqLowPosnReTab "Gemera Base - Ride height position request rear in Low height [mm] 100 mm stationary as per spec sheet: https://koenigseggautomotive-my.sharepoint.com/:x:/g/personal/shak_huq_koenigsegg_com/IQDmPpvKDe6PSqn5lc2MlCjCASeSbffpMBOgeXdOBn5Aack?e=gi3Ihv&CID=a2e6f937-99c3-66a9-fe78-932704e53183" CURVE 1073881738 __SWord_Value 0 tMillimetre_10_S16 -1000.0 1000.0 STEP_SIZE 1
 /begin AXIS_DESCR COM_AXIS NO_INPUT_QUANTITY tKilometrePerHour_S16 12 0 0 AXIS_PTS_REF CVehVelActvSysXsp /end AXIS_DESCR
/end CHARACTERISTIC
/begin CHARACTERISTIC CRideHeiReqMedPosnFrntTab "Gemera Base - Ride height position request front in Medium height [mm] 102 mm stationary as per spec sheet: https://koenigseggautomotive-my.sharepoint.com/:x:/g/personal/shak_huq_koenigsegg_com/IQDmPpvKDe6PSqn5lc2MlCjCASeSbffpMBOgeXdOBn5Aack?e=gi3Ihv&CID=a2e6f937-99c3-66a9-fe78-932704e53183" CURVE 1073881714 __SWord_Value 0 tMillimetre_10_S16 -1000.0 1000.0 STEP_SIZE 1
 /begin AXIS_DESCR COM_AXIS NO_INPUT_QUANTITY tKilometrePerHour_S16 12 0 0 AXIS_PTS_REF CVehVelActvSysXsp /end AXIS_DESCR
/end CHARACTERISTIC
/begin CHARACTERISTIC CRideHeiReqMedPosnReTab "Gemera Base - Ride height position request rear in Medium height [mm] 107 mm stationary as per spec sheet: https://koenigseggautomotive-my.sharepoint.com/:x:/g/personal/shak_huq_koenigsegg_com/IQDmPpvKDe6PSqn5lc2MlCjCASeSbffpMBOgeXdOBn5Aack?e=gi3Ihv&CID=a2e6f937-99c3-66a9-fe78-932704e53183" CURVE 1073881690 __SWord_Value 0 tMillimetre_10_S16 -1000.0 1000.0 STEP_SIZE 1
 /begin AXIS_DESCR COM_AXIS NO_INPUT_QUANTITY tKilometrePerHour_S16 12 0 0 AXIS_PTS_REF CVehVelActvSysXsp /end AXIS_DESCR
/end CHARACTERISTIC
/begin CHARACTERISTIC CRideHeiReqHighPosnFrntTab "Gemera Base - Ride height position request front in High height [mm] 110 mm stationary as per spec sheet: https://koenigseggautomotive-my.sharepoint.com/:x:/g/personal/shak_huq_koenigsegg_com/IQDmPpvKDe6PSqn5lc2MlCjCASeSbffpMBOgeXdOBn5Aack?e=gi3Ihv&CID=a2e6f937-99c3-66a9-fe78-932704e53183 Homologation costraint: to comply with homologation documents regarding vehicle's height from the ground in the default Ghost EV and Comfort modes, at zero speed ride height must be 110mm" CURVE 1073881666 __SWord_Value 0 tMillimetre_10_S16 -1000.0 1000.0 STEP_SIZE 1
 /begin AXIS_DESCR COM_AXIS NO_INPUT_QUANTITY tKilometrePerHour_S16 12 0 0 AXIS_PTS_REF CVehVelActvSysXsp /end AXIS_DESCR
/end CHARACTERISTIC
/begin CHARACTERISTIC CRideHeiReqHighPosnReTab "Gemera Base - Ride height position request rear in High height [mm] 115 mm stationary as per spec sheet: https://koenigseggautomotive-my.sharepoint.com/:x:/g/personal/shak_huq_koenigsegg_com/IQDmPpvKDe6PSqn5lc2MlCjCASeSbffpMBOgeXdOBn5Aack?e=gi3Ihv&CID=a2e6f937-99c3-66a9-fe78-932704e53183 Homologation costraint: to comply with homologation documents regarding vehicle's height from the ground in the default Ghost EV and Comfort modes, at zero speed ride height must be 110mm" CURVE 1073881642 __SWord_Value 0 tMillimetre_10_S16 -1000.0 1000.0 STEP_SIZE 1
 /begin AXIS_DESCR COM_AXIS NO_INPUT_QUANTITY tKilometrePerHour_S16 12 0 0 AXIS_PTS_REF CVehVelActvSysXsp /end AXIS_DESCR
/end CHARACTERISTIC
/begin AXIS_PTS CRideHeiRollCompXsp "Roll compensation lateral acceleration setpoint [m/s²]" 1073881624 shared.dynamicsVso.imuLatAccelFilt __SWord_Axis 0 tMetrePerSquareSecond_10_S16 5 0 200 STEP_SIZE 10 /end AXIS_PTS
/begin CHARACTERISTIC CRideHeiRollCompFrntOuterTab "Roll compensation ride height front outer setpoint [mm]" CURVE 1073881614 __SWord_Value 0 tMillimetre_10_S16 0 300 STEP_SIZE 10
 /begin AXIS_DESCR COM_AXIS shared.dynamicsVso.imuLatAccelFilt tMetrePerSquareSecond_10_S16 5 0 0 AXIS_PTS_REF CRideHeiRollCompXsp /end AXIS_DESCR
/end CHARACTERISTIC
/begin CHARACTERISTIC CRideHeiRollCompFrntInnerTab "Roll compensation ride height front inner setpoint [mm]" CURVE 1073881604 __SWord_Value 0 tMillimetre_10_S16 0 300 STEP_SIZE 10
 /begin AXIS_DESCR COM_AXIS shared.dynamicsVso.imuLatAccelFilt tMetrePerSquareSecond_10_S16 5 0 0 AXIS_PTS_REF CRideHeiRollCompXsp /end AXIS_DESCR
/end CHARACTERISTIC
/begin CHARACTERISTIC CRideHeiRollCompReOuterTab "Roll compensation ride height rear outer setpoint [mm]" CURVE 1073881594 __SWord_Value 0 tMillimetre_10_S16 0 300 STEP_SIZE 10
 /begin AXIS_DESCR COM_AXIS shared.dynamicsVso.imuLatAccelFilt tMetrePerSquareSecond_10_S16 5 0 0 AXIS_PTS_REF CRideHeiRollCompXsp /end AXIS_DESCR
/end CHARACTERISTIC
/begin CHARACTERISTIC CRideHeiRollCompReInnerTab "Roll compensation ride height rear inner setpoint [mm]" CURVE 1073881584 __SWord_Value 0 tMillimetre_10_S16 0 300 STEP_SIZE 10
 /begin AXIS_DESCR COM_AXIS shared.dynamicsVso.imuLatAccelFilt tMetrePerSquareSecond_10_S16 5 0 0 AXIS_PTS_REF CRideHeiRollCompXsp /end AXIS_DESCR
/end CHARACTERISTIC
/begin CHARACTERISTIC CLiftCylRng "Lifting cylinder controllable travel [mm]" CURVE 1073881578 __SWord_Value 0 tMillimetre_10_S16 -1000.0 1000.0 STEP_SIZE 1
 /begin AXIS_DESCR FIX_AXIS NO_INPUT_QUANTITY NO_COMPU_METHOD 2 0 1 FIX_AXIS_PAR_DIST 0 1 2 /end AXIS_DESCR
/end CHARACTERISTIC
/begin CHARACTERISTIC CWhlTrvlRngFrnt "Front axle wheel travel range [full droop, lift up, lift down, full bump] [mm]" CURVE 1073881558 __SWord_Value 0 tMillimetre_10_S16 -1000.0 1000.0 STEP_SIZE 1
 /begin AXIS_DESCR FIX_AXIS NO_INPUT_QUANTITY NO_COMPU_METHOD 4 0 3 FIX_AXIS_PAR_DIST 0 1 4 /end AXIS_DESCR
/end CHARACTERISTIC
/begin CHARACTERISTIC CWhlTrvlRngRe "Rear axle wheel travel [full droop, lift up, lift down, full bump] [mm]" CURVE 1073881550 __SWord_Value 0 tMillimetre_10_S16 -1000.0 1000.0 STEP_SIZE 1
 /begin AXIS_DESCR FIX_AXIS NO_INPUT_QUANTITY NO_COMPU_METHOD 4 0 3 FIX_AXIS_PAR_DIST 0 1 4 /end AXIS_DESCR
/end CHARACTERISTIC
/begin CHARACTERISTIC CDamprTrvlFullBumpFrnt "Full bump travel of the front damper [mm]" VALUE 1073881548 __SWord_Value 0 tMillimetre_10_S16 -1000.0 1000.0 STEP_SIZE 1 /end CHARACTERISTIC
/begin CHARACTERISTIC CDamprTrvlFullBumpRe "Full bump travel of the rear damper [mm]" VALUE 1073881546 __SWord_Value 0 tMillimetre_10_S16 -1000.0 1000.0 STEP_SIZE 1 /end CHARACTERISTIC
/begin CHARACTERISTIC CDamprTrvlLiftDwnFrnt "Front Damper travel when lift is fully down [mm]" VALUE 1073881544 __SWord_Value 0 tMillimetre_10_S16 -1000.0 1000.0 STEP_SIZE 1 /end CHARACTERISTIC
/begin CHARACTERISTIC CDamprTrvlLiftDwnRe "Rear Damper travel when lift is fully down [mm]" VALUE 1073881542 __SWord_Value 0 tMillimetre_10_S16 -1000.0 1000.0 STEP_SIZE 1 /end CHARACTERISTIC
/begin CHARACTERISTIC CSuspMtnRatFrntTab "Front motion ratio (force multiplier from wheel vertical to damper)" CURVE 1073881512 __SWord_Value 0 tFactor_1000_S16 -32.768 32.767 STEP_SIZE 1
 /begin AXIS_DESCR COM_AXIS NO_INPUT_QUANTITY tMillimetre_10_S16 13 0 0 AXIS_PTS_REF CSuspMtnRatFrntTabXsp /end AXIS_DESCR
/end CHARACTERISTIC
/begin AXIS_PTS CSuspMtnRatFrntTabXsp "Front suspension X-axis for motion ratio (wheel travel) [mm]" 1073881486 NO_INPUT_QUANTITY __SWord_Axis 0 tMillimetre_10_S16 13 -1000.0 1000.0 STEP_SIZE 1 /end AXIS_PTS
/begin CHARACTERISTIC CSuspMtnRatReTab "Rear motion ratio (force multiplier from wheel vertical to damper)" CURVE 1073881460 __SWord_Value 0 tFactor_1000_S16 -32.768 32.767 STEP_SIZE 1
 /begin AXIS_DESCR COM_AXIS NO_INPUT_QUANTITY tMillimetre_10_S16 13 0 0 AXIS_PTS_REF CSuspMtnRatReTabXsp /end AXIS_DESCR
/end CHARACTERISTIC
/begin AXIS_PTS CSuspMtnRatReTabXsp "Rear suspension X-axis for motion ratio (wheel travel) [mm]" 1073881434 NO_INPUT_QUANTITY __SWord_Axis 0 tMillimetre_10_S16 13 -1000.0 1000.0 STEP_SIZE 1 /end AXIS_PTS
/begin CHARACTERISTIC CCycleRideMoveDuration "" VALUE 1073881416 __ULong_Value 0 tMillisecond_U32 0 3600000 STEP_SIZE 1 /end CHARACTERISTIC
/begin CHARACTERISTIC CSpdLimPerfModArr "Performance Mode dependent Speed Limit" CURVE 1073881316 __SWord_Value 0 tKilometrePerHour_10_S16 0 420.0 STEP_SIZE 10
 /begin AXIS_DESCR FIX_AXIS NO_INPUT_QUANTITY NO_COMPU_METHOD 6 0 5 FIX_AXIS_PAR_DIST 0 1 6 /end AXIS_DESCR
/end CHARACTERISTIC
/begin AXIS_PTS CSpdLimDeltaActvnVelXsp "Vehicle Speed absolute setpoint to enable/disable Speed Limiter actuation [km/h]" 1073881306 NO_INPUT_QUANTITY __SWord_Axis 0 tKilometrePerHour_10_S16 5 0 600.0 STEP_SIZE 10 /end AXIS_PTS
/begin CHARACTERISTIC CSpdLimDeltaActvnVelTab "Speed delta to enable Speed Limiter actuation [km/h]" CURVE 1073881296 __SWord_Value 0 tKilometrePerHour_10_S16 0 50.0 STEP_SIZE 1
 /begin AXIS_DESCR COM_AXIS NO_INPUT_QUANTITY tKilometrePerHour_10_S16 5 0 0 AXIS_PTS_REF CSpdLimDeltaActvnVelXsp /end AXIS_DESCR
/end CHARACTERISTIC
/begin CHARACTERISTIC CSpdLimDeltaDeactvnVelTab "Speed delta to disable Speed Limiter actuation [km/h]" CURVE 1073881286 __SWord_Value 0 tKilometrePerHour_10_S16 0 50.0 STEP_SIZE 1
 /begin AXIS_DESCR COM_AXIS NO_INPUT_QUANTITY tKilometrePerHour_10_S16 5 0 0 AXIS_PTS_REF CSpdLimDeltaActvnVelXsp /end AXIS_DESCR
/end CHARACTERISTIC
/begin AXIS_PTS CWhlTqTotLimLowrLatAccXsp "Regen limit dependent on lateral acceleration axis [m/s^2]" 1073881156 shared.dynamicsVso.imuLatAccelFilt __Float32_Axis 0 tMetrePerSquareSecond 5 0.0 30.0 STEP_SIZE 1 /end AXIS_PTS
/begin CHARACTERISTIC CWhlTqTotLimLowLatAccTab "Regen limit dependent on lateral acceleration table [Nm] Type: Curve" CURVE 1073881136 __Float32_Value 0 tNewtonMetre 0.0 10000.0 STEP_SIZE 100
 /begin AXIS_DESCR COM_AXIS shared.dynamicsVso.imuLatAccelFilt tMetrePerSquareSecond 5 0 0 AXIS_PTS_REF CWhlTqTotLimLowrLatAccXsp /end AXIS_DESCR
/end CHARACTERISTIC
/begin CHARACTERISTIC CHndlgAttdModSelnOrder "Handling attitude selection order array" CURVE 1073881044 __SLong_Value 0 NO_COMPU_METHOD -2147483648 2147483647 STEP_SIZE 1 FORMAT "%.0"
 /begin AXIS_DESCR FIX_AXIS NO_INPUT_QUANTITY NO_COMPU_METHOD 7 0 6 FIX_AXIS_PAR_DIST 0 1 7 /end AXIS_DESCR
/end CHARACTERISTIC
/begin CHARACTERISTIC CTracCtrlPropn "Proportion between Safe and agressive traction control calibration (0 = fully safe, 1 = fully aggressive)" CURVE 1073880996 __Float32_Value 0 tFactor -3.40282346639E+38 3.40282346639E+38 STEP_SIZE 1
 /begin AXIS_DESCR FIX_AXIS NO_INPUT_QUANTITY NO_COMPU_METHOD 6 0 5 FIX_AXIS_PAR_DIST 0 1 6 /end AXIS_DESCR
/end CHARACTERISTIC
/begin CHARACTERISTIC CTireMaxLgtSlipOffsFrntSafeMap "Tire longitudinal slip limit offset for front axle safe [-]" MAP 1073880876 __Float32_Value 0 tFactor -0.5 0.5 STEP_SIZE 0.01
 /begin AXIS_DESCR COM_AXIS NO_INPUT_QUANTITY tMetrePerSquareSecond 5 0 0 AXIS_PTS_REF CTracCtrlXsp /end AXIS_DESCR
 /begin AXIS_DESCR COM_AXIS NO_INPUT_QUANTITY tKilometrePerHour 6 0 0 AXIS_PTS_REF CTracCtrlYsp /end AXIS_DESCR
/end CHARACTERISTIC
/begin CHARACTERISTIC CTireMaxLgtSlipOffsFrntAggsvMap "Tire longitudinal slip limit offset for front axle aggressive [-]" MAP 1073880756 __Float32_Value 0 tFactor -0.5 0.5 STEP_SIZE 0.01
 /begin AXIS_DESCR COM_AXIS NO_INPUT_QUANTITY tMetrePerSquareSecond 5 0 0 AXIS_PTS_REF CTracCtrlXsp /end AXIS_DESCR
 /begin AXIS_DESCR COM_AXIS NO_INPUT_QUANTITY tKilometrePerHour 6 0 0 AXIS_PTS_REF CTracCtrlYsp /end AXIS_DESCR
/end CHARACTERISTIC
/begin CHARACTERISTIC CTireMaxLgtSlipOffsReSafeMap "Tire longitudinal slip limit offset for rear axle safe [-]" MAP 1073880636 __Float32_Value 0 tFactor -0.5 0.5 STEP_SIZE 0.01
 /begin AXIS_DESCR COM_AXIS NO_INPUT_QUANTITY tMetrePerSquareSecond 5 0 0 AXIS_PTS_REF CTracCtrlXsp /end AXIS_DESCR
 /begin AXIS_DESCR COM_AXIS NO_INPUT_QUANTITY tKilometrePerHour 6 0 0 AXIS_PTS_REF CTracCtrlYsp /end AXIS_DESCR
/end CHARACTERISTIC
/begin CHARACTERISTIC CTireMaxLgtSlipOffsReAggsvMap "Tire longitudinal slip limit offset for rear axle aggressive [-]" MAP 1073880516 __Float32_Value 0 tFactor -0.5 0.5 STEP_SIZE 0.01
 /begin AXIS_DESCR COM_AXIS NO_INPUT_QUANTITY tMetrePerSquareSecond 5 0 0 AXIS_PTS_REF CTracCtrlXsp /end AXIS_DESCR
 /begin AXIS_DESCR COM_AXIS NO_INPUT_QUANTITY tKilometrePerHour 6 0 0 AXIS_PTS_REF CTracCtrlYsp /end AXIS_DESCR
/end CHARACTERISTIC
/begin AXIS_PTS CTracCtrlXsp "Lateral acceleration setpoint for traction control interpolations [m/s^2]" 1073880496 NO_INPUT_QUANTITY __Float32_Axis 0 tMetrePerSquareSecond 5 0 20 STEP_SIZE 1 /end AXIS_PTS
/begin AXIS_PTS CTracCtrlDiffXsp "Tire slip difference setpoint for traction control interpolations [-]" 1073880476 NO_INPUT_QUANTITY __Float32_Axis 0 tFactor 5 0 5 STEP_SIZE 0.05 /end AXIS_PTS
/begin AXIS_PTS CTracCtrlYsp "Vehicle velocity setpoint for traction control interpolations [km/h]" 1073880452 NO_INPUT_QUANTITY __Float32_Axis 0 tKilometrePerHour 6 0 500 STEP_SIZE 10 /end AXIS_PTS
/begin CHARACTERISTIC CTracCtrlWhlTqLimSlipDiffFrntSafeMap "Wheel torque limit for the high tire slip wheel of front axle safe [Nm]" MAP 1073880316 __Float32_Value 0 tNewtonMetre 0 10000 STEP_SIZE 100
 /begin AXIS_DESCR COM_AXIS NO_INPUT_QUANTITY tFactor 5 0 0 AXIS_PTS_REF CTracCtrlDiffXsp /end AXIS_DESCR
 /begin AXIS_DESCR COM_AXIS NO_INPUT_QUANTITY tKilometrePerHour 6 0 0 AXIS_PTS_REF CTracCtrlYsp /end AXIS_DESCR
/end CHARACTERISTIC
/begin CHARACTERISTIC CTracCtrlWhlTqLimSlipDiffFrntAggsvMap "Wheel torque limit for the high tire slip wheel of front axle aggressive [Nm]" MAP 1073880196 __Float32_Value 0 tNewtonMetre 0 10000 STEP_SIZE 100
 /begin AXIS_DESCR COM_AXIS NO_INPUT_QUANTITY tFactor 5 0 0 AXIS_PTS_REF CTracCtrlDiffXsp /end AXIS_DESCR
 /begin AXIS_DESCR COM_AXIS NO_INPUT_QUANTITY tKilometrePerHour 6 0 0 AXIS_PTS_REF CTracCtrlYsp /end AXIS_DESCR
/end CHARACTERISTIC
/begin CHARACTERISTIC CTracCtrlWhlTqLimSlipDiffReSafeMap "Wheel torque limit for the high tire slip wheel of rear axle safe [Nm]" MAP 1073880076 __Float32_Value 0 tNewtonMetre 0 10000 STEP_SIZE 100
 /begin AXIS_DESCR COM_AXIS NO_INPUT_QUANTITY tFactor 5 0 0 AXIS_PTS_REF CTracCtrlDiffXsp /end AXIS_DESCR
 /begin AXIS_DESCR COM_AXIS NO_INPUT_QUANTITY tKilometrePerHour 6 0 0 AXIS_PTS_REF CTracCtrlYsp /end AXIS_DESCR
/end CHARACTERISTIC
/begin CHARACTERISTIC CTracCtrlWhlTqLimSlipDiffReAggsvMap "Wheel torque limit for the high tire slip wheel of rear axle aggressive [Nm]" MAP 1073879956 __Float32_Value 0 tNewtonMetre 0 10000 STEP_SIZE 100
 /begin AXIS_DESCR COM_AXIS NO_INPUT_QUANTITY tFactor 5 0 0 AXIS_PTS_REF CTracCtrlDiffXsp /end AXIS_DESCR
 /begin AXIS_DESCR COM_AXIS NO_INPUT_QUANTITY tKilometrePerHour 6 0 0 AXIS_PTS_REF CTracCtrlYsp /end AXIS_DESCR
/end CHARACTERISTIC
/begin CHARACTERISTIC CYtrYawTqFfwReqMap "Feed-forward yaw torque request table based on steer angle and vehicle speed [Nm]" MAP 1073879448 __Float32_Value 0 tNewtonMetre -20000 20000 STEP_SIZE 10
 /begin AXIS_DESCR COM_AXIS shared.dynamicsVso.vehVelLgt tMetrePerSecond 11 0 0 AXIS_PTS_REF CYtrYawTqFfwReqXsp /end AXIS_DESCR
 /begin AXIS_DESCR COM_AXIS shared.steering.steerAg tDegree 11 0 0 AXIS_PTS_REF CYtrYawTqFfwReqYsp /end AXIS_DESCR
/end CHARACTERISTIC
/begin AXIS_PTS CYtrYawTqFfwReqXsp "Feed-forward yaw torque request x-axis, vehicle speed [m/s]" 1073879404 shared.dynamicsVso.vehVelLgt __Float32_Axis 0 tMetrePerSecond 11 0 120 STEP_SIZE 10 /end AXIS_PTS
/begin AXIS_PTS CYtrYawTqFfwReqYsp "Feed-forward yaw torque request y-axis, steer angle [deg]" 1073879360 shared.steering.steerAg __Float32_Axis 0 tDegree 11 0 450.0 STEP_SIZE 10 /end AXIS_PTS
/begin AXIS_PTS CYawRefGenNormLoadDeratingFacFrntXsp "Normal load derating factor front setpoint" 1073879240 NO_INPUT_QUANTITY __Float32_Axis 0 tFactor 30 0 5 STEP_SIZE 0.1 /end AXIS_PTS
/begin CHARACTERISTIC CYawRefGenNormLoadDeratingFacFrntYsp "Normal load derating factor front" CURVE 1073879120 __Float32_Value 0 tFactor 0 5 STEP_SIZE 0.1
 /begin AXIS_DESCR COM_AXIS NO_INPUT_QUANTITY tFactor 30 0 0 AXIS_PTS_REF CYawRefGenNormLoadDeratingFacFrntXsp /end AXIS_DESCR
/end CHARACTERISTIC
/begin AXIS_PTS CYawRefGenNormLoadDeratingFacReXsp "Normal load derating factor rear setpoint" 1073879000 NO_INPUT_QUANTITY __Float32_Axis 0 tFactor 30 0 5 STEP_SIZE 0.1 /end AXIS_PTS
/begin CHARACTERISTIC CYawRefGenNormLoadDeratingFacReYsp "Normal load derating factor rear" CURVE 1073878880 __Float32_Value 0 tFactor 0 5 STEP_SIZE 0.1
 /begin AXIS_DESCR COM_AXIS NO_INPUT_QUANTITY tFactor 30 0 0 AXIS_PTS_REF CYawRefGenNormLoadDeratingFacReXsp /end AXIS_DESCR
/end CHARACTERISTIC
/begin AXIS_PTS CStatyCrkTrsmOilTXsp "Stationary Crank Temperature Axis based on transmission oil temperature [C]" 1073878792 shared.engine.trsmOilT __SWord_Axis 0 tCelsius_10_S16 11 -50 200 STEP_SIZE 5 /end AXIS_PTS
/begin CHARACTERISTIC CStatyCrkPropshSpdOffsTab "Stationary cranking target offset at propshaft level [rpm] Type: Curve" CURVE 1073878770 __SWord_Value 0 tRevolutionPerMinute_S16 -32768 32767 STEP_SIZE 1
 /begin AXIS_DESCR COM_AXIS shared.engine.trsmOilT tCelsius_10_S16 11 0 0 AXIS_PTS_REF CStatyCrkTrsmOilTXsp /end AXIS_DESCR
/end CHARACTERISTIC
/begin CHARACTERISTIC CPropshCrkRunngSpdErrThresTab "Speed error threshold for propshaft sync during cranking running [rpm]" CURVE 1073878748 __SWord_Value 0 tRevolutionPerMinute_S16 -32768 32767 STEP_SIZE 1
 /begin AXIS_DESCR FIX_AXIS NO_INPUT_QUANTITY NO_COMPU_METHOD 11 0 10 FIX_AXIS_PAR_DIST 0 1 11 /end AXIS_DESCR
/end CHARACTERISTIC
/begin CHARACTERISTIC CPropshRateCtrlTqReqIceRunngDetnThdTab "Propshaft rate controller ICE running detection propshaft torque threshold Type: Curve" CURVE 1073878704 __Float32_Value 0 tNewtonMetre -100000 100000 STEP_SIZE 1
 /begin AXIS_DESCR COM_AXIS shared.engine.trsmOilT tCelsius_10_S16 11 0 0 AXIS_PTS_REF CStatyCrkTrsmOilTXsp /end AXIS_DESCR
/end CHARACTERISTIC
/begin CHARACTERISTIC CPropshCrkRunngStCntTab "Count for propshaft speed sync during cranking running, used in torque averaging Type: Curve" CURVE 1073878660 __ULong_Value 0 NO_COMPU_METHOD 0 4294967295 STEP_SIZE 1 FORMAT "%.0"
 /begin AXIS_DESCR COM_AXIS shared.engine.trsmOilT tCelsius_10_S16 11 0 0 AXIS_PTS_REF CStatyCrkTrsmOilTXsp /end AXIS_DESCR
/end CHARACTERISTIC
/begin AXIS_PTS CHybIceSpdXsp "Charge power in hybrid idle [Nm]" 1073878632 shared.hybrid.elecMotPwrDmd __SWord_Axis 0 tKilowatt_S16 6 -500 500 STEP_SIZE 1 /end AXIS_PTS
/begin CHARACTERISTIC CHybIdleIceSpdTab "Hybrid idle target idle map, ICE speed [rpm]" CURVE 1073878620 __SWord_Value 0 tRevolutionPerMinute_S16 500 6000 STEP_SIZE 1
 /begin AXIS_DESCR COM_AXIS shared.hybrid.elecMotPwrDmd tKilowatt_S16 6 0 0 AXIS_PTS_REF CHybIceSpdXsp /end AXIS_DESCR
/end CHARACTERISTIC
/begin CHARACTERISTIC CHybDriveIceSpdTab "Hybrid drive target idle map, ICE speed [rpm]" CURVE 1073878608 __SWord_Value 0 tRevolutionPerMinute_S16 500 6000 STEP_SIZE 1
 /begin AXIS_DESCR COM_AXIS shared.hybrid.elecMotPwrDmd tKilowatt_S16 6 0 0 AXIS_PTS_REF CHybIceSpdXsp /end AXIS_DESCR
/end CHARACTERISTIC
/begin CHARACTERISTIC CCenCluSyncErrThres "Central clutch slip error threshold [rpm]" VALUE 1073878584 __Float32_Value 0 tRevolutionPerMinute -10000 10000 STEP_SIZE 1 /end CHARACTERISTIC
/begin CHARACTERISTIC CCenCluSyncStTi "Central clutch motor sync time [ms]" VALUE 1073878572 __ULong_Value 0 tMillisecond_U32 0 3600000 STEP_SIZE 1 /end CHARACTERISTIC
/begin AXIS_PTS CSyncCluRateSlipXsp "Sync clutch rotational rate slip drivetrain torque request setpoint [C]" 1073878532 shared.hwio.vecTqCooltT __Float32_Axis 0 tCelsius 5 -100 500 STEP_SIZE 5 /end AXIS_PTS
/begin CHARACTERISTIC CSyncCluRateSlipTab "Sync clutch rotational rate slip table based on oil temperature [rad/s]" CURVE 1073878512 __Float32_Value 0 tRadianPerSecond 0 1000 STEP_SIZE 0.5
 /begin AXIS_DESCR COM_AXIS shared.hwio.vecTqCooltT tCelsius 5 0 0 AXIS_PTS_REF CSyncCluRateSlipXsp /end AXIS_DESCR
/end CHARACTERISTIC
/begin CHARACTERISTIC CCluMinSlipLimit "Minimum allowable clutch slip before lock-up" VALUE 1073878490 __SWord_Value 0 tRevolutionPerMinute_S16 0 500 STEP_SIZE 1 /end CHARACTERISTIC
/begin AXIS_PTS CTrsmOilTXsp "Transmission oil temperature X-setpoint for interpolation tables/maps [C]" 1073878404 shared.engine.trsmOilT __SLong_Axis 0 NO_COMPU_METHOD 11 -50 200 STEP_SIZE 5 FORMAT "%.0" /end AXIS_PTS
/begin AXIS_PTS CIceSpdTarYsp "Propshaft rate feedforward torque Y-setpoint [rpm] Engine speed target during sync state of stationary cranking process" 1073878384 taskTqStruct.tqStructLocals.cluTqHdlLocals.iceSpdTar __SLong_Axis 0 tRevolutionPerMinute_S32 5 0 8500 STEP_SIZE 5 /end AXIS_PTS
/begin CHARACTERISTIC CPropshTqForCrkIniBumpTab "Initial feedforward torque used to turn engine over [Nm]" CURVE 1073878340 __SLong_Value 0 tNewtonMetre_100_S32 0 1000.0 STEP_SIZE 10
 /begin AXIS_DESCR COM_AXIS shared.engine.trsmOilT NO_COMPU_METHOD 11 0 0 AXIS_PTS_REF CTrsmOilTXsp /end AXIS_DESCR
/end CHARACTERISTIC
/begin CHARACTERISTIC CPropshRateCtrlFfStatyCrkMap "Propshaft rate feedforward torque lookup table [Nm]" MAP 1073878120 __SLong_Value 0 tNewtonMetre_100_S32 0 1250.0 STEP_SIZE 5
 /begin AXIS_DESCR COM_AXIS shared.engine.trsmOilT NO_COMPU_METHOD 11 0 0 AXIS_PTS_REF CTrsmOilTXsp /end AXIS_DESCR
 /begin AXIS_DESCR COM_AXIS taskTqStruct.tqStructLocals.cluTqHdlLocals.propshRateTar tRevolutionPerMinute_S32 5 0 0 AXIS_PTS_REF CIceSpdTarYsp /end AXIS_DESCR
/end CHARACTERISTIC
/begin CHARACTERISTIC CPropshRateCtrlGainSetCenCluEg "Propshaft rate controller gains during central clutch is engaged Proportional (indices 0-10) [Nms/rad] Integral (indices 11-21) [Nm/rad] Derivative (indices 22-32) [Nms^2/rad]" MAP 1073877988 __Float32_Value 0 NO_COMPU_METHOD 0 10000000.0 STEP_SIZE 1 FORMAT "%.6"
 /begin AXIS_DESCR FIX_AXIS NO_INPUT_QUANTITY NO_COMPU_METHOD 11 0 10 FIX_AXIS_PAR_DIST 0 1 11 /end AXIS_DESCR
 /begin AXIS_DESCR FIX_AXIS NO_INPUT_QUANTITY NO_COMPU_METHOD 3 0 2 FIX_AXIS_PAR_DIST 0 1 3 /end AXIS_DESCR
/end CHARACTERISTIC
/begin CHARACTERISTIC CPropshRateCtrlGainSetCenCluDisegElecFwd "Propshaft rate controller gains during central clutch is disengaged and vehicle is driven by electric motor only through front wheels Proportional (indices 0-10) [Nms/rad] Integral (indices 11-21) [Nm/rad] Derivative (indices 22-32) [Nms^2/rad]" MAP 1073877856 __Float32_Value 0 NO_COMPU_METHOD 0 10000000.0 STEP_SIZE 1 FORMAT "%.6"
 /begin AXIS_DESCR FIX_AXIS NO_INPUT_QUANTITY NO_COMPU_METHOD 11 0 10 FIX_AXIS_PAR_DIST 0 1 11 /end AXIS_DESCR
 /begin AXIS_DESCR FIX_AXIS NO_INPUT_QUANTITY NO_COMPU_METHOD 3 0 2 FIX_AXIS_PAR_DIST 0 1 3 /end AXIS_DESCR
/end CHARACTERISTIC
/begin CHARACTERISTIC CPropshRateCtrlGainSetCenCluDisegIceRwd "Propshaft rate controller gains during central clutch is disengaged and vehicle is driven by combustion engine only through rear wheels Proportional (indices 0-10) [Nms/rad] Integral (indices 11-21) [Nm/rad] Derivative (indices 22-32) [Nms^2/rad]" MAP 1073877724 __Float32_Value 0 NO_COMPU_METHOD 0 10000000.0 STEP_SIZE 1 FORMAT "%.6"
 /begin AXIS_DESCR FIX_AXIS NO_INPUT_QUANTITY NO_COMPU_METHOD 11 0 10 FIX_AXIS_PAR_DIST 0 1 11 /end AXIS_DESCR
 /begin AXIS_DESCR FIX_AXIS NO_INPUT_QUANTITY NO_COMPU_METHOD 3 0 2 FIX_AXIS_PAR_DIST 0 1 3 /end AXIS_DESCR
/end CHARACTERISTIC
/begin AXIS_PTS CTpmsWarnLampTirePXsp "Speed range for minimum tire pressure for TPMS warning lamp decision" 1073877608 shared.dynamicsHomlnSfty.homldVehVel __SWord_Axis 0 tKilometrePerHour_10_S16 3 -600.0 600.0 STEP_SIZE 1 /end AXIS_PTS
/begin CHARACTERISTIC CTpmsWarnLampTirePFrntTab "Minimum Front tire pressure for setting a TPMS warning lamp" CURVE 1073877602 __SWord_Value 0 tBar_1000_S16 -0.1 100.0 STEP_SIZE 1
 /begin AXIS_DESCR COM_AXIS shared.dynamicsHomlnSfty.homldVehVel tKilometrePerHour_10_S16 3 0 0 AXIS_PTS_REF CTpmsWarnLampTirePXsp /end AXIS_DESCR
/end CHARACTERISTIC
/begin CHARACTERISTIC CTpmsWarnLampTirePReTab "Minimum Rear tire pressure for setting a TPMS warning lamp" CURVE 1073877596 __SWord_Value 0 tBar_1000_S16 -0.1 100.0 STEP_SIZE 1
 /begin AXIS_DESCR COM_AXIS shared.dynamicsHomlnSfty.homldVehVel tKilometrePerHour_10_S16 3 0 0 AXIS_PTS_REF CTpmsWarnLampTirePXsp /end AXIS_DESCR
/end CHARACTERISTIC
/begin CHARACTERISTIC CTpmsSpdLimMaxSpdFrntNormTab "Allowed Speed for current tire pressure for TPMS speed limit decision (TPMS_LIM_NORM)" CURVE 1073877580 __SWord_Value 0 tKilometrePerHour_10_S16 -600.0 600.0 STEP_SIZE 1
 /begin AXIS_DESCR COM_AXIS shared.tpms.tpmsTireP[0] tBar_1000_S16 8 0 0 AXIS_PTS_REF CTpmsSpdLimMinTirePFrntNormXsp /end AXIS_DESCR
/end CHARACTERISTIC
/begin CHARACTERISTIC CTpmsSpdLimMaxSpdReNormTab "Allowed Speed for current tire pressure for TPMS speed limit decision (TPMS_LIM_NORM)" CURVE 1073877564 __SWord_Value 0 tKilometrePerHour_10_S16 -600.0 600.0 STEP_SIZE 1
 /begin AXIS_DESCR COM_AXIS shared.tpms.tpmsTireP[2] tBar_1000_S16 8 0 0 AXIS_PTS_REF CTpmsSpdLimMinTirePReNormXsp /end AXIS_DESCR
/end CHARACTERISTIC
/begin AXIS_PTS CTpmsSpdLimMinTirePFrntNormXsp "Minimum front tire pressure for TPMS speed limit decision, Front axle (TPMS_LIM_NORM)" 1073877548 shared.tpms.tpmsTireP[0] __SWord_Axis 0 tBar_1000_S16 8 -0.1 100.0 STEP_SIZE 1 /end AXIS_PTS
/begin AXIS_PTS CTpmsSpdLimMinTirePReNormXsp "Minimum rear tire pressure for TPMS speed limit decision, Rear axle (TPMS_LIM_NORM)" 1073877532 shared.tpms.tpmsTireP[2] __SWord_Axis 0 tBar_1000_S16 8 -0.1 100.0 STEP_SIZE 1 /end AXIS_PTS
/begin CHARACTERISTIC CTpmsSpdLimMaxSpdFrntPerformanceTab "Allowed Speed for current tire pressure for TPMS speed limit decision, Front axle (TPMS_LIM_PERFORMANCE)" CURVE 1073877516 __SWord_Value 0 tKilometrePerHour_10_S16 -600.0 600.0 STEP_SIZE 1
 /begin AXIS_DESCR COM_AXIS shared.tpms.tpmsTireP[0] tBar_1000_S16 8 0 0 AXIS_PTS_REF CTpmsSpdLimMinTirePFrntNormXsp /end AXIS_DESCR
/end CHARACTERISTIC
/begin CHARACTERISTIC CTpmsSpdLimMaxSpdRePerformanceTab "Allowed Speed for current tire pressure for TPMS speed limit decision, Rear axle (TPMS_LIM_PERFORMANCE)" CURVE 1073877500 __SWord_Value 0 tKilometrePerHour_10_S16 -600.0 600.0 STEP_SIZE 1
 /begin AXIS_DESCR COM_AXIS shared.tpms.tpmsTireP[2] tBar_1000_S16 8 0 0 AXIS_PTS_REF CTpmsSpdLimMinTirePReNormXsp /end AXIS_DESCR
/end CHARACTERISTIC
/begin AXIS_PTS CTpmsSpdLimMinTirePFrntPerformanceXsp "Minimum front tire pressure for TPMS speed limit decision (TPMS_LIM_PERFORMANCE)" 1073877484 shared.tpms.tpmsTireP[0] __SWord_Axis 0 tBar_1000_S16 8 -0.1 100.0 STEP_SIZE 1 /end AXIS_PTS
/begin AXIS_PTS CTpmsSpdLimMinTirePRePerformanceXsp "Minimum rear tire pressure for TPMS speed limit decision (TPMS_LIM_PERFORMANCE)" 1073877468 shared.tpms.tpmsTireP[2] __SWord_Axis 0 tBar_1000_S16 8 -0.1 100.0 STEP_SIZE 1 /end AXIS_PTS
/begin CHARACTERISTIC CDefaultEngineFanSpeed "Engine related fan speed when CAN signal is not valid" VALUE 1073877466 __SByte_Value 0 tPercent_S8 0 100 STEP_SIZE 1 /end CHARACTERISTIC
/begin CHARACTERISTIC CDefaultEnginePumpSpeed "Engine related pump speed when CAN signal is not valid" VALUE 1073877465 __SByte_Value 0 tPercent_S8 0 100 STEP_SIZE 1 /end CHARACTERISTIC
/begin CHARACTERISTIC CDefaultLsttFanSpeed "LSTT related Fan speed when CAN signal is not valid" VALUE 1073877464 __SByte_Value 0 tPercent_S8 0 100 STEP_SIZE 1 /end CHARACTERISTIC
/begin CHARACTERISTIC CCwa150PumpMaxSpd "cwa150 pump max speed" VALUE 1073877456 __Float32_Value 0 tRevolutionPerMinute 0 10000 STEP_SIZE 1 /end CHARACTERISTIC
/begin CHARACTERISTIC CCwa100PumpMaxSpd "fic10 and fic11 fan  max speed" VALUE 1073877452 __Float32_Value 0 tRevolutionPerMinute 0 10000 STEP_SIZE 1 /end CHARACTERISTIC
/begin AXIS_PTS CFic10FanPowerXsp "Power estimation map for Fic10 fan [%]" 1073877416 NO_INPUT_QUANTITY __Float32_Axis 0 tPercent 8 0 100 STEP_SIZE 1 /end AXIS_PTS
/begin CHARACTERISTIC CFic10FanPowerYsp "Power estimation map for Fic10 fan [kW]" CURVE 1073877384 __Float32_Value 0 tKilowatt -10000 10000 STEP_SIZE 1
 /begin AXIS_DESCR COM_AXIS NO_INPUT_QUANTITY tPercent 8 0 0 AXIS_PTS_REF CFic10FanPowerXsp /end AXIS_DESCR
/end CHARACTERISTIC
/begin AXIS_PTS CFic11FanPowerXsp "Power estimation map for Fic11 fan [%]" 1073877352 NO_INPUT_QUANTITY __Float32_Axis 0 tPercent 8 0 100 STEP_SIZE 1 /end AXIS_PTS
/begin CHARACTERISTIC CFic11FanPowerYsp "Power estimation map for Fic11 fan [kW]" CURVE 1073877320 __Float32_Value 0 tKilowatt -10000 10000 STEP_SIZE 1
 /begin AXIS_DESCR COM_AXIS NO_INPUT_QUANTITY tPercent 8 0 0 AXIS_PTS_REF CFic11FanPowerXsp /end AXIS_DESCR
/end CHARACTERISTIC
/begin AXIS_PTS CEcp80PumpPowerXsp "Power estimation map for Ecp80 pump [%]" 1073877312 NO_INPUT_QUANTITY __Float32_Axis 0 tPercent 2 0 100 STEP_SIZE 1 /end AXIS_PTS
/begin CHARACTERISTIC CEcp80PumpPowerYsp "Power estimation map for Ecp80 pump [kW]" CURVE 1073877304 __Float32_Value 0 tKilowatt -10000 10000 STEP_SIZE 1
 /begin AXIS_DESCR COM_AXIS NO_INPUT_QUANTITY tPercent 2 0 0 AXIS_PTS_REF CEcp80PumpPowerXsp /end AXIS_DESCR
/end CHARACTERISTIC
/begin AXIS_PTS CCwa100PumpPowerXsp "Power estimation map for Cwa100 pump [%]" 1073877296 NO_INPUT_QUANTITY __Float32_Axis 0 tPercent 2 0 100 STEP_SIZE 1 /end AXIS_PTS
/begin CHARACTERISTIC CCwa100PumpPowerYsp "Power estimation map for Cwa100 pump [kW]" CURVE 1073877288 __Float32_Value 0 tKilowatt -10000 10000 STEP_SIZE 1
 /begin AXIS_DESCR COM_AXIS NO_INPUT_QUANTITY tPercent 2 0 0 AXIS_PTS_REF CCwa100PumpPowerXsp /end AXIS_DESCR
/end CHARACTERISTIC
/begin AXIS_PTS CCwa150PumpPowerXsp "Power estimation map for Cwa150 pump [%]" 1073877280 NO_INPUT_QUANTITY __Float32_Axis 0 tPercent 2 0 100 STEP_SIZE 1 /end AXIS_PTS
/begin CHARACTERISTIC CCwa150PumpPowerYsp "Power estimation map for Cwa150 pump [kW]" CURVE 1073877272 __Float32_Value 0 tKilowatt -10000 10000 STEP_SIZE 1
 /begin AXIS_DESCR COM_AXIS NO_INPUT_QUANTITY tPercent 2 0 0 AXIS_PTS_REF CCwa100PumpPowerXsp /end AXIS_DESCR
/end CHARACTERISTIC
/begin CHARACTERISTIC CEmotPumpSpdPerfMod "E-motor pump speed command function of performance mode [0]  PERF_MOD_UNKNOWN [1]  PERF_MOD_GHOST_EV [2]  PERF_MOD_COMFORT [3]  PERF_MOD_WET_SNOW [4]  PERF_MOD_SPORT [5]  PERF_MOD_TRACK [6]  PERF_MOD_INDIVIDUAL" CURVE 1073877264 __SByte_Value 0 tPercent_S8 0 100 STEP_SIZE 1
 /begin AXIS_DESCR FIX_AXIS NO_INPUT_QUANTITY tPerformanceMode 7 0 6 FIX_AXIS_PAR_DIST 0 1 7 /end AXIS_DESCR
/end CHARACTERISTIC
/begin CHARACTERISTIC CInvPumpSpdPerfMod "E-motor pump speed command function of performance mode [0]  PERF_MOD_UNKNOWN [1]  PERF_MOD_GHOST_EV [2]  PERF_MOD_COMFORT [3]  PERF_MOD_WET_SNOW [4]  PERF_MOD_SPORT [5]  PERF_MOD_TRACK [6]  PERF_MOD_INDIVIDUAL" CURVE 1073877256 __SByte_Value 0 tPercent_S8 0 100 STEP_SIZE 1
 /begin AXIS_DESCR FIX_AXIS NO_INPUT_QUANTITY tPerformanceMode 7 0 6 FIX_AXIS_PAR_DIST 0 1 7 /end AXIS_DESCR
/end CHARACTERISTIC
/begin CHARACTERISTIC CDcdcPeakPower "Value to convert dcdc available power from % to kW" VALUE 1073877252 __Float32_Value 0 tKilowatt 0 100 STEP_SIZE 1 /end CHARACTERISTIC
/begin CHARACTERISTIC CFanDiagEnbl "Fans list with diagnostic enabled [0]  FAN_POS_FRONT_RIGHT [1]  FAN_POS_CENTER_RIGHT [2]  FAN_POS_CENTER_LEFT [3]  FAN_POS_FRONT_LEFT [4]  FAN_POS_MIDDLE_RIGHT [5]  FAN_POS_MIDDLE_LEFT [6]  FAN_POS_REAR_RIGHT [7]  FAN_POS_REAR_LEFT" CURVE 1073877244 __UByte_Value 0 NO_COMPU_METHOD 0 1 STEP_SIZE 1 FORMAT "%.2"
 /begin AXIS_DESCR FIX_AXIS NO_INPUT_QUANTITY tCoolingFansPosition 8 0 7 FIX_AXIS_PAR_DIST 0 1 8 /end AXIS_DESCR
/end CHARACTERISTIC
/begin CHARACTERISTIC CPumpDiagEnbl "Pumps with diagnostic enabled [0]  PUMP_POS_INV [1]  PUMP_POS_EMOTOR [2]  PUMP_POS_HV_BAT [3]  PUMP_POS_HVAC_CIRCULATION [4]  PUMP_POS_INTERCOOLER_RIGHT [5]  PUMP_POS_INTERCOOLER_LEFT" CURVE 1073877236 __UByte_Value 0 NO_COMPU_METHOD 0 1 STEP_SIZE 1 FORMAT "%.2"
 /begin AXIS_DESCR FIX_AXIS NO_INPUT_QUANTITY tCoolingPumpsPosition 7 0 6 FIX_AXIS_PAR_DIST 0 1 7 /end AXIS_DESCR
/end CHARACTERISTIC
/begin CHARACTERISTIC CDeratingLevelMax "Thermal derating levels" VALUE 1073877180 __UByte_Value 0 NO_COMPU_METHOD 0 10 STEP_SIZE 1 FORMAT "%.0" /end CHARACTERISTIC
/begin CHARACTERISTIC CFanPriorities "Fans priority list [0]  FAN_POS_FRONT_RIGHT [1]  FAN_POS_CENTER_RIGHT [2]  FAN_POS_CENTER_LEFT [3]  FAN_POS_FRONT_LEFT [4]  FAN_POS_MIDDLE_RIGHT [5]  FAN_POS_MIDDLE_LEFT [6]  FAN_POS_REAR_RIGHT [7]  FAN_POS_REAR_LEFT" CURVE 1073877172 __UByte_Value 0 NO_COMPU_METHOD 0 255 STEP_SIZE 1 FORMAT "%.0"
 /begin AXIS_DESCR FIX_AXIS NO_INPUT_QUANTITY tCoolingFansPosition 8 0 7 FIX_AXIS_PAR_DIST 0 1 8 /end AXIS_DESCR
/end CHARACTERISTIC
/begin CHARACTERISTIC CPumpPriorities "Pumps priority list [0]  PUMP_POS_INV [1]  PUMP_POS_EMOTOR [2]  PUMP_POS_HV_BAT [3]  PUMP_POS_HVAC_CIRCULATION [4]  PUMP_POS_INTERCOOLER_RIGHT [5]  PUMP_POS_INTERCOOLER_LEFT" CURVE 1073877164 __UByte_Value 0 NO_COMPU_METHOD 0 255 STEP_SIZE 1 FORMAT "%.0"
 /begin AXIS_DESCR FIX_AXIS NO_INPUT_QUANTITY tCoolingPumpsPosition 7 0 6 FIX_AXIS_PAR_DIST 0 1 7 /end AXIS_DESCR
/end CHARACTERISTIC
/begin CHARACTERISTIC CFanMinCommand "Min command to send if derating active [0]  FAN_POS_FRONT_RIGHT [1]  FAN_POS_CENTER_RIGHT [2]  FAN_POS_CENTER_LEFT [3]  FAN_POS_FRONT_LEFT [4]  FAN_POS_MIDDLE_RIGHT [5]  FAN_POS_MIDDLE_LEFT [6]  FAN_POS_REAR_RIGHT [7]  FAN_POS_REAR_LEFT" CURVE 1073877156 __SByte_Value 0 tPercent_S8 0 100 STEP_SIZE 1
 /begin AXIS_DESCR FIX_AXIS NO_INPUT_QUANTITY tCoolingFansPosition 8 0 7 FIX_AXIS_PAR_DIST 0 1 8 /end AXIS_DESCR
/end CHARACTERISTIC
/begin CHARACTERISTIC CPumpMinCommand "Min command to send if derating active [0]  PUMP_POS_INV [1]  PUMP_POS_EMOTOR [2]  PUMP_POS_HV_BAT [3]  PUMP_POS_HVAC_CIRCULATION [4]  PUMP_POS_INTERCOOLER_RIGHT [5]  PUMP_POS_INTERCOOLER_LEFT" CURVE 1073877148 __SByte_Value 0 tPercent_S8 0 100 STEP_SIZE 1
 /begin AXIS_DESCR FIX_AXIS NO_INPUT_QUANTITY tCoolingPumpsPosition 7 0 6 FIX_AXIS_PAR_DIST 0 1 7 /end AXIS_DESCR
/end CHARACTERISTIC
/begin CHARACTERISTIC CDeratingLevel1CutStep "Power cut for derating leveles" VALUE 1073877147 __SByte_Value 0 tPercent_S8 0 100 STEP_SIZE 5 /end CHARACTERISTIC
/begin CHARACTERISTIC CDeratingLevel2CutStep "Power cut for derating leveles" VALUE 1073877146 __SByte_Value 0 tPercent_S8 0 100 STEP_SIZE 5 /end CHARACTERISTIC
/begin CHARACTERISTIC CDeratingLevel3CutStep "Power cut for derating leveles" VALUE 1073877145 __SByte_Value 0 tPercent_S8 0 100 STEP_SIZE 5 /end CHARACTERISTIC
/begin CHARACTERISTIC CDeratingLevel4CutStep "Power cut for derating leveles" VALUE 1073877144 __SByte_Value 0 tPercent_S8 0 100 STEP_SIZE 5 /end CHARACTERISTIC
/begin AXIS_PTS CFanCmdMaxVsVehSpeedXsp "Max allowed fan command based on vehicle speed, x-axis [kph]" 1073877120 taskThermal.libThermalManager.vehSpeed __Float32_Axis 0 tKilometrePerHour 6 0 500 STEP_SIZE 10 /end AXIS_PTS
/begin CHARACTERISTIC CFanCmdMaxVsVehSpeedYsp "Max allowed fan command based on vehicle speed map [%]" CURVE 1073877096 __Float32_Value 0 tPercent 0 100 STEP_SIZE 1
 /begin AXIS_DESCR COM_AXIS taskThermal.libThermalManager.vehSpeed tKilometrePerHour 6 0 0 AXIS_PTS_REF CFanCmdMaxVsVehSpeedXsp /end AXIS_DESCR
/end CHARACTERISTIC
/begin AXIS_PTS CTrsmGearXsp "Transmission gear X-setpoint for interpolation tables/maps" 1073877048 shared.engine.actGear __SLong_Axis 0 NO_COMPU_METHOD 11 0 10 STEP_SIZE 1 FORMAT "%.0" /end AXIS_PTS
/begin CHARACTERISTIC CRatGbx "LST gearbox gear ratios Safe values for UNKNOWN and NEUTRAL Unknown      1        2        3        4        5        6        7        8        9        N" CURVE 1073877004 __Float32_Value 0 NO_COMPU_METHOD -3.40282346639E+38 3.40282346639E+38 STEP_SIZE 1 FORMAT "%.6"
 /begin AXIS_DESCR FIX_AXIS NO_INPUT_QUANTITY NO_COMPU_METHOD 11 0 10 FIX_AXIS_PAR_DIST 0 1 11 /end AXIS_DESCR
/end CHARACTERISTIC
/begin AXIS_PTS CVsoWhlTqBrkHeatDissaptionXSP "Brake heat dissipation coefficient XSP [m/s]" 1073876968 NO_INPUT_QUANTITY __SWord_Axis 0 tMetrePerSecond_100_S16 6 -200.0 200.0 STEP_SIZE 1 /end AXIS_PTS
/begin CHARACTERISTIC CVsoWhlTqFrntBrkHeatDissaptionCoeff "Front brake heat dissipation coefficient [W/K]" CURVE 1073876956 __SWord_Value 0 NO_COMPU_METHOD -32768 32767 STEP_SIZE 1 FORMAT "%.0"
 /begin AXIS_DESCR COM_AXIS NO_INPUT_QUANTITY tMetrePerSecond_100_S16 6 0 0 AXIS_PTS_REF CVsoWhlTqBrkHeatDissaptionXSP /end AXIS_DESCR
/end CHARACTERISTIC
/begin CHARACTERISTIC CVsoWhlTqRearBrkHeatDissaptionCoeff "Rear brake heat dissipation coefficient [W/K]" CURVE 1073876940 __SWord_Value 0 NO_COMPU_METHOD -32768 32767 STEP_SIZE 1 FORMAT "%.0"
 /begin AXIS_DESCR COM_AXIS NO_INPUT_QUANTITY tMetrePerSecond_100_S16 6 0 0 AXIS_PTS_REF CVsoWhlTqBrkHeatDissaptionXSP /end AXIS_DESCR
/end CHARACTERISTIC
/begin CHARACTERISTIC CVsoWhlTqFrntBrkFrictionTab "Front brake pad/disc coefficient of friction vs temperature table" CURVE 1073876924 __SWord_Value 0 tFactor_1000_S16 -32.768 32.767 STEP_SIZE 1
 /begin AXIS_DESCR COM_AXIS NO_INPUT_QUANTITY tCelsius_100_S16 5 0 0 AXIS_PTS_REF CVsoWhlTqFrntBrkFrictionXSP /end AXIS_DESCR
/end CHARACTERISTIC
/begin AXIS_PTS CVsoWhlTqFrntBrkFrictionXSP "Front brake pad/disc coefficient of friction vs temperature table [C]" 1073876914 NO_INPUT_QUANTITY __SWord_Axis 0 tCelsius_100_S16 5 -4000.0 100000.0 STEP_SIZE 1 /end AXIS_PTS
/begin CHARACTERISTIC CVsoWhlTqReBrkFrictionTab "Rear brake pad/disc coefficient of friction vs temperature table" CURVE 1073876896 __SWord_Value 0 tFactor_1000_S16 -32.768 32.767 STEP_SIZE 1
 /begin AXIS_DESCR COM_AXIS NO_INPUT_QUANTITY tCelsius_100_S16 5 0 0 AXIS_PTS_REF CVsoWhlTqReBrkFrictionXSP /end AXIS_DESCR
/end CHARACTERISTIC
/begin AXIS_PTS CVsoWhlTqReBrkFrictionXSP "Rear brake pad/disc coefficient of friction vs temperature table [C]" 1073876886 NO_INPUT_QUANTITY __SWord_Axis 0 tCelsius_100_S16 5 -4000.0 100000.0 STEP_SIZE 1 /end AXIS_PTS
/begin CHARACTERISTIC CVsoCogPosn "CoG position in track mode" CURVE 1073876844 __Float32_Value 0 tMetre -1000 1000 STEP_SIZE 1
 /begin AXIS_DESCR FIX_AXIS NO_INPUT_QUANTITY NO_COMPU_METHOD 3 0 2 FIX_AXIS_PAR_DIST 0 1 3 /end AXIS_DESCR
/end CHARACTERISTIC
/begin CHARACTERISTIC CVsoImuSnsrQOverride "Qualifier override for body IMU sensors, use Q_NOT_INITIALIZED to use CAN values. [0] = Conti IMU, [1] = HPDM1 IMU, [2] = HPDM4 IMU" CURVE 1073876832 __ULong_Value 0 tQualifier 0 3 STEP_SIZE 1
 /begin AXIS_DESCR FIX_AXIS NO_INPUT_QUANTITY NO_COMPU_METHOD 3 0 2 FIX_AXIS_PAR_DIST 0 1 3 /end AXIS_DESCR
/end CHARACTERISTIC
/begin CHARACTERISTIC CVsoImuRotMatrixSnsr1 "Sensor1 rotation matrix from vehicle CAD" MAP 1073876796 __Float32_Value 0 NO_COMPU_METHOD -3.40282346639E+38 3.40282346639E+38 STEP_SIZE 1 FORMAT "%.6"
 /begin AXIS_DESCR FIX_AXIS NO_INPUT_QUANTITY NO_COMPU_METHOD 3 0 2 FIX_AXIS_PAR_DIST 0 1 3 /end AXIS_DESCR
 /begin AXIS_DESCR FIX_AXIS NO_INPUT_QUANTITY NO_COMPU_METHOD 3 0 2 FIX_AXIS_PAR_DIST 0 1 3 /end AXIS_DESCR
/end CHARACTERISTIC
/begin CHARACTERISTIC CVsoImuOffsVectSnsr1 "Sensor1 3D offset from centre of gravity [m]" CURVE 1073876784 __Float32_Value 0 tMetre -1000 1000 STEP_SIZE 1
 /begin AXIS_DESCR FIX_AXIS NO_INPUT_QUANTITY NO_COMPU_METHOD 3 0 2 FIX_AXIS_PAR_DIST 0 1 3 /end AXIS_DESCR
/end CHARACTERISTIC
/begin CHARACTERISTIC CVsoImuRotMatrixSnsr2 "Sensor2 rotation matrix from vehicle CAD" MAP 1073876740 __Float32_Value 0 NO_COMPU_METHOD -3.40282346639E+38 3.40282346639E+38 STEP_SIZE 1 FORMAT "%.6"
 /begin AXIS_DESCR FIX_AXIS NO_INPUT_QUANTITY NO_COMPU_METHOD 3 0 2 FIX_AXIS_PAR_DIST 0 1 3 /end AXIS_DESCR
 /begin AXIS_DESCR FIX_AXIS NO_INPUT_QUANTITY NO_COMPU_METHOD 3 0 2 FIX_AXIS_PAR_DIST 0 1 3 /end AXIS_DESCR
/end CHARACTERISTIC
/begin CHARACTERISTIC CVsoImuOffsVectSnsr2 "Sensor2 3D offset from centre of gravity [m]" CURVE 1073876728 __Float32_Value 0 tMetre -1000 1000 STEP_SIZE 1
 /begin AXIS_DESCR FIX_AXIS NO_INPUT_QUANTITY NO_COMPU_METHOD 3 0 2 FIX_AXIS_PAR_DIST 0 1 3 /end AXIS_DESCR
/end CHARACTERISTIC
/begin CHARACTERISTIC CVsoImuRotMatrixSnsr3 "Sensor3 rotation matrix from vehicle CAD" MAP 1073876684 __Float32_Value 0 NO_COMPU_METHOD -3.40282346639E+38 3.40282346639E+38 STEP_SIZE 1 FORMAT "%.6"
 /begin AXIS_DESCR FIX_AXIS NO_INPUT_QUANTITY NO_COMPU_METHOD 3 0 2 FIX_AXIS_PAR_DIST 0 1 3 /end AXIS_DESCR
 /begin AXIS_DESCR FIX_AXIS NO_INPUT_QUANTITY NO_COMPU_METHOD 3 0 2 FIX_AXIS_PAR_DIST 0 1 3 /end AXIS_DESCR
/end CHARACTERISTIC
/begin CHARACTERISTIC CVsoImuOffsVectSnsr3 "Sensor3 3D offset from centre of gravity [m]" CURVE 1073876672 __Float32_Value 0 tMetre -1000 1000 STEP_SIZE 1
 /begin AXIS_DESCR FIX_AXIS NO_INPUT_QUANTITY NO_COMPU_METHOD 3 0 2 FIX_AXIS_PAR_DIST 0 1 3 /end AXIS_DESCR
/end CHARACTERISTIC
/begin CHARACTERISTIC CVsoImuCogAccelFiltCutoffFreq "Virtual IMU accelerations low pass O1 Butter filter cutoff frequency [Hz]" CURVE 1073876636 __Float32_Value 0 tFactor -3.40282346639E+38 3.40282346639E+38 STEP_SIZE 1
 /begin AXIS_DESCR FIX_AXIS NO_INPUT_QUANTITY NO_COMPU_METHOD 3 0 2 FIX_AXIS_PAR_DIST 0 1 3 /end AXIS_DESCR
/end CHARACTERISTIC
/begin CHARACTERISTIC CVsoImuCogGyroFiltCutoffFreq "Virtual IMU gyro rates low pass O1 Butter filter cutoff frequency [Hz]" CURVE 1073876624 __Float32_Value 0 tFactor -3.40282346639E+38 3.40282346639E+38 STEP_SIZE 1
 /begin AXIS_DESCR FIX_AXIS NO_INPUT_QUANTITY NO_COMPU_METHOD 3 0 2 FIX_AXIS_PAR_DIST 0 1 3 /end AXIS_DESCR
/end CHARACTERISTIC
/begin CHARACTERISTIC CVsoVehMassFuelTab "Fuel level vs added vehicle mass table [kg]" CURVE 1073876596 __SWord_Value 0 tKilogram_S16 0 10000 STEP_SIZE 1
 /begin AXIS_DESCR COM_AXIS NO_INPUT_QUANTITY tPercent_100_S16 6 0 0 AXIS_PTS_REF CVsoVehMassFuelTabXSP /end AXIS_DESCR
/end CHARACTERISTIC
/begin AXIS_PTS CVsoVehMassFuelTabXSP "Fuel level vs added vehicle mass table, XAxis [%]" 1073876584 NO_INPUT_QUANTITY __SWord_Axis 0 tPercent_100_S16 6 0.0 100.0 STEP_SIZE 1 /end AXIS_PTS
/begin CHARACTERISTIC CVsoWhlAgFrntSteerTab "Steer angle of left front wheel w.r.t. steering wheel (static toe removed, +ve to left) [deg]" CURVE 1073876558 __SWord_Value 0 tDegree_10_S16 -720.0 720.0 STEP_SIZE 1
 /begin AXIS_DESCR COM_AXIS NO_INPUT_QUANTITY tDegree_10_S16 9 0 0 AXIS_PTS_REF CVsoWhlAgFrntSteerXSP /end AXIS_DESCR
/end CHARACTERISTIC
/begin AXIS_PTS CVsoWhlAgFrntSteerXSP "Steer angle of left front wheel w.r.t. steering wheel (static toe removed, +ve to left), XAxis - steer angle [deg] Input: shared->steering.steerAg" 1073876540 NO_INPUT_QUANTITY __SWord_Axis 0 tDegree_10_S16 9 -720.0 720.0 STEP_SIZE 1 /end AXIS_PTS
/begin CHARACTERISTIC CVsoWhlAgFrntTab "Steer angle of left front wheel w.r.t. suspension bump (static toe removed, +ve to left) [deg]" CURVE 1073876526 __SWord_Value 0 tDegree_10_S16 -720.0 720.0 STEP_SIZE 1
 /begin AXIS_DESCR COM_AXIS NO_INPUT_QUANTITY tMillimetre_10_S16 7 0 0 AXIS_PTS_REF CVsoWhlAgFrntMapXSP /end AXIS_DESCR
/end CHARACTERISTIC
/begin AXIS_PTS CVsoWhlAgFrntMapXSP "Steer angle of left front wheel w.r.t. suspension bump (static toe removed, +ve to left), XAxis - wheel travel [mm]" 1073876512 NO_INPUT_QUANTITY __SWord_Axis 0 tMillimetre_10_S16 7 -1000.0 1000.0 STEP_SIZE 1 /end AXIS_PTS
/begin CHARACTERISTIC CVsoWhlAgReTab "Steer angle of left rear wheel w.r.t. suspension bump (static toe removed, +ve to left) [deg]" CURVE 1073876498 __SWord_Value 0 tDegree_10_S16 -720.0 720.0 STEP_SIZE 1
 /begin AXIS_DESCR COM_AXIS NO_INPUT_QUANTITY tMillimetre_10_S16 7 0 0 AXIS_PTS_REF CVsoWhlAgReMapXSP /end AXIS_DESCR
/end CHARACTERISTIC
/begin AXIS_PTS CVsoWhlAgReMapXSP "Steer angle of left rear wheel w.r.t. suspension bump (static toe removed, +ve to left), XAxis - wheel travel [mm]" 1073876484 NO_INPUT_QUANTITY __SWord_Axis 0 tMillimetre_10_S16 7 -1000.0 1000.0 STEP_SIZE 1 /end AXIS_PTS
/begin CHARACTERISTIC CVsoWhlLoadCptEna "Enable single wheel normal load components" CURVE 1073876472 __UByte_Value 0 NO_COMPU_METHOD 0 1 STEP_SIZE 1 FORMAT "%.2"
 /begin AXIS_DESCR FIX_AXIS NO_INPUT_QUANTITY NO_COMPU_METHOD 7 0 6 FIX_AXIS_PAR_DIST 0 1 7 /end AXIS_DESCR
/end CHARACTERISTIC
/begin AXIS_PTS CVsoFrntAntiXSP "XAxis for front anti-X table - average wheel travel [mm]" 1073876458 NO_INPUT_QUANTITY __SWord_Axis 0 tMillimetre_10_S16 7 -1000.0 1000.0 STEP_SIZE 1 /end AXIS_PTS
/begin CHARACTERISTIC CVsoFrntRollAxisHeight "Height from ground of front suspension roll axis [mm]" CURVE 1073876444 __SWord_Value 0 tMillimetre_10_S16 -1000.0 1000.0 STEP_SIZE 1
 /begin AXIS_DESCR COM_AXIS NO_INPUT_QUANTITY tMillimetre_10_S16 7 0 0 AXIS_PTS_REF CVsoFrntAntiXSP /end AXIS_DESCR
/end CHARACTERISTIC
/begin CHARACTERISTIC CVsoFrntBrkAntiXAngle "Front suspension anti-dive angle while braking [deg] TODO (PWTSW-9969)" CURVE 1073876430 __SWord_Value 0 tDegree_10_S16 -720.0 720.0 STEP_SIZE 1
 /begin AXIS_DESCR COM_AXIS NO_INPUT_QUANTITY tMillimetre_10_S16 7 0 0 AXIS_PTS_REF CVsoFrntAntiXSP /end AXIS_DESCR
/end CHARACTERISTIC
/begin CHARACTERISTIC CVsoFrntDrvAntiXAngle "Front suspension anti-lift angle while driving [deg] TODO (PWTSW-9969)" CURVE 1073876416 __SWord_Value 0 tDegree_10_S16 -720.0 720.0 STEP_SIZE 1
 /begin AXIS_DESCR COM_AXIS NO_INPUT_QUANTITY tMillimetre_10_S16 7 0 0 AXIS_PTS_REF CVsoFrntAntiXSP /end AXIS_DESCR
/end CHARACTERISTIC
/begin AXIS_PTS CVsoReAntiXSP "XAxis for rear anti-X table - average wheel travel [mm]" 1073876402 NO_INPUT_QUANTITY __SWord_Axis 0 tMillimetre_10_S16 7 -1000.0 1000.0 STEP_SIZE 1 /end AXIS_PTS
/begin CHARACTERISTIC CVsoReRollAxisHeight "Height from ground of rear suspension roll axis [mm]" CURVE 1073876388 __SWord_Value 0 tMillimetre_10_S16 -1000.0 1000.0 STEP_SIZE 1
 /begin AXIS_DESCR COM_AXIS NO_INPUT_QUANTITY tMillimetre_10_S16 7 0 0 AXIS_PTS_REF CVsoReAntiXSP /end AXIS_DESCR
/end CHARACTERISTIC
/begin CHARACTERISTIC CVsoReBrkAntiXAngle "Rear suspension anti-lift angle while braking [deg] TODO (PWTSW-9969)" CURVE 1073876374 __SWord_Value 0 tDegree_10_S16 -720.0 720.0 STEP_SIZE 1
 /begin AXIS_DESCR COM_AXIS NO_INPUT_QUANTITY tMillimetre_10_S16 7 0 0 AXIS_PTS_REF CVsoReAntiXSP /end AXIS_DESCR
/end CHARACTERISTIC
/begin CHARACTERISTIC CVsoReDrvAntiXAngle "Rear suspension anti-squat angle while driving [deg] TODO (PWTSW-9969)" CURVE 1073876360 __SWord_Value 0 tDegree_10_S16 -720.0 720.0 STEP_SIZE 1
 /begin AXIS_DESCR COM_AXIS NO_INPUT_QUANTITY tMillimetre_10_S16 7 0 0 AXIS_PTS_REF CVsoReAntiXSP /end AXIS_DESCR
/end CHARACTERISTIC
/begin CHARACTERISTIC CVsoMainSprgStfn "Suspension main spring stiffnesses [N/mm]" CURVE 1073876344 __Float32_Value 0 tFactor 50 300 STEP_SIZE 1
 /begin AXIS_DESCR FIX_AXIS NO_INPUT_QUANTITY NO_COMPU_METHOD 4 0 3 FIX_AXIS_PAR_DIST 0 1 4 /end AXIS_DESCR
/end CHARACTERISTIC
/begin CHARACTERISTIC CVsoMainSprgTrvlRng "Suspension main spring maximum travel (free - block lenght) [mm]" CURVE 1073876336 __SWord_Value 0 tMillimetre_10_S16 100 2000 STEP_SIZE 1
 /begin AXIS_DESCR FIX_AXIS NO_INPUT_QUANTITY NO_COMPU_METHOD 4 0 3 FIX_AXIS_PAR_DIST 0 1 4 /end AXIS_DESCR
/end CHARACTERISTIC
/begin CHARACTERISTIC CVsoHelperSprgStfn "Suspension helper spring stiffnesses [N/mm]" CURVE 1073876320 __Float32_Value 0 tFactor 1 100 STEP_SIZE 1
 /begin AXIS_DESCR FIX_AXIS NO_INPUT_QUANTITY NO_COMPU_METHOD 4 0 3 FIX_AXIS_PAR_DIST 0 1 4 /end AXIS_DESCR
/end CHARACTERISTIC
/begin CHARACTERISTIC CVsoHelperSprgTrvlRng "Suspension helper spring maximum travel (free - block lenght) [mm]" CURVE 1073876310 __SWord_Value 0 tMillimetre_10_S16 100 2000 STEP_SIZE 1
 /begin AXIS_DESCR FIX_AXIS NO_INPUT_QUANTITY NO_COMPU_METHOD 4 0 3 FIX_AXIS_PAR_DIST 0 1 4 /end AXIS_DESCR
/end CHARACTERISTIC
/begin CHARACTERISTIC CVsoFrntWhlArbStiffness "Front ARB stiffness (vehicle roll torque / vehicle roll angle) [Nm/deg]" CURVE 1073876296 __SWord_Value 0 tNewtonMetrePerDegree_S16 0 10000 STEP_SIZE 1
 /begin AXIS_DESCR COM_AXIS NO_INPUT_QUANTITY tMillimetre_10_S16 7 0 0 AXIS_PTS_REF CVsoFrntWhlArbXSP /end AXIS_DESCR
/end CHARACTERISTIC
/begin AXIS_PTS CVsoFrntWhlArbXSP "Front ARB stiffness (vehicle roll torque / vehicle roll angle) Xaxis, average wheel travel [mm]" 1073876282 NO_INPUT_QUANTITY __SWord_Axis 0 tMillimetre_10_S16 7 -1000.0 1000.0 STEP_SIZE 1 /end AXIS_PTS
/begin CHARACTERISTIC CVsoFrntDamperCmpnMap "Front damper map from KW, compression [kN]" MAP 1073876228 __SWord_Value 0 tNewton_S16 -10000 10000 STEP_SIZE 1
 /begin AXIS_DESCR COM_AXIS NO_INPUT_QUANTITY tMillimetrePerSecond_S16 9 0 0 AXIS_PTS_REF CVsoFrntDamperMapXSP /end AXIS_DESCR
 /begin AXIS_DESCR COM_AXIS NO_INPUT_QUANTITY tAmpere_100_S16 3 0 0 AXIS_PTS_REF CVsoFrntDamperMapYSP /end AXIS_DESCR
/end CHARACTERISTIC
/begin CHARACTERISTIC CVsoFrntDamperRbdMap "Front damper map from KW, rebound [kN]" MAP 1073876174 __SWord_Value 0 tNewton_S16 -10000 10000 STEP_SIZE 1
 /begin AXIS_DESCR COM_AXIS NO_INPUT_QUANTITY tMillimetrePerSecond_S16 9 0 0 AXIS_PTS_REF CVsoFrntDamperMapXSP /end AXIS_DESCR
 /begin AXIS_DESCR COM_AXIS NO_INPUT_QUANTITY tAmpere_100_S16 3 0 0 AXIS_PTS_REF CVsoFrntDamperMapYSP /end AXIS_DESCR
/end CHARACTERISTIC
/begin AXIS_PTS CVsoFrntDamperMapXSP "Front damper map from KW [m/s]" 1073876156 NO_INPUT_QUANTITY __SWord_Axis 0 tMillimetrePerSecond_S16 9 -2000 2000 STEP_SIZE 1 /end AXIS_PTS
/begin AXIS_PTS CVsoFrntDamperMapYSP "Front damper map from KW [A]" 1073876150 NO_INPUT_QUANTITY __SWord_Axis 0 tAmpere_100_S16 3 0.0 10000.0 STEP_SIZE 1 /end AXIS_PTS
/begin CHARACTERISTIC CVsoReWhlArbStiffness "Rear ARB stiffness (vehicle roll torque / vehicle roll angle) [Nm/deg]" CURVE 1073876136 __SWord_Value 0 tNewtonMetrePerDegree_S16 0 10000 STEP_SIZE 1
 /begin AXIS_DESCR COM_AXIS NO_INPUT_QUANTITY tMillimetre_10_S16 7 0 0 AXIS_PTS_REF CVsoReWhlArbXSP /end AXIS_DESCR
/end CHARACTERISTIC
/begin AXIS_PTS CVsoReWhlArbXSP "Rear ARB stiffness (vehicle roll torque / vehicle roll angle) Xaxis, average wheel travel [mm]" 1073876122 NO_INPUT_QUANTITY __SWord_Axis 0 tMillimetre_10_S16 7 -1000.0 1000.0 STEP_SIZE 1 /end AXIS_PTS
/begin CHARACTERISTIC CVsoReDamperCmpnMap "Rear damper map from KW, compression [kN]" MAP 1073876068 __SWord_Value 0 tNewton_S16 -10000 10000 STEP_SIZE 1
 /begin AXIS_DESCR COM_AXIS NO_INPUT_QUANTITY tMillimetrePerSecond_S16 9 0 0 AXIS_PTS_REF CVsoReDamperMapXSP /end AXIS_DESCR
 /begin AXIS_DESCR COM_AXIS NO_INPUT_QUANTITY tAmpere_100_S16 3 0 0 AXIS_PTS_REF CVsoReDamperMapYSP /end AXIS_DESCR
/end CHARACTERISTIC
/begin CHARACTERISTIC CVsoReDamperRbdMap "Rear damper map from KW, rebound [kN]" MAP 1073876014 __SWord_Value 0 tNewton_S16 -10000 10000 STEP_SIZE 1
 /begin AXIS_DESCR COM_AXIS NO_INPUT_QUANTITY tMillimetrePerSecond_S16 9 0 0 AXIS_PTS_REF CVsoFrntDamperMapXSP /end AXIS_DESCR
 /begin AXIS_DESCR COM_AXIS NO_INPUT_QUANTITY tAmpere_100_S16 3 0 0 AXIS_PTS_REF CVsoReDamperMapYSP /end AXIS_DESCR
/end CHARACTERISTIC
/begin AXIS_PTS CVsoReDamperMapXSP "Rear damper map from KW [m/s]" 1073875996 NO_INPUT_QUANTITY __SWord_Axis 0 tMillimetrePerSecond_S16 9 -2000 2000 STEP_SIZE 1 /end AXIS_PTS
/begin AXIS_PTS CVsoReDamperMapYSP "Rear damper map from KW [A]" 1073875990 NO_INPUT_QUANTITY __SWord_Axis 0 tAmpere_100_S16 3 0.0 10000.0 STEP_SIZE 1 /end AXIS_PTS
/begin AXIS_PTS CVsoTireRadNormalLoadTabXSP "Tire radius calibration tables X-axis (Vertical Force) [kN]" 1073875934 NO_INPUT_QUANTITY __SWord_Axis 0 tKilonewton_100_S16 6 -100.0 100.0 STEP_SIZE 1 /end AXIS_PTS
/begin CHARACTERISTIC CVsoTireRadFrntCup2NormLoadTab "Tire rolling radius vs normal load factor table - Front Cup 2" CURVE 1073875922 __SWord_Value 0 tFactor_1000_S16 -32.768 32.767 STEP_SIZE 1
 /begin AXIS_DESCR COM_AXIS NO_INPUT_QUANTITY tKilonewton_100_S16 6 0 0 AXIS_PTS_REF CVsoTireRadNormalLoadTabXSP /end AXIS_DESCR
/end CHARACTERISTIC
/begin CHARACTERISTIC CVsoTireRadFrntCup2RNormLoadTab "Tire rolling radius vs normal load factor table - Front Cup 2R" CURVE 1073875910 __SWord_Value 0 tFactor_1000_S16 -32.768 32.767 STEP_SIZE 1
 /begin AXIS_DESCR COM_AXIS NO_INPUT_QUANTITY tKilonewton_100_S16 6 0 0 AXIS_PTS_REF CVsoTireRadNormalLoadTabXSP /end AXIS_DESCR
/end CHARACTERISTIC
/begin CHARACTERISTIC CVsoTireRadFrntAlpinNormLoadTab "Tire rolling radius vs normal load factor table - Front Alpin" CURVE 1073875898 __SWord_Value 0 tFactor_1000_S16 -32.768 32.767 STEP_SIZE 1
 /begin AXIS_DESCR COM_AXIS NO_INPUT_QUANTITY tKilonewton_100_S16 6 0 0 AXIS_PTS_REF CVsoTireRadNormalLoadTabXSP /end AXIS_DESCR
/end CHARACTERISTIC
/begin CHARACTERISTIC CVsoTireRadReCup2NormLoadTab "Tire rolling radius vs normal load factor table - Rear Cup 2" CURVE 1073875842 __SWord_Value 0 tFactor_1000_S16 -32.768 32.767 STEP_SIZE 1
 /begin AXIS_DESCR COM_AXIS NO_INPUT_QUANTITY tKilonewton_100_S16 6 0 0 AXIS_PTS_REF CVsoTireRadNormalLoadTabXSP /end AXIS_DESCR
/end CHARACTERISTIC
/begin CHARACTERISTIC CVsoTireRadReCup2RNormLoadTab "Tire rolling radius vs normal load factor table - Rear Cup 2R" CURVE 1073875830 __SWord_Value 0 tFactor_1000_S16 -32.768 32.767 STEP_SIZE 1
 /begin AXIS_DESCR COM_AXIS NO_INPUT_QUANTITY tKilonewton_100_S16 6 0 0 AXIS_PTS_REF CVsoTireRadNormalLoadTabXSP /end AXIS_DESCR
/end CHARACTERISTIC
/begin CHARACTERISTIC CVsoTireRadReAlpinNormLoadTab "Tire rolling radius vs normal load factor table - Rear Alpin" CURVE 1073875818 __SWord_Value 0 tFactor_1000_S16 -32.768 32.767 STEP_SIZE 1
 /begin AXIS_DESCR COM_AXIS NO_INPUT_QUANTITY tKilonewton_100_S16 6 0 0 AXIS_PTS_REF CVsoTireRadNormalLoadTabXSP /end AXIS_DESCR
/end CHARACTERISTIC
/begin AXIS_PTS CVsoDsoObsvrGainMatrixXsp "VSO dynamic state observer gain matrix speed setpoints" 1073875676 NO_INPUT_QUANTITY __Float32_Axis 0 tKilometrePerHour 9 10 400 STEP_SIZE 1 /end AXIS_PTS
/begin CHARACTERISTIC CVsoDsoObsvrGainMatrixL00 "VSO dynamic state observer gain matrix element at index position [0][0]" CURVE 1073875640 __Float32_Value 0 NO_COMPU_METHOD -150 0 STEP_SIZE 1 FORMAT "%.6"
 /begin AXIS_DESCR COM_AXIS NO_INPUT_QUANTITY tKilometrePerHour 9 0 0 AXIS_PTS_REF CVsoDsoObsvrGainMatrixXsp /end AXIS_DESCR
/end CHARACTERISTIC
/begin CHARACTERISTIC CVsoDsoObsvrGainMatrixL01 "VSO dynamic state observer gain matrix element at index position [0][1] [-]" CURVE 1073875604 __Float32_Value 0 NO_COMPU_METHOD 0 0.5 STEP_SIZE 1 FORMAT "%.6"
 /begin AXIS_DESCR COM_AXIS NO_INPUT_QUANTITY tKilometrePerHour 9 0 0 AXIS_PTS_REF CVsoDsoObsvrGainMatrixXsp /end AXIS_DESCR
/end CHARACTERISTIC
/begin CHARACTERISTIC CVsoDsoObsvrGainMatrixL10 "VSO dynamic state observer gain matrix element at index position [1][0] [-]" CURVE 1073875568 __Float32_Value 0 NO_COMPU_METHOD -200 0 STEP_SIZE 1 FORMAT "%.6"
 /begin AXIS_DESCR COM_AXIS NO_INPUT_QUANTITY tKilometrePerHour 9 0 0 AXIS_PTS_REF CVsoDsoObsvrGainMatrixXsp /end AXIS_DESCR
/end CHARACTERISTIC
/begin CHARACTERISTIC CVsoDsoObsvrGainMatrixL11 "VSO dynamic state observer gain matrix element at index position [1][1] [-]" CURVE 1073875532 __Float32_Value 0 NO_COMPU_METHOD 0 1 STEP_SIZE 1 FORMAT "%.6"
 /begin AXIS_DESCR COM_AXIS NO_INPUT_QUANTITY tKilometrePerHour 9 0 0 AXIS_PTS_REF CVsoDsoObsvrGainMatrixXsp /end AXIS_DESCR
/end CHARACTERISTIC
/begin CHARACTERISTIC CVsoTireMdlPrmFrnt "Pacejka tire longitudinal model parameters, front tire" CURVE 1073875456 __Float32_Value 0 NO_COMPU_METHOD -3.40282346639E+38 3.40282346639E+38 STEP_SIZE 1 FORMAT "%.6"
 /begin AXIS_DESCR FIX_AXIS NO_INPUT_QUANTITY NO_COMPU_METHOD 12 0 11 FIX_AXIS_PAR_DIST 0 1 12 /end AXIS_DESCR
/end CHARACTERISTIC
/begin CHARACTERISTIC CVsoTireMdlPrmRe "Pacejka tire model parameters, rear tire" CURVE 1073875408 __Float32_Value 0 NO_COMPU_METHOD -3.40282346639E+38 3.40282346639E+38 STEP_SIZE 1 FORMAT "%.6"
 /begin AXIS_DESCR FIX_AXIS NO_INPUT_QUANTITY NO_COMPU_METHOD 12 0 11 FIX_AXIS_PAR_DIST 0 1 12 /end AXIS_DESCR
/end CHARACTERISTIC
/begin AXIS_PTS CVsoTireMdlRoad2TireFricCoeffXsp "Tire model friction coefficient linear conversion from tire-road friction coefficient, setpoint" 1073875392 NO_INPUT_QUANTITY __Float32_Axis 0 tFactor 2 0 2 STEP_SIZE 1 /end AXIS_PTS
/begin CHARACTERISTIC CVsoTireMdlRoad2TireFricCoeffLgtYsp "Tire model longitudinal friction coefficient linear conversion from tire-road friction coefficient" CURVE 1073875384 __Float32_Value 0 tFactor 0 2 STEP_SIZE 1
 /begin AXIS_DESCR COM_AXIS NO_INPUT_QUANTITY tFactor 2 0 0 AXIS_PTS_REF CVsoTireMdlRoad2TireFricCoeffXsp /end AXIS_DESCR
/end CHARACTERISTIC
/begin CHARACTERISTIC CVsoTireMdlRoad2TireFricCoeffLatYsp "Tire model lateral friction coefficient linear conversion from tire-road friction coefficient" CURVE 1073875376 __Float32_Value 0 tFactor 0 2 STEP_SIZE 1
 /begin AXIS_DESCR COM_AXIS NO_INPUT_QUANTITY tFactor 2 0 0 AXIS_PTS_REF CVsoTireMdlRoad2TireFricCoeffXsp /end AXIS_DESCR
/end CHARACTERISTIC
/begin CHARACTERISTIC CVsoCoastDwnDrgPolyCoeff "Coast down polynomial coefficients" CURVE 1073875328 __Float32_Value 0 tFactor -3.40282346639E+38 3.40282346639E+38 STEP_SIZE 1
 /begin AXIS_DESCR FIX_AXIS NO_INPUT_QUANTITY NO_COMPU_METHOD 3 0 2 FIX_AXIS_PAR_DIST 0 1 3 /end AXIS_DESCR
/end CHARACTERISTIC
/begin AXIS_PTS CVsoDtLossTempXsp "Oil temperature used to evaluate drivetrain losses" 1073875304 NO_INPUT_QUANTITY __Float32_Axis 0 tCelsius 6 -400 10000 STEP_SIZE 1 /end AXIS_PTS
/begin AXIS_PTS CVsoDtLossRotSpdYsp "Vehicle velocity used to evaluate drivetrain losses" 1073875272 NO_INPUT_QUANTITY __Float32_Axis 0 tRevolutionPerMinute 8 -10000 10000 STEP_SIZE 1 /end AXIS_PTS
/begin CHARACTERISTIC CVsoFrntDtLossPropshTqMap "Front drivetrain losses for the portion of driveline delimited by front wheel clutches and central clutch Evaluated as propshaft torque resistance, based on bulldog oil temperature and emotor speed Calibration method: dyno without road load, wheel clutches and central clutch open, spin emotor at different rpm and oil temperatures, record emotor torque, clutches with separation springs to avoid dragging" MAP 1073875080 __Float32_Value 0 tNewtonMetre -100000 100000 STEP_SIZE 1
 /begin AXIS_DESCR COM_AXIS NO_INPUT_QUANTITY tCelsius 6 0 0 AXIS_PTS_REF CVsoDtLossTempXsp /end AXIS_DESCR
 /begin AXIS_DESCR COM_AXIS NO_INPUT_QUANTITY tRevolutionPerMinute 8 0 0 AXIS_PTS_REF CVsoDtLossRotSpdYsp /end AXIS_DESCR
/end CHARACTERISTIC
/begin CHARACTERISTIC CVsoRearDtLossPropshTqMap "Rear drivetrain losses for the portion of driveline delimited by rear wheel clutches and central clutch, LSTT in neutral Evaluated as propshaft torque resistance, based on LSTT oil temperature and propshaft speed Calibration method: dyno without road load, wheel clutches open and and central clutch engaged, spin emotor at different rpm and LSTT oil temperatures, record emotor torque, subtract CVsoFrntDtLossPropshTqMap" MAP 1073874888 __Float32_Value 0 tNewtonMetre -100000 100000 STEP_SIZE 1
 /begin AXIS_DESCR COM_AXIS NO_INPUT_QUANTITY tCelsius 6 0 0 AXIS_PTS_REF CVsoDtLossTempXsp /end AXIS_DESCR
 /begin AXIS_DESCR COM_AXIS NO_INPUT_QUANTITY tRevolutionPerMinute 8 0 0 AXIS_PTS_REF CVsoDtLossRotSpdYsp /end AXIS_DESCR
/end CHARACTERISTIC
/begin CHARACTERISTIC CWhlCluEngdSftyFacMap "Safety factor for wheel clutches when in engaged state" MAP 1073874848 __Float32_Value 0 tFactor -3.40282346639E+38 3.40282346639E+38 STEP_SIZE 1
 /begin AXIS_DESCR COM_AXIS NO_INPUT_QUANTITY tNewtonMetre 3 0 0 AXIS_PTS_REF CWhlCluEngdSftyFacXSP /end AXIS_DESCR
 /begin AXIS_DESCR COM_AXIS NO_INPUT_QUANTITY tKilometrePerHour 3 0 0 AXIS_PTS_REF CWhlCluEngdSftyFacYSP /end AXIS_DESCR
/end CHARACTERISTIC
/begin AXIS_PTS CWhlCluEngdSftyFacXSP "XSP to safety factor map" 1073874836 NO_INPUT_QUANTITY __Float32_Axis 0 tNewtonMetre 3 -100000 100000 STEP_SIZE 1 /end AXIS_PTS
/begin AXIS_PTS CWhlCluEngdSftyFacYSP "TODO: Description required!" 1073874824 NO_INPUT_QUANTITY __Float32_Axis 0 tKilometrePerHour 3 -600 600 STEP_SIZE 1 /end AXIS_PTS
/begin CHARACTERISTIC CTqToPTranslateTab "Torque to pressure table based on pressure TODO convert to wheel torque number based on differences" CURVE 1073874792 __Float32_Value 0 tNewtonMetrePerBar 0 150 STEP_SIZE 1
 /begin AXIS_DESCR COM_AXIS NO_INPUT_QUANTITY tRevolutionPerMinute 6 0 0 AXIS_PTS_REF CTqToPTranslateXSP /end AXIS_DESCR
/end CHARACTERISTIC
/begin AXIS_PTS CTqToPTranslateXSP "XSP to torque to pressure table" 1073874768 NO_INPUT_QUANTITY __Float32_Axis 0 tRevolutionPerMinute 6 -10000 10000 STEP_SIZE 1 /end AXIS_PTS
/begin CHARACTERISTIC CNmPerBarTFac "Nm per bar factor based on estimated clutch temperature" CURVE 1073874744 __Float32_Value 0 tFactor -3.40282346639E+38 3.40282346639E+38 STEP_SIZE 1
 /begin AXIS_DESCR COM_AXIS NO_INPUT_QUANTITY tCelsius 6 0 0 AXIS_PTS_REF CNmPerBarTFacXsp /end AXIS_DESCR
/end CHARACTERISTIC
/begin AXIS_PTS CNmPerBarTFacXsp "XSP to torque to pressure table" 1073874720 NO_INPUT_QUANTITY __Float32_Axis 0 tCelsius 6 -400 10000 STEP_SIZE 1 /end AXIS_PTS
/begin CHARACTERISTIC CCluSTEngdPressErrorThres "Pressure error threshold to consider a clutch ENGAGED" VALUE 1073874714 __SWord_Value 0 tBar_100_S16 -1.0 1000.0 STEP_SIZE 1 /end CHARACTERISTIC
/begin CHARACTERISTIC CCMDDefault_Tab "* Valve calibration *********************************** Base CMD to achieve a given pressure" CURVE 1073874710 __SWord_Value 0 tPercent_100_S16 0.0 100.0 STEP_SIZE 1
 /begin AXIS_DESCR COM_AXIS NO_INPUT_QUANTITY tBar_100_S16 2 0 0 AXIS_PTS_REF CValveCMD_XSP /end AXIS_DESCR
/end CHARACTERISTIC
/begin CHARACTERISTIC CCMDAllowedDeviation "Allowed deviation of top and bottom values in valve lookup tables (valveCMD_Map)" CURVE 1073874706 __SWord_Value 0 tPercent_100_S16 0.0 100.0 STEP_SIZE 1
 /begin AXIS_DESCR COM_AXIS NO_INPUT_QUANTITY tBar_100_S16 2 0 0 AXIS_PTS_REF CValveCMD_XSP /end AXIS_DESCR
/end CHARACTERISTIC
/begin CHARACTERISTIC CTestWhlCluPressDmd "Pressure demand for testing wheel clutches [0] CLU_FL [1] CLU_FR [2] CLU_RL [3] CLU_RR" CURVE 1073874696 __SWord_Value 0 tBar_100_S16 -1.0 1000.0 STEP_SIZE 1
 /begin AXIS_DESCR FIX_AXIS NO_INPUT_QUANTITY tCluIdx 4 0 3 FIX_AXIS_PAR_DIST 0 1 4 /end AXIS_DESCR
/end CHARACTERISTIC
/begin AXIS_PTS CValveCMD_XSP "Pressure lookup map x-axis" 1073874692 NO_INPUT_QUANTITY __SWord_Axis 0 tBar_100_S16 2 -1.0 1000.0 STEP_SIZE 1 /end AXIS_PTS
/begin CHARACTERISTIC CCluEngdTqMin "Min torque if CLU_CTRL_ENGAGED state" VALUE 1073874688 __Float32_Value 0 tNewtonMetre -100000 100000 STEP_SIZE 1 /end CHARACTERISTIC
/begin CHARACTERISTIC CMaxCluPressure "Max pressure in clutch" CURVE 1073874678 __SWord_Value 0 tBar_100_S16 -1.0 1000.0 STEP_SIZE 1
 /begin AXIS_DESCR FIX_AXIS NO_INPUT_QUANTITY NO_COMPU_METHOD 4 0 3 FIX_AXIS_PAR_DIST 0 1 4 /end AXIS_DESCR
/end CHARACTERISTIC
/begin CHARACTERISTIC CValveHysteresisCorrectionUp_Tab "Correction for hysteresis when ramping up" CURVE 1073874648 __SWord_Value 0 tPercent_100_S16 0.0 100.0 STEP_SIZE 1
 /begin AXIS_DESCR COM_AXIS NO_INPUT_QUANTITY tBar_100_S16 14 0 0 AXIS_PTS_REF CValveHysteresisCorrection_XSP /end AXIS_DESCR
/end CHARACTERISTIC
/begin CHARACTERISTIC CValveHysteresisCorrectionDown_Tab "Correction for hysteresis when ramping down" CURVE 1073874620 __SWord_Value 0 tPercent_100_S16 0.0 100.0 STEP_SIZE 1
 /begin AXIS_DESCR COM_AXIS NO_INPUT_QUANTITY tBar_100_S16 14 0 0 AXIS_PTS_REF CValveHysteresisCorrection_XSP /end AXIS_DESCR
/end CHARACTERISTIC
/begin CHARACTERISTIC CValveHysteresis "If a valve has higher hysteresis than the average, the value can be set here" CURVE 1073874612 __SWord_Value 0 tPercent_100_S16 0.0 100.0 STEP_SIZE 1
 /begin AXIS_DESCR FIX_AXIS NO_INPUT_QUANTITY NO_COMPU_METHOD 4 0 3 FIX_AXIS_PAR_DIST 0 1 4 /end AXIS_DESCR
/end CHARACTERISTIC
/begin AXIS_PTS CValveHysteresisCorrection_XSP "Horisontal axis of hysteresis correction" 1073874584 NO_INPUT_QUANTITY __SWord_Axis 0 tBar_100_S16 14 -1.0 1000.0 STEP_SIZE 1 /end AXIS_PTS
/begin CHARACTERISTIC CChargedHighPressure "Pressure controller needs this system pressure to start a fastfill and engage a clutch" VALUE 1073874574 __SWord_Value 0 tBar_100_S16 -1.0 1000.0 STEP_SIZE 1 /end CHARACTERISTIC
/begin CHARACTERISTIC CDischargedHighPressure "Pressure controller will open an engaged clutch or abort a fastfill below this system pressure" VALUE 1073874572 __SWord_Value 0 tBar_100_S16 -1.0 1000.0 STEP_SIZE 1 /end CHARACTERISTIC
/begin CHARACTERISTIC CFeedforwardInertiaGain_Tab "* Pressure Controller ********************************* Feedforward inertia gain" CURVE 1073874562 __SWord_Value 0 tFactor_1000_S16 -32.768 32.767 STEP_SIZE 1
 /begin AXIS_DESCR COM_AXIS NO_INPUT_QUANTITY tCelsius_10_S16 2 0 0 AXIS_PTS_REF CFeedforwardInertiaGain_XSP /end AXIS_DESCR
/end CHARACTERISTIC
/begin AXIS_PTS CFeedforwardInertiaGain_XSP "Fastfill sequence start pressure Gearbox temperature on vertical axis" 1073874558 NO_INPUT_QUANTITY __SWord_Axis 0 tCelsius_10_S16 2 -400.0 10000.0 STEP_SIZE 1 /end AXIS_PTS
/begin CHARACTERISTIC CDeltaDemandLow "At low ramp deltas, use PI controller in ramps" VALUE 1073874556 __SWord_Value 0 tBar_100_S16 -1.0 1000.0 STEP_SIZE 1 /end CHARACTERISTIC
/begin CHARACTERISTIC CDeltaDemandHigh "At high ramp deltas, ignore PI controller, run open loop" VALUE 1073874554 __SWord_Value 0 tBar_100_S16 -1.0 1000.0 STEP_SIZE 1 /end CHARACTERISTIC
/begin CHARACTERISTIC CPID_Lim_tab "PID limit (15-8%)" CURVE 1073874536 __SWord_Value 0 tPercent_100_S16 0.0 100.0 STEP_SIZE 1
 /begin AXIS_DESCR COM_AXIS NO_INPUT_QUANTITY tBar_100_S16 6 0 0 AXIS_PTS_REF CPID_coeff_P_XSP /end AXIS_DESCR
/end CHARACTERISTIC
/begin CHARACTERISTIC CPID_coeff_P_Cold_Map "PID P coefficient map for low temperature. High gain at low pressure (typ <10 bar), normal gain above" MAP 1073874488 __SWord_Value 0 tFactor_1000_S16 -32.768 32.767 STEP_SIZE 1
 /begin AXIS_DESCR COM_AXIS NO_INPUT_QUANTITY tBar_100_S16 6 0 0 AXIS_PTS_REF CPID_coeff_P_XSP /end AXIS_DESCR
 /begin AXIS_DESCR FIX_AXIS NO_INPUT_QUANTITY NO_COMPU_METHOD 4 0 3 FIX_AXIS_PAR_DIST 0 1 4 /end AXIS_DESCR
/end CHARACTERISTIC
/begin CHARACTERISTIC CPID_coeff_P_Hot_Map "PID P coefficient map for high temperature. High gain at low pressure (typ <10 bar), normal gain above" MAP 1073874440 __SWord_Value 0 tFactor_1000_S16 -32.768 32.767 STEP_SIZE 1
 /begin AXIS_DESCR COM_AXIS NO_INPUT_QUANTITY tBar_100_S16 6 0 0 AXIS_PTS_REF CPID_coeff_P_XSP /end AXIS_DESCR
 /begin AXIS_DESCR FIX_AXIS NO_INPUT_QUANTITY NO_COMPU_METHOD 4 0 3 FIX_AXIS_PAR_DIST 0 1 4 /end AXIS_DESCR
/end CHARACTERISTIC
/begin CHARACTERISTIC CCMDFloorOffset "Offset to the floored CMD" VALUE 1073874438 __SWord_Value 0 tPercent_100_S16 0.0 100.0 STEP_SIZE 1 /end CHARACTERISTIC
/begin CHARACTERISTIC CCMDFloorOffsetDownRamp "Offset to the floored CMD during downramp" VALUE 1073874436 __SWord_Value 0 tPercent_100_S16 0.0 100.0 STEP_SIZE 1 /end CHARACTERISTIC
/begin AXIS_PTS CPID_coeff_P_XSP "Pressure points for the P factor map" 1073874424 NO_INPUT_QUANTITY __SWord_Axis 0 tBar_100_S16 6 -1.0 1000.0 STEP_SIZE 1 /end AXIS_PTS
/begin CHARACTERISTIC CPID_coeff_I_Map "PID I coefficient table. Lower gain a low temperature" MAP 1073874392 __SWord_Value 0 tFactor_1000_S16 -32.768 32.767 STEP_SIZE 1
 /begin AXIS_DESCR COM_AXIS NO_INPUT_QUANTITY tCelsius_10_S16 4 0 0 AXIS_PTS_REF CPID_coeff_temperature_XSP /end AXIS_DESCR
 /begin AXIS_DESCR FIX_AXIS NO_INPUT_QUANTITY NO_COMPU_METHOD 4 0 3 FIX_AXIS_PAR_DIST 0 1 4 /end AXIS_DESCR
/end CHARACTERISTIC
/begin CHARACTERISTIC CPID_coeff_D_Map "PID D coefficient table. Higher gain a low temperature" MAP 1073874360 __SWord_Value 0 tFactor_1000_S16 -32.768 32.767 STEP_SIZE 1
 /begin AXIS_DESCR COM_AXIS NO_INPUT_QUANTITY tCelsius_10_S16 4 0 0 AXIS_PTS_REF CPID_coeff_temperature_XSP /end AXIS_DESCR
 /begin AXIS_DESCR FIX_AXIS NO_INPUT_QUANTITY NO_COMPU_METHOD 4 0 3 FIX_AXIS_PAR_DIST 0 1 4 /end AXIS_DESCR
/end CHARACTERISTIC
/begin AXIS_PTS CPID_coeff_temperature_XSP "Temperature points of" 1073874352 NO_INPUT_QUANTITY __SWord_Axis 0 tCelsius_10_S16 4 -400.0 10000.0 STEP_SIZE 1 /end AXIS_PTS
/begin AXIS_PTS CWhlCluIdx_YSP "Clutch Index" 1073874344 NO_INPUT_QUANTITY __SWord_Axis 0 NO_COMPU_METHOD 4 -32768 32767 STEP_SIZE 1 FORMAT "%.0" /end AXIS_PTS
/begin CHARACTERISTIC CDitherAmplitudePlateauDownslopeScale "Software dithering amplitude scaling on flat demands and downslope" VALUE 1073874316 __Float32_Value 0 tFactor -3.40282346639E+38 3.40282346639E+38 STEP_SIZE 1 /end CHARACTERISTIC
/begin CHARACTERISTIC CDitherUpslopeHyst "Hysteresis between upslope and downslope for dithering" VALUE 1073874312 __SWord_Value 0 tBar_100_S16 -1.0 1000.0 STEP_SIZE 1 /end CHARACTERISTIC
/begin CHARACTERISTIC CDitherFrequency_Map "//Software dithering frequency map" MAP 1073874272 __SWord_Value 0 tHertz_10_S16 0.0 30000.0 STEP_SIZE 1
 /begin AXIS_DESCR COM_AXIS NO_INPUT_QUANTITY tCelsius_10_S16 5 0 0 AXIS_PTS_REF CDitherFrequency_XSP /end AXIS_DESCR
 /begin AXIS_DESCR FIX_AXIS NO_INPUT_QUANTITY NO_COMPU_METHOD 4 0 3 FIX_AXIS_PAR_DIST 0 1 4 /end AXIS_DESCR
/end CHARACTERISTIC
/begin AXIS_PTS CDitherFrequency_XSP "//Software dithering frequency map X axis" 1073874262 NO_INPUT_QUANTITY __SWord_Axis 0 tCelsius_10_S16 5 -400.0 10000.0 STEP_SIZE 1 /end AXIS_PTS
/begin CHARACTERISTIC CDitherAmplitude_Map "//Software dithering amplitude map" MAP 1073874222 __SWord_Value 0 tPercent_100_S16 0.0 100.0 STEP_SIZE 1
 /begin AXIS_DESCR COM_AXIS NO_INPUT_QUANTITY tCelsius_10_S16 5 0 0 AXIS_PTS_REF CDitherAmplitude_XSP /end AXIS_DESCR
 /begin AXIS_DESCR FIX_AXIS NO_INPUT_QUANTITY NO_COMPU_METHOD 4 0 3 FIX_AXIS_PAR_DIST 0 1 4 /end AXIS_DESCR
/end CHARACTERISTIC
/begin AXIS_PTS CDitherAmplitude_XSP "//Software dithering amplitude map X axis" 1073874212 NO_INPUT_QUANTITY __SWord_Axis 0 tCelsius_10_S16 5 -400.0 10000.0 STEP_SIZE 1 /end AXIS_PTS
/begin CHARACTERISTIC CValveCMDToCurrent_Tab "Valve CMD(%) to Current(A)" CURVE 1073874188 __SWord_Value 0 tAmpere_100_S16 0.0 10000.0 STEP_SIZE 1
 /begin AXIS_DESCR COM_AXIS NO_INPUT_QUANTITY tPercent_100_S16 2 0 0 AXIS_PTS_REF CValveCMDToCurrent_XSP /end AXIS_DESCR
/end CHARACTERISTIC
/begin AXIS_PTS CValveCMDToCurrent_XSP "XSP for Valve CMD(*100%) to Current(A) Tab" 1073874184 NO_INPUT_QUANTITY __SWord_Axis 0 tPercent_100_S16 2 0.0 100.0 STEP_SIZE 1 /end AXIS_PTS
/begin CHARACTERISTIC CDitherPeakHold "Dithering Peak-Hold Ratio" VALUE 1073874176 __Float32_Value 0 tFactor -3.40282346639E+38 3.40282346639E+38 STEP_SIZE 1 /end CHARACTERISTIC
/begin CHARACTERISTIC CFastfillSpdComp "Fastfill sequence time compensation [ms per 1000RPM] due to Clutch Speed" CURVE 1073874158 __SWord_Value 0 tFactor_1000_S16 -32.768 32.767 STEP_SIZE 1
 /begin AXIS_DESCR FIX_AXIS NO_INPUT_QUANTITY NO_COMPU_METHOD 4 0 3 FIX_AXIS_PAR_DIST 0 1 4 /end AXIS_DESCR
/end CHARACTERISTIC
/begin CHARACTERISTIC CFastfillAdaptionIntegralCorrectionFactor "Fastfill sequence correction factor" CURVE 1073874144 __SWord_Value 0 tFactor_1000_S16 -32.768 32.767 STEP_SIZE 1
 /begin AXIS_DESCR FIX_AXIS NO_INPUT_QUANTITY NO_COMPU_METHOD 4 0 3 FIX_AXIS_PAR_DIST 0 1 4 /end AXIS_DESCR
/end CHARACTERISTIC
/begin CHARACTERISTIC CFastfillAdaptionIntegralCorrectionFactor_Map "Fastfill adaption seems more sensitive at higher RPM and lower temperature This lookup table is used to scale the correction factor It will adapt slower at high RPM and low temperature" MAP 1073874132 __SWord_Value 0 tFactor_1000_S16 -32.768 32.767 STEP_SIZE 1
 /begin AXIS_DESCR COM_AXIS NO_INPUT_QUANTITY tRevolutionPerMinute_S16 2 0 0 AXIS_PTS_REF CFastfillAdaptionIntegralCorrectionFactor_XSP /end AXIS_DESCR
 /begin AXIS_DESCR COM_AXIS NO_INPUT_QUANTITY tDegree_10_S16 3 0 0 AXIS_PTS_REF CFastfillAdaptionIntegralCorrectionFactor_YSP /end AXIS_DESCR
/end CHARACTERISTIC
/begin AXIS_PTS CFastfillAdaptionIntegralCorrectionFactor_XSP "X axis of lookup table" 1073874128 NO_INPUT_QUANTITY __SWord_Axis 0 tRevolutionPerMinute_S16 2 -32768 32767 STEP_SIZE 1 /end AXIS_PTS
/begin AXIS_PTS CFastfillAdaptionIntegralCorrectionFactor_YSP "X axis of lookup table" 1073874122 NO_INPUT_QUANTITY __SWord_Axis 0 tDegree_10_S16 3 -720.0 720.0 STEP_SIZE 1 /end AXIS_PTS
/begin CHARACTERISTIC CFastfillAdaptionMaxStepPos_Tab "Fastfill max step in adaption. Slow positive steps in low temperature" CURVE 1073874114 __SWord_Value 0 tPercent_100_S16 0.0 100.0 STEP_SIZE 1
 /begin AXIS_DESCR COM_AXIS NO_INPUT_QUANTITY tDegree_10_S16 2 0 0 AXIS_PTS_REF CFastfillAdaptionMaxStepPos_XSP /end AXIS_DESCR
/end CHARACTERISTIC
/begin AXIS_PTS CFastfillAdaptionMaxStepPos_XSP "Temperature points for above table" 1073874110 NO_INPUT_QUANTITY __SWord_Axis 0 tDegree_10_S16 2 -720.0 720.0 STEP_SIZE 1 /end AXIS_PTS
/begin CHARACTERISTIC CFastfillAdaptionAbortPressure_Tab "Fastfill sequence pressure limit to instantly floor CMD to prevent binding clutch" CURVE 1073874104 __SWord_Value 0 tBar_100_S16 -1.0 1000.0 STEP_SIZE 1
 /begin AXIS_DESCR COM_AXIS NO_INPUT_QUANTITY tDegree_10_S16 2 0 0 AXIS_PTS_REF CFastfillAdaptionAbortPressure_XSP /end AXIS_DESCR
/end CHARACTERISTIC
/begin AXIS_PTS CFastfillAdaptionAbortPressure_XSP "Fastfill sequence pressure limit to instantly floor CMD to prevent binding clutch XSP" 1073874100 NO_INPUT_QUANTITY __SWord_Axis 0 tDegree_10_S16 2 -720.0 720.0 STEP_SIZE 1 /end AXIS_PTS
/begin CHARACTERISTIC CFastfillHoldMaxFactor "Max allowed time in CLU_CTRL_FASTFILL_HOLD state before continuing" CURVE 1073874092 __SWord_Value 0 tFactor_1000_S16 -32.768 32.767 STEP_SIZE 1
 /begin AXIS_DESCR COM_AXIS NO_INPUT_QUANTITY tDegree_10_S16 2 0 0 AXIS_PTS_REF CFastfillHoldMaxFactor_YSP /end AXIS_DESCR
/end CHARACTERISTIC
/begin AXIS_PTS CFastfillHoldMaxFactor_YSP "YSP for CFastfillHoldMaxFactor" 1073874088 NO_INPUT_QUANTITY __SWord_Axis 0 tDegree_10_S16 2 -720.0 720.0 STEP_SIZE 1 /end AXIS_PTS
/begin CHARACTERISTIC CFastfillHoldTimeFactor_Tab "Duration of the hold part of the fastfill sequence compared to the length of the triangle shaped sequence Timer starts from the peak of pressure" CURVE 1073874078 __SWord_Value 0 tFactor_1000_S16 -32.768 32.767 STEP_SIZE 1
 /begin AXIS_DESCR COM_AXIS NO_INPUT_QUANTITY tDegree_10_S16 3 0 0 AXIS_PTS_REF CFastfillHoldTimeFactor_XSP /end AXIS_DESCR
/end CHARACTERISTIC
/begin AXIS_PTS CFastfillHoldTimeFactor_XSP "Fastfill sequence start pressure Gearbox temperature on vertical axis" 1073874072 NO_INPUT_QUANTITY __SWord_Axis 0 tDegree_10_S16 3 -720.0 720.0 STEP_SIZE 1 /end AXIS_PTS
/begin CHARACTERISTIC CCluFillTime_Map "Map for clutch fill time For all clutches Based on a curve fit I did on the old lookup table Result of curve fit: filltime(oiltemp) = 3800ms / (oiltemp + 19 deg C) + 10ms This means: At  1 deg C the fastfill time is 200ms ((3800/20 + 10) At 21 deg C the fastfill time is 105ms ((3800/40 + 10) At 81 deg C the fastfill time is  48ms ((3800/100 + 10) The function filltime vs oiltemp is likely different in each clutch And will likely change over the lifetime of the oil because the viscosity of the oil changes when the length of the polymer chains in the oil gets shorter and shorter when sheared apart during use 1B uses this formula: filltime(oiltemp) = 3500ms / (oiltemp + 19 deg C) + 10ms 1C uses this formula: filltime(oiltemp) = 3000ms / (oiltemp + 19 deg C) + 10ms" MAP 1073873912 __SWord_Value 0 tMillisecond_S16 0 3600000 STEP_SIZE 1
 /begin AXIS_DESCR COM_AXIS NO_INPUT_QUANTITY tDegree_10_S16 20 0 0 AXIS_PTS_REF CCluFillTime_XSP /end AXIS_DESCR
 /begin AXIS_DESCR FIX_AXIS NO_INPUT_QUANTITY NO_COMPU_METHOD 4 0 3 FIX_AXIS_PAR_DIST 0 1 4 /end AXIS_DESCR
/end CHARACTERISTIC
/begin AXIS_PTS CCluFillTime_XSP "XSP for clutch fill time (horisontal axis) Temperature points choosen to get a smooth transition between fastfill time deltas" 1073873872 NO_INPUT_QUANTITY __SWord_Axis 0 tDegree_10_S16 20 -720.0 720.0 STEP_SIZE 1 /end AXIS_PTS
/begin CHARACTERISTIC CCluTinyfillTime_Tab "Tinyfill time" CURVE 1073873868 __SWord_Value 0 tMillisecond_S16 0 3600000 STEP_SIZE 1
 /begin AXIS_DESCR COM_AXIS NO_INPUT_QUANTITY tDegree_10_S16 2 0 0 AXIS_PTS_REF CCluTinyfillTime_XSP /end AXIS_DESCR
/end CHARACTERISTIC
/begin AXIS_PTS CCluTinyfillTime_XSP "XSP for tinyfill time" 1073873864 NO_INPUT_QUANTITY __SWord_Axis 0 tDegree_10_S16 2 -720.0 720.0 STEP_SIZE 1 /end AXIS_PTS
/begin CHARACTERISTIC CCluTinyfillStrtpressure "Tinyfill for pressures below kiss" VALUE 1073873862 __SWord_Value 0 tBar_100_S16 -1.0 1000.0 STEP_SIZE 1 /end CHARACTERISTIC
/begin AXIS_PTS CCluFastFillTimeAdaption_XSP "Fastfill duration adaption temperature X axis" 1073873834 NO_INPUT_QUANTITY __SWord_Axis 0 tDegree_10_S16 14 -720.0 720.0 STEP_SIZE 1 /end AXIS_PTS
/begin CHARACTERISTIC CCluNotUsedTimeout "Timeout to consider that a clutch was not used recently" VALUE 1073873828 __ULong_Value 0 tMillisecond_U32 0 3600000 STEP_SIZE 1 /end CHARACTERISTIC
/begin CHARACTERISTIC CClutchPresAllowedInNeutralTime_Tab "Allowed time with pressure when in neutral or park. TODO lower as we get more confident in the calibration" CURVE 1073873796 __SWord_Value 0 tMillisecond_S16 0 3600000 STEP_SIZE 1
 /begin AXIS_DESCR COM_AXIS NO_INPUT_QUANTITY tCelsius_10_S16 2 0 0 AXIS_PTS_REF CClutchPresAllowedInNeutralTime_XSP /end AXIS_DESCR
/end CHARACTERISTIC
/begin AXIS_PTS CClutchPresAllowedInNeutralTime_XSP "Temperature XSP to CClutchPresAllowedInNeutralTime_Tab" 1073873792 NO_INPUT_QUANTITY __SWord_Axis 0 tCelsius_10_S16 2 -400.0 10000.0 STEP_SIZE 1 /end AXIS_PTS
/begin CHARACTERISTIC CCluFltTimeout "Wheel Clutch Fault Timeout [ms]" VALUE 1073873788 __ULong_Value 0 tMillisecond_U32 0 1000 STEP_SIZE 1 /end CHARACTERISTIC
/begin CHARACTERISTIC CCluPMaxDelta "Maximum pressure demand delta [bar/ms]" VALUE 1073873784 __SWord_Value 0 tBar_100_S16 -1.0 1000.0 STEP_SIZE 1 /end CHARACTERISTIC
/begin CHARACTERISTIC CCluDiscHeatCp "Heat capacity of all clutch discs [J/K]" VALUE 1073873776 __Float32_Value 0 tJoulePerKelvin -3.40282346639E+38 3.40282346639E+38 STEP_SIZE 1 /end CHARACTERISTIC
/begin CHARACTERISTIC CCluCoolgRate "" CURVE 1073873756 __Float32_Value 0 tFactor -3.40282346639E+38 3.40282346639E+38 STEP_SIZE 1
 /begin AXIS_DESCR FIX_AXIS NO_INPUT_QUANTITY NO_COMPU_METHOD 4 0 3 FIX_AXIS_PAR_DIST 0 1 4 /end AXIS_DESCR
/end CHARACTERISTIC
/begin CHARACTERISTIC CCluDragTab "Induced drag on clutches. PWTSW-8648" CURVE 1073873746 __SWord_Value 0 tNewtonMetre_S16 -32000 32000 STEP_SIZE 1
 /begin AXIS_DESCR COM_AXIS NO_INPUT_QUANTITY tRevolutionPerMinute_S16 5 0 0 AXIS_PTS_REF CCluDragXsp /end AXIS_DESCR
/end CHARACTERISTIC
/begin AXIS_PTS CCluDragXsp "Induced drag on clutches XSP" 1073873736 NO_INPUT_QUANTITY __SWord_Axis 0 tRevolutionPerMinute_S16 5 -32768 32767 STEP_SIZE 1 /end AXIS_PTS
/begin CHARACTERISTIC CCluTPeakTi "Time highest clutch temperature is held" VALUE 1073873732 __ULong_Value 0 tMillisecond_U32 0 3600000 STEP_SIZE 1 /end CHARACTERISTIC
/begin CHARACTERISTIC CCluTTqLim "Max clutch torque allowed based on estimated temperature" CURVE 1073873724 __Float32_Value 0 tNewtonMetre -100000 100000 STEP_SIZE 1
 /begin AXIS_DESCR FIX_AXIS NO_INPUT_QUANTITY NO_COMPU_METHOD 2 0 1 FIX_AXIS_PAR_DIST 0 1 2 /end AXIS_DESCR
/end CHARACTERISTIC
/begin AXIS_PTS CCluTTqLimYSP "YSP to CCluTTqLim" 1073873716 NO_INPUT_QUANTITY __Float32_Axis 0 tCelsius 2 -400 10000 STEP_SIZE 1 /end AXIS_PTS
/begin CHARACTERISTIC CTestWhlCluSlipClu "Clutches to slip Pressure request for slip in dyno [0] CLU_FL [1] CLU_FR [2] CLU_RL [3] CLU_RR" CURVE 1073873704 __UByte_Value 0 NO_COMPU_METHOD 0 1 STEP_SIZE 1 FORMAT "%.2"
 /begin AXIS_DESCR FIX_AXIS NO_INPUT_QUANTITY tCluIdx 4 0 3 FIX_AXIS_PAR_DIST 0 1 4 /end AXIS_DESCR
/end CHARACTERISTIC
/begin CHARACTERISTIC CTestWhlCluSlipCluP "Pressure request for slip in dyno [0] CLU_FL [1] CLU_FR [2] CLU_RL [3] CLU_RR" CURVE 1073873694 __SWord_Value 0 tBar_100_S16 -1.0 1000.0 STEP_SIZE 1
 /begin AXIS_DESCR FIX_AXIS NO_INPUT_QUANTITY tCluIdx 4 0 3 FIX_AXIS_PAR_DIST 0 1 4 /end AXIS_DESCR
/end CHARACTERISTIC
/begin CHARACTERISTIC CSlipCtrlrPGainTab "P-gain for clutch slip controller" CURVE 1073873652 __Float32_Value 0 tFactor -3.40282346639E+38 3.40282346639E+38 STEP_SIZE 0.01
 /begin AXIS_DESCR COM_AXIS NO_INPUT_QUANTITY tRevolutionPerMinute 10 0 0 AXIS_PTS_REF CSlipCtrlrGainYsp /end AXIS_DESCR
/end CHARACTERISTIC
/begin CHARACTERISTIC CSlipCtrlrIGainTab "I-gain for clutch slip controller" CURVE 1073873612 __Float32_Value 0 tFactor -3.40282346639E+38 3.40282346639E+38 STEP_SIZE 0.001
 /begin AXIS_DESCR COM_AXIS NO_INPUT_QUANTITY tRevolutionPerMinute 10 0 0 AXIS_PTS_REF CSlipCtrlrGainYsp /end AXIS_DESCR
/end CHARACTERISTIC
/begin CHARACTERISTIC CSlipCtrlrDGainTab "D-gain for clutch slip controller" CURVE 1073873572 __Float32_Value 0 tFactor -3.40282346639E+38 3.40282346639E+38 STEP_SIZE 0.001
 /begin AXIS_DESCR COM_AXIS NO_INPUT_QUANTITY tRevolutionPerMinute 10 0 0 AXIS_PTS_REF CSlipCtrlrGainYsp /end AXIS_DESCR
/end CHARACTERISTIC
/begin AXIS_PTS CSlipCtrlrGainYsp "Pressure request for slip in dyno" 1073873532 NO_INPUT_QUANTITY __Float32_Axis 0 tRevolutionPerMinute 10 -10000 10000 STEP_SIZE 1 /end AXIS_PTS
/begin CHARACTERISTIC CVeqTqFanReq "Fan % request for veqTorque cooling" CURVE 1073873512 __SWord_Value 0 NO_COMPU_METHOD -32768 32767 STEP_SIZE 1 FORMAT "%.0"
 /begin AXIS_DESCR COM_AXIS NO_INPUT_QUANTITY tDegree_10_S16 4 0 0 AXIS_PTS_REF CVeqTqFanReqXsp /end AXIS_DESCR
/end CHARACTERISTIC
/begin AXIS_PTS CVeqTqFanReqXsp "XSP to CVeqTqFanReq" 1073873504 NO_INPUT_QUANTITY __SWord_Axis 0 tDegree_10_S16 4 -720.0 720.0 STEP_SIZE 1 /end AXIS_PTS
/begin COMPU_METHOD tFactor "" IDENTICAL "%.6" "" /end COMPU_METHOD
/begin COMPU_METHOD tFactor_1000_S16 "" LINEAR "%.3" "-" COEFFS_LINEAR 0.001000 0 /end COMPU_METHOD
/begin COMPU_METHOD tPercent "" IDENTICAL "%.1" "%" /end COMPU_METHOD
/begin COMPU_METHOD tPercent_100_S16 "" LINEAR "%.2" "%" COEFFS_LINEAR 0.010000 0 /end COMPU_METHOD
/begin COMPU_METHOD tPercent_S8 "" IDENTICAL "%.0" "%" /end COMPU_METHOD
/begin COMPU_METHOD tPercent_S16 "" IDENTICAL "%.0" "%" /end COMPU_METHOD
/begin COMPU_METHOD tSecond "" IDENTICAL "%.3" "s" /end COMPU_METHOD
/begin COMPU_METHOD tHertz_10_S16 "" LINEAR "%.1" "Hz" COEFFS_LINEAR 0.100000 0 /end COMPU_METHOD
/begin COMPU_METHOD tMillisecond_S16 "" IDENTICAL "%.3" "ms" /end COMPU_METHOD
/begin COMPU_METHOD tMillisecond_U32 "" IDENTICAL "%.3" "ms" /end COMPU_METHOD
/begin COMPU_METHOD tMetre "" IDENTICAL "%.4" "m" /end COMPU_METHOD
/begin COMPU_METHOD tMillimetre_10_S16 "" LINEAR "%.1" "mm" COEFFS_LINEAR 0.100000 0 /end COMPU_METHOD
/begin COMPU_METHOD tKilometre "" IDENTICAL "%.3" "km" /end COMPU_METHOD
/begin COMPU_METHOD tMetrePerSecond "" IDENTICAL "%.3" "m/s" /end COMPU_METHOD
/begin COMPU_METHOD tMetrePerSecond_100_S16 "" LINEAR "%.2" "m/s" COEFFS_LINEAR 0.010000 0 /end COMPU_METHOD
/begin COMPU_METHOD tMetrePerSquareSecond_10_S16 "" LINEAR "%.1" "m/s^2" COEFFS_LINEAR 0.100000 0 /end COMPU_METHOD
/begin COMPU_METHOD tMillimetrePerSecond_S16 "" IDENTICAL "%.0" "mm/s" /end COMPU_METHOD
/begin COMPU_METHOD tKilometrePerHour "" IDENTICAL "%.3" "km/h" /end COMPU_METHOD
/begin COMPU_METHOD tKilometrePerHour_S16 "" IDENTICAL "%.0" "km/h" /end COMPU_METHOD
/begin COMPU_METHOD tKilometrePerHour_10_S16 "" LINEAR "%.1" "km/h" COEFFS_LINEAR 0.100000 0 /end COMPU_METHOD
/begin COMPU_METHOD tKilometrePerHour_10_S32 "" LINEAR "%.1" "km/h" COEFFS_LINEAR 0.100000 0 /end COMPU_METHOD
/begin COMPU_METHOD tMetrePerSquareSecond "" IDENTICAL "%.3" "m/s2" /end COMPU_METHOD
/begin COMPU_METHOD tRadian "" IDENTICAL "%.3" "rad" /end COMPU_METHOD
/begin COMPU_METHOD tDegree "" IDENTICAL "%.3" "deg" /end COMPU_METHOD
/begin COMPU_METHOD tDegree_10_S16 "" LINEAR "%.1" "deg" COEFFS_LINEAR 0.100000 0 /end COMPU_METHOD
/begin COMPU_METHOD tRadianPerSecond "" IDENTICAL "%.3" "rad/s" /end COMPU_METHOD
/begin COMPU_METHOD tRevolutionPerMinute "" IDENTICAL "%.3" "rpm" /end COMPU_METHOD
/begin COMPU_METHOD tRevolutionPerMinute_S16 "" IDENTICAL "%.0" "rpm" /end COMPU_METHOD
/begin COMPU_METHOD tRevolutionPerMinute_S32 "" IDENTICAL "%.0" "rpm" /end COMPU_METHOD
/begin COMPU_METHOD tKilogram_S16 "" IDENTICAL "%.0" "kg" /end COMPU_METHOD
/begin COMPU_METHOD tNewton_S16 "" IDENTICAL "%.0" "N" /end COMPU_METHOD
/begin COMPU_METHOD tKilonewton_100_S16 "" LINEAR "%.2" "kN" COEFFS_LINEAR 0.010000 0 /end COMPU_METHOD
/begin COMPU_METHOD tNewtonMetre "" IDENTICAL "%.3" "Nm" /end COMPU_METHOD
/begin COMPU_METHOD tNewtonMetre_100_S32 "" LINEAR "%.2" "Nm" COEFFS_LINEAR 0.010000 0 /end COMPU_METHOD
/begin COMPU_METHOD tNewtonMetre_S16 "" IDENTICAL "%.0" "Nm" /end COMPU_METHOD
/begin COMPU_METHOD tNewtonMetrePerBar "" IDENTICAL "%.2" "Nm/bar" /end COMPU_METHOD
/begin COMPU_METHOD tKilowatt "" IDENTICAL "%.3" "kW" /end COMPU_METHOD
/begin COMPU_METHOD tKilowatt_S16 "" IDENTICAL "%.0" "kW" /end COMPU_METHOD
/begin COMPU_METHOD tKilowattHour "" IDENTICAL "%.3" "kWh" /end COMPU_METHOD
/begin COMPU_METHOD tMegaJoule "" IDENTICAL "%.6" "MJ" /end COMPU_METHOD
/begin COMPU_METHOD tMegaJoule_U32 "" IDENTICAL "%.0" "MJ" /end COMPU_METHOD
/begin COMPU_METHOD tCelsius "" IDENTICAL "%.3" "C" /end COMPU_METHOD
/begin COMPU_METHOD tCelsius_10_S16 "" LINEAR "%.1" "C" COEFFS_LINEAR 0.100000 0 /end COMPU_METHOD
/begin COMPU_METHOD tCelsius_100_S16 "" LINEAR "%.2" "C" COEFFS_LINEAR 0.010000 0 /end COMPU_METHOD
/begin COMPU_METHOD tBar "" IDENTICAL "%.3" "bar" /end COMPU_METHOD
/begin COMPU_METHOD tBar_10_S16 "" LINEAR "%.1" "bar" COEFFS_LINEAR 0.100000 0 /end COMPU_METHOD
/begin COMPU_METHOD tBar_100_S16 "" LINEAR "%.2" "bar" COEFFS_LINEAR 0.010000 0 /end COMPU_METHOD
/begin COMPU_METHOD tBar_1000_S16 "" LINEAR "%.3" "bar" COEFFS_LINEAR 0.001000 0 /end COMPU_METHOD
/begin COMPU_METHOD tAmpere_100_S16 "" LINEAR "%.2" "A" COEFFS_LINEAR 0.010000 0 /end COMPU_METHOD
/begin COMPU_METHOD tNewtonMetrePerDegree_S16 "" IDENTICAL "%.0" "Nm/deg" /end COMPU_METHOD
/begin COMPU_METHOD tMillivolt_S16 "" IDENTICAL "%.0" "mV" /end COMPU_METHOD
/begin COMPU_METHOD tVolt "" IDENTICAL "%.3" "V" /end COMPU_METHOD
/begin COMPU_METHOD tJoulePerKelvin "" IDENTICAL "%.2" "J/K" /end COMPU_METHOD
/begin COMPU_METHOD tAscii "" IDENTICAL "%.0" "ascii" /end COMPU_METHOD
/begin COMPU_METHOD tQualifier "" TAB_VERB "%.0" "" COMPU_TAB_REF tQualifier /end COMPU_METHOD
/begin COMPU_METHOD tSign "" TAB_VERB "%.0" "" COMPU_TAB_REF tSign /end COMPU_METHOD
/begin COMPU_METHOD tCluIdx "" TAB_VERB "%.0" "" COMPU_TAB_REF tCluIdx /end COMPU_METHOD
/begin COMPU_METHOD tLowPassFilterType "" TAB_VERB "%.0" "" COMPU_TAB_REF tLowPassFilterType /end COMPU_METHOD
/begin COMPU_METHOD tPerformanceMode "" TAB_VERB "%.0" "" COMPU_TAB_REF tPerformanceMode /end COMPU_METHOD
/begin COMPU_METHOD tEnableState "" TAB_VERB "%.0" "" COMPU_TAB_REF tEnableState /end COMPU_METHOD
/begin COMPU_METHOD tEBrakeState "" TAB_VERB "%.0" "" COMPU_TAB_REF tEBrakeState /end COMPU_METHOD
/begin COMPU_METHOD tAutoHillHoldMode "" TAB_VERB "%.0" "" COMPU_TAB_REF tAutoHillHoldMode /end COMPU_METHOD
/begin COMPU_METHOD tAccDistanceLevel "" TAB_VERB "%.0" "" COMPU_TAB_REF tAccDistanceLevel /end COMPU_METHOD
/begin COMPU_METHOD tAutDrvrCtrlMstSwt "" TAB_VERB "%.0" "" COMPU_TAB_REF tAutDrvrCtrlMstSwt /end COMPU_METHOD
/begin COMPU_METHOD tTpmsWarnLampRsn "" TAB_VERB "%.0" "" COMPU_TAB_REF tTpmsWarnLampRsn /end COMPU_METHOD
/begin COMPU_METHOD tBrakeSwitchChoice "" TAB_VERB "%.0" "" COMPU_TAB_REF tBrakeSwitchChoice /end COMPU_METHOD
/begin COMPU_METHOD tCoolingFansPosition "" TAB_VERB "%.0" "" COMPU_TAB_REF tCoolingFansPosition /end COMPU_METHOD
/begin COMPU_METHOD tCoolingPumpsPosition "" TAB_VERB "%.0" "" COMPU_TAB_REF tCoolingPumpsPosition /end COMPU_METHOD
/begin COMPU_VTAB tQualifier "" TAB_VERB 4 0 "Q_NOT_INITIALIZED" 1 "Q_FAULTY" 2 "Q_NORMAL" 3 "Q_LOW_QUALITY" /end COMPU_VTAB
/begin COMPU_VTAB tSign "" TAB_VERB 2 -1 "SIGN_NEGATIVE" 0 "SIGN_ZERO" 1 "SIGN_POSITIVE" /end COMPU_VTAB
/begin COMPU_VTAB tCluIdx "" TAB_VERB 5 0 "CLU_FL" 1 "CLU_FR" 2 "CLU_RL" 3 "CLU_RR" 4 "NUM_OF_CLU" /end COMPU_VTAB
/begin COMPU_VTAB tLowPassFilterType "" TAB_VERB 2 0 "LPF_TYPE_O1_BUTTER" 1 "LPF_TYPE_O2_BUTTER" /end COMPU_VTAB
/begin COMPU_VTAB tPerformanceMode "" TAB_VERB 8 0 "PERF_MOD_UNKNOWN" 1 "PERF_MOD_GHOST_EV" 2 "PERF_MOD_COMFORT" 3 "PERF_MOD_WET_SNOW" 4 "PERF_MOD_SPORT" 5 "PERF_MOD_TRACK" 6 "PERF_MOD_INDIVIDUAL" 7 "NUM_OF_PERF_MOD" /end COMPU_VTAB
/begin COMPU_VTAB tEnableState "" TAB_VERB 4 0 "ENA_ST_UNKNOWN" 1 "ENA_ST_OFF" 2 "ENA_ST_ON" 3 "ENA_ST_FLT" /end COMPU_VTAB
/begin COMPU_VTAB tEBrakeState "" TAB_VERB 6 0 "E_BRAKE_SM_UNKNOWN" 1 "E_BRAKE_SM_ENGAGING" 2 "E_BRAKE_SM_ENGAGED" 3 "E_BRAKE_SM_DISENGAGING" 4 "E_BRAKE_SM_DISENGAGED" 5 "E_BRAKE_SM_FAULT" /end COMPU_VTAB
/begin COMPU_VTAB tAutoHillHoldMode "" TAB_VERB 5 0 "AHH_MOD_UKWN" 1 "AHH_MOD_DEACTVD" 2 "AHH_MOD_IEB_CTRL" 3 "AHH_MOD_GVCU_CTRL" 4 "AHH_MOD_IEB_GVCU_COMB" /end COMPU_VTAB
/begin COMPU_VTAB tAccDistanceLevel "" TAB_VERB 5 0 "ACC_DIST_LVL_UNKNOWN" 1 "ACC_DIST_LVL_0" 2 "ACC_DIST_LVL_1" 3 "ACC_DIST_LVL_2" 4 "ACC_DIST_LVL_3" /end COMPU_VTAB
/begin COMPU_VTAB tAutDrvrCtrlMstSwt "" TAB_VERB 4 0 "AUT_DRVR_MST_SWT_UKWN" 1 "AUT_DRVR_MST_SWT_OFF" 2 "AUT_DRVR_MST_SWT_ON" 3 "AUT_DRVR_MST_SWT_AUTO_START" /end COMPU_VTAB
/begin COMPU_VTAB tTpmsWarnLampRsn "" TAB_VERB 4 0 "TPMS_WARN_LAMP_REASON_UNKNOWN" 1 "TPMS_WARN_LAMP_REASON_NONE" 2 "TPMS_WARN_LAMP_REASON_MALFUNCTION" 3 "TPMS_WARN_LAMP_REASON_P_LOSS" /end COMPU_VTAB
/begin COMPU_VTAB tBrakeSwitchChoice "" TAB_VERB 3 0 "BRK_SWT_IEB" 1 "BRK_SWT_BRK_LI_SWT" 2 "BRK_SWT_BOTH" /end COMPU_VTAB
/begin COMPU_VTAB tCoolingFansPosition "" TAB_VERB 9 0 "FAN_POS_FRONT_RIGHT" 1 "FAN_POS_CENTER_RIGHT" 2 "FAN_POS_CENTER_LEFT" 3 "FAN_POS_FRONT_LEFT" 4 "FAN_POS_MIDDLE_RIGHT" 5 "FAN_POS_MIDDLE_LEFT" 6 "FAN_POS_REAR_RIGHT" 7 "FAN_POS_REAR_LEFT" 8 "FAN_POS_MAX" /end COMPU_VTAB
/begin COMPU_VTAB tCoolingPumpsPosition "" TAB_VERB 8 0 "PUMP_POS_INV" 1 "PUMP_POS_EMOTOR" 2 "PUMP_POS_HV_BAT1" 3 "PUMP_POS_HV_BAT2" 4 "PUMP_POS_HVAC_CIRCULATION" 5 "PUMP_POS_INTERCOOLER_RIGHT" 6 "PUMP_POS_INTERCOOLER_LEFT" 7 "PUMP_POS_MAX" /end COMPU_VTAB
/begin GROUP header_data ""
 /begin REF_MEASUREMENT flash_name flash_csum1 flash_csum2 flash_crc_size common_rev app_rev req_boot_rev req_appx_rev pre_build_rev post_build_rev app_tag_rev app_sha_rev app_dirty_rev sub_module1_rev sub_module2_rev sub_module3_rev sub_module4_rev sub_module5_rev sub_module6_rev sub_module7_rev sub_module8_rev sub_module9_rev sub_module10_rev sub_module11_rev sub_module12_rev sub_module13_rev sub_module14_rev sub_module15_rev sub_module16_rev /end REF_MEASUREMENT
/end GROUP
/begin GROUP adaption_PAR ""
 /begin SUB_GROUP adaption_AXIS_PTS adaption_CURVE adaption_MAP adaption_VALUE /end SUB_GROUP
/end GROUP
/begin GROUP adaption_AXIS_PTS "" /begin REF_CHARACTERISTIC /end REF_CHARACTERISTIC /end GROUP
/begin GROUP adaption_CURVE ""
 /begin REF_CHARACTERISTIC ACluKissPress ACluWearEgyRem ACluWearEgyStorg ADamprTrvlRatio ALastKwnVin ALiftCylEndstopsFL ALiftCylEndstopsFR ALiftCylEndstopsRL ALiftCylEndstopsRR APerfModIndUsrSeln AVsoSprgPackPreloadTrvl AVsoStatyWhlLoad AVsoWhlRdAdaption AWishboneAgEndstopsFL AWishboneAgEndstopsFR AWishboneAgEndstopsRL AWishboneAgEndstopsRR /end REF_CHARACTERISTIC
/end GROUP
/begin GROUP adaption_MAP ""
 /begin REF_CHARACTERISTIC APerfModRgnModUsrSeln AValveCMD_Map AVsoImuRotCalSnsr1 AVsoImuRotCalSnsr2 AVsoImuRotCalSnsr3 /end REF_CHARACTERISTIC
/end GROUP
/begin GROUP adaption_VALUE ""
 /begin REF_CHARACTERISTIC AEBrakeStMac AElecCnsCdIceOffLifetime AElecCnsCdIceOnLifetime AOdoVal ARideHeightLiftCalibDone ASlipringSteerAgOffset ATpmsWarnLampRsn AVsoImuAccelGainSnsr1 AVsoImuAccelGainSnsr2 AVsoImuAccelGainSnsr3 AVsoImuRotCalRqrd AWhlAlignmentDone /end REF_CHARACTERISTIC
/end GROUP
/begin GROUP caldata_PAR "" /begin SUB_GROUP caldata_AXIS_PTS caldata_CURVE caldata_MAP caldata_VALUE /end SUB_GROUP /end GROUP
/begin GROUP caldata_AXIS_PTS ""
 /begin REF_CHARACTERISTIC CAdpvCrsCtrlMaxSteerVelXsp CAdpvCrsCtrlRefAccelXsp CAdpvCrsCtrlReqVelErrXsp CAutDrvrCtrlRefVelErrXsp CAvasFanReqPercXsp CBatSoCPowerDemandXsp CCluDragXsp CCluFastFillTimeAdaption_XSP CCluFillTime_XSP CClutchPresAllowedInNeutralTime_XSP CCluTinyfillTime_XSP CCluTTqLimYSP CCooltSnsrAmphenolTXsp CCwa100PumpPowerXsp CCwa150PumpPowerXsp CDeplSocErrXsp CDitherAmplitude_XSP CDitherFrequency_XSP CDrvrRevIceSpdTarXsp CDrvrWhlTqReqGrdtLimXsp CDrvrWhlTqReqGrdtLimYsp CEcp80PumpPowerXsp CElecMotEffXsp CElecMotEffYsp CFanCmdMaxVsVehSpeedXsp CFastfillAdaptionAbortPressure_XSP CFastfillAdaptionIntegralCorrectionFactor_XSP CFastfillAdaptionIntegralCorrectionFactor_YSP CFastfillAdaptionMaxStepPos_XSP CFastfillHoldMaxFactor_YSP CFastfillHoldTimeFactor_XSP CFeedforwardInertiaGain_XSP CFic10FanPowerXsp CFic11FanPowerXsp CHvBattVocXsp CHybIceSpdXsp CIceSpdTarYsp CInvFanReqXsp CInvFanReqYsp CInvPumpReqXsp CInvPumpReqYsp CMotFanReqXsp CMotFanReqYsp CMotPumpReqXsp CMotPumpReqYsp CNmPerBarTFacXsp CPID_coeff_P_XSP CPID_coeff_temperature_XSP CPwrReqYsp CRideHeiRollCompXsp CSlipCtrlrGainYsp CSpdLimDeltaActvnVelXsp CStatyCrkTrsmOilTXsp CStatyRecupBrkWhlTqXsp CSuspMtnRatFrntTabXsp CSuspMtnRatReTabXsp CSustSocErrXsp CSyncCluRateSlipXsp CTempSnsrNtcJumoXsp CTpmsSpdLimMinTirePFrntNormXsp CTpmsSpdLimMinTirePFrntPerformanceXsp CTpmsSpdLimMinTirePReNormXsp CTpmsSpdLimMinTirePRePerformanceXsp CTpmsWarnLampTirePXsp CTqToPTranslateXSP CTracCtrlDiffXsp CTracCtrlXsp CTracCtrlYsp CTrsmGearXsp CTrsmOilTXsp CValveCMD_XSP CValveCMDToCurrent_XSP CValveHysteresisCorrection_XSP CVehVelActvSysXsp CVeqTqFanReqXsp CVsoDsoObsvrGainMatrixXsp CVsoDtLossRotSpdYsp CVsoDtLossTempXsp CVsoFrntAntiXSP CVsoFrntDamperMapXSP CVsoFrntDamperMapYSP CVsoFrntWhlArbXSP CVsoReAntiXSP CVsoReDamperMapXSP CVsoReDamperMapYSP CVsoReWhlArbXSP CVsoTireMdlRoad2TireFricCoeffXsp CVsoTireRadNormalLoadTabXSP CVsoVehMassFuelTabXSP CVsoWhlAgFrntMapXSP CVsoWhlAgFrntSteerXSP CVsoWhlAgReMapXSP CVsoWhlTqBrkHeatDissaptionXSP CVsoWhlTqFrntBrkFrictionXSP CVsoWhlTqReBrkFrictionXSP CWhlCluEngdSftyFacXSP CWhlCluEngdSftyFacYSP CWhlCluIdx_YSP CWhlTqTotLimLowrLatAccXsp CYawRefGenNormLoadDeratingFacFrntXsp CYawRefGenNormLoadDeratingFacReXsp CYtrYawTqFfwReqXsp CYtrYawTqFfwReqYsp /end REF_CHARACTERISTIC
/end GROUP
/begin GROUP caldata_CURVE ""
 /begin REF_CHARACTERISTIC CAdpvCrsCtrlGrdtVelErrLowrTab CAdpvCrsCtrlGrdtVelErrUpprTab CAdpvCrsCtrlMaxAlwdSteerAbsTab CAdpvCrsCtrlRefJerkLimAbsTab CAutDrvrCtrlAllwdPerfMod CAutDrvrCtrlRefAccelMaxTab CAutDrvrCtrlRefAccelMinTab CAuxOdoCntPerRev CAvasFanFrntReqPercTab CAvasFanReReqPercTab CBatSoCPowerDemandTab CCluCoolgRate CCluDragTab CClutchPresAllowedInNeutralTime_Tab CCluTinyfillTime_Tab CCluTTqLim CCMDAllowedDeviation CCMDDefault_Tab CCooltSnsrAmphenolTTab CCwa100PumpPowerYsp CCwa150PumpPowerYsp CDepltEgyMgrPidimeHrznTab CDrvrWhlTqPedlMapEngDragCompPoly CDrvrWhlTqPedlMapSpdLim CEcp80PumpPowerYsp CEmotPumpSpdPerfMod CFanCmdMaxVsVehSpeedYsp CFanDiagEnbl CFanMinCommand CFanPriorities CFastfillAdaptionAbortPressure_Tab CFastfillAdaptionIntegralCorrectionFactor CFastfillAdaptionMaxStepPos_Tab CFastfillHoldMaxFactor CFastfillHoldTimeFactor_Tab CFastfillSpdComp CFeedforwardInertiaGain_Tab CFic10FanPowerYsp CFic11FanPowerYsp CHndlgAttdModSelnOrder CHvBattVocTab CHybDriveIceSpdTab CHybIdleIceSpdTab CInvPumpSpdPerfMod CLiftCylRng CMaxCluPressure CNmPerBarTFac CPerfModCptSwtReqEna CPerfModReqSelnOrder CPID_Lim_tab CPropshCrkRunngSpdErrThresTab CPropshCrkRunngStCntTab CPropshRateCtrlTqReqIceRunngDetnThdTab CPropshTqForCrkIniBumpTab CPumpDiagEnbl CPumpMinCommand CPumpPriorities CRatGbx CRideHeiReqHighPosnFrntTab CRideHeiReqHighPosnReTab CRideHeiReqLowPosnFrntTab CRideHeiReqLowPosnReTab CRideHeiReqMedPosnFrntTab CRideHeiReqMedPosnReTab CRideHeiRollCompFrntInnerTab CRideHeiRollCompFrntOuterTab CRideHeiRollCompReInnerTab CRideHeiRollCompReOuterTab CSlipCtrlrDGainTab CSlipCtrlrIGainTab CSlipCtrlrPGainTab CSpdLimDeltaActvnVelTab CSpdLimDeltaDeactvnVelTab CSpdLimPerfModArr CSpdSnsrCluManShutoff CSpdSnsrRearSign CStatyCrkPropshSpdOffsTab CStatyRecupBrkWhlTqLim CSuspMtnRatFrntTab CSuspMtnRatReTab CSustEgyMgrPidTimeHrznTab CSyncCluRateSlipTab CTempSnsrNtcJumoTab CTestAutoHillHoldBrkPReqVal CTestWhlCluPressDmd CTestWhlCluSlipClu CTestWhlCluSlipCluP CTireMaxLgtF CTpmsSpdLimMaxSpdFrntNormTab CTpmsSpdLimMaxSpdFrntPerformanceTab CTpmsSpdLimMaxSpdReNormTab CTpmsSpdLimMaxSpdRePerformanceTab CTpmsWarnLampTirePFrntTab CTpmsWarnLampTirePReTab CTqToPTranslateTab CTracCtrlPropn CValveCMDToCurrent_Tab CValveHysteresis CValveHysteresisCorrectionDown_Tab CValveHysteresisCorrectionUp_Tab CVeqTqFanReq CVsoCoastDwnDrgPolyCoeff CVsoCogPosn CVsoDsoObsvrGainMatrixL00 CVsoDsoObsvrGainMatrixL01 CVsoDsoObsvrGainMatrixL10 CVsoDsoObsvrGainMatrixL11 CVsoFrntBrkAntiXAngle CVsoFrntDrvAntiXAngle CVsoFrntRollAxisHeight CVsoFrntWhlArbStiffness CVsoHelperSprgStfn CVsoHelperSprgTrvlRng CVsoImuCogAccelFiltCutoffFreq CVsoImuCogGyroFiltCutoffFreq CVsoImuOffsVectSnsr1 CVsoImuOffsVectSnsr2 CVsoImuOffsVectSnsr3 CVsoImuSnsrQOverride CVsoMainSprgStfn CVsoMainSprgTrvlRng CVsoReBrkAntiXAngle CVsoReDrvAntiXAngle CVsoReRollAxisHeight CVsoReWhlArbStiffness CVsoTireMdlPrmFrnt CVsoTireMdlPrmRe CVsoTireMdlRoad2TireFricCoeffLatYsp CVsoTireMdlRoad2TireFricCoeffLgtYsp CVsoTireRadFrntAlpinNormLoadTab CVsoTireRadFrntCup2NormLoadTab CVsoTireRadFrntCup2RNormLoadTab CVsoTireRadReAlpinNormLoadTab CVsoTireRadReCup2NormLoadTab CVsoTireRadReCup2RNormLoadTab CVsoVehMassFuelTab CVsoWhlAgFrntSteerTab CVsoWhlAgFrntTab CVsoWhlAgReTab CVsoWhlLoadCptEna CVsoWhlTqFrntBrkFrictionTab CVsoWhlTqFrntBrkHeatDissaptionCoeff CVsoWhlTqRearBrkHeatDissaptionCoeff CVsoWhlTqReBrkFrictionTab CWhlCluReqEna CWhlTqTotLimLowLatAccTab CWhlTrvlRngFrnt CWhlTrvlRngRe CYawRefGenNormLoadDeratingFacFrntYsp CYawRefGenNormLoadDeratingFacReYsp /end REF_CHARACTERISTIC
/end GROUP
/begin GROUP caldata_MAP ""
 /begin REF_CHARACTERISTIC CCluFillTime_Map CDeplEgyMgrPidKdTab CDeplEgyMgrPidKiTab CDeplEgyMgrPidKpTab CDitherAmplitude_Map CDitherFrequency_Map CDrvrWhlTqReqGrdtLimLowrMap CDrvrWhlTqReqGrdtLimUpprMap CElecMotEffTab CFastfillAdaptionIntegralCorrectionFactor_Map CPID_coeff_D_Map CPID_coeff_I_Map CPID_coeff_P_Cold_Map CPID_coeff_P_Hot_Map CPropshRateCtrlFfStatyCrkMap CPropshRateCtrlGainSetCenCluDisegElecFwd CPropshRateCtrlGainSetCenCluDisegIceRwd CPropshRateCtrlGainSetCenCluEg CSustEgyMgrKdTab CSustEgyMgrKiTab CSustEgyMgrKpTab CTireMaxLgtSlipOffsFrntAggsvMap CTireMaxLgtSlipOffsFrntSafeMap CTireMaxLgtSlipOffsReAggsvMap CTireMaxLgtSlipOffsReSafeMap CTracCtrlWhlTqLimSlipDiffFrntAggsvMap CTracCtrlWhlTqLimSlipDiffFrntSafeMap CTracCtrlWhlTqLimSlipDiffReAggsvMap CTracCtrlWhlTqLimSlipDiffReSafeMap CVsoFrntDamperCmpnMap CVsoFrntDamperRbdMap CVsoFrntDtLossPropshTqMap CVsoImuRotMatrixSnsr1 CVsoImuRotMatrixSnsr2 CVsoImuRotMatrixSnsr3 CVsoRearDtLossPropshTqMap CVsoReDamperCmpnMap CVsoReDamperRbdMap CWhlCluEngdSftyFacMap CYtrYawTqFfwReqMap /end REF_CHARACTERISTIC
/end GROUP
/begin GROUP caldata_VALUE ""
 /begin REF_CHARACTERISTIC CAdpvCrsCtrlActrReqTolr CAdpvCrsCtrlAlwdBrkPerc CAdpvCrsCtrlBtnDebPerd CAdpvCrsCtrlBtnLongPsdPerd CAdpvCrsCtrlDftActvToFolCtrl CAdpvCrsCtrlDftDistLvl CAdpvCrsCtrlDistLvl0ToVelCtrlEna CAdpvCrsCtrlEnaIntgtrInin CAdpvCrsCtrlEnaOvrdIntgtrReset CAdpvCrsCtrlEnaTranFromActvToStbyIntgtrFreeze CAdpvCrsCtrlEnaTranFromOvrdToActvIntgtrRst CAdpvCrsCtrlErrStResetWaitPerd CAdpvCrsCtrlFbCtrlrEna CAdpvCrsCtrlFbWhlTqReqMax CAdpvCrsCtrlFbWhlTqReqMin CAdpvCrsCtrlFfCtrlrEna CAdpvCrsCtrlFfWhlTqReqMax CAdpvCrsCtrlFfWhlTqReqMin CAdpvCrsCtrlFolCtrlAllwdMaskOvrd CAdpvCrsCtrlFolCtrlAlwdRefVelMax CAdpvCrsCtrlGainD CAdpvCrsCtrlGainI CAdpvCrsCtrlGainP CAdpvCrsCtrlGoReqAccrPedlPercThd CAdpvCrsCtrlIntglWhlTqMax CAdpvCrsCtrlIntglWhlTqMin CAdpvCrsCtrlLongestScrollPosnDelta CAdpvCrsCtrlLongestScrollSetVelInc CAdpvCrsCtrlLongScrollPosnDelta CAdpvCrsCtrlLongScrollSetVelInc CAdpvCrsCtrlNotAllwdHoldTime CAdpvCrsCtrlOvrdInhbPerd CAdpvCrsCtrlRefAccelLimLowr CAdpvCrsCtrlRefAccelLimUppr CAdpvCrsCtrlRefVelGrdtLimLowr CAdpvCrsCtrlRefVelGrdtLimUppr CAdpvCrsCtrlRefVelGrdtWetLimLowr CAdpvCrsCtrlRefVelGrdtWetLimUppr CAdpvCrsCtrlScrollBtnPosnDeltaMin CAdpvCrsCtrlScrollBtnPosnStatyPerd CAdpvCrsCtrlSetVelDisIncEna CAdpvCrsCtrlSetVelGrdtDecFiltCoeff CAdpvCrsCtrlSetVelGrdtIncFiltCoeff CAdpvCrsCtrlSetVelPropIncMax CAdpvCrsCtrlSetVelPropIncMin CAdpvCrsCtrlSetVelPropIncStep CAdpvCrsCtrlSetVelResl CAdpvCrsCtrlShoScrollSetVelInc CAdpvCrsCtrlStandgActvPerd CAdpvCrsCtrlStandgActvStTranVehVel CAdpvCrsCtrlStandgActvTakeOffReqPerd CAdpvCrsCtrlStateDropMaskRsnTime CAdpvCrsCtrlStbyAllwdMaskOvrd CAdpvCrsCtrlTotWhlTqReqMax CAdpvCrsCtrlTotWhlTqReqMin CAdpvCrsCtrlVehVelTol CAdpvCrsCtrlVelCtrlAllwdMaskOvrd CAdpvCrsCtrlVelCtrlAlwdRefVelMax CAdpvCrsCtrlVelCtrlAlwdRefVelMin CAdpvCrsCtrlVelCtrlEnaDfdFil CAdpvCrsCtrlVelErrDerivDecFiltCoeff CAdpvCrsCtrlVelErrDerivIncFiltCoeff CAdpvCrsCtrlWhlTqReqDecFiltCoeff CAdpvCrsCtrlWhlTqReqFilEna CAdpvCrsCtrlWhlTqReqFilType CAdpvCrsCtrlWhlTqReqIncFiltCoeff CAdpvCrsCtrlZeroVehVelEna CAsfEnaBrake CAsfEnaDamper CAsfEnaHydraulicPress CAsfEnaImu CAsfEnaRideHeight CAsfEnaSteering CAsfEnaTpms CAsfEnaVehicleSpeed CAsfStartupDelay CAutDrvrCtrlAllwManModShift CAutDrvrCtrlEnaIntgtrInin CAutDrvrCtrlFbCtrlrEna CAutDrvrCtrlFbWhlTqReqMax CAutDrvrCtrlFbWhlTqReqMin CAutDrvrCtrlFfCtrlrEna CAutDrvrCtrlFfTqCmpRefVel CAutDrvrCtrlFfWhlTqReqMax CAutDrvrCtrlFfWhlTqReqMin CAutDrvrCtrlGainD CAutDrvrCtrlGainI CAutDrvrCtrlGainP CAutDrvrCtrlIntglWhlTqMax CAutDrvrCtrlIntglWhlTqMin CAutDrvrCtrlMaskOvrd CAutDrvrCtrlMstSwt CAutDrvrCtrlOvrdStFbCtrlrRstEna CAutDrvrCtrlRdyNotAllwdHoldPerd CAutDrvrCtrlRefAccelFiltEna CAutDrvrCtrlSetVelGrdtFiltCoeff CAutDrvrCtrlShutdwnStFbCtrlrEna CAutDrvrCtrlStatySpd CAutDrvrCtrlStatyTq CAutDrvrCtrlStOvrdIntgtrRstEna CAutDrvrCtrlTarAccelFromCycEna CAutDrvrCtrlTarAccelMax CAutDrvrCtrlTarAccelMin CAutDrvrCtrlTarVelFiltCoeff CAutDrvrCtrlTarVelFiltEna CAutDrvrCtrlTarVelMax CAutDrvrCtrlTarVelMin CAutDrvrCtrlTotWhlTqReqMax CAutDrvrCtrlTotWhlTqReqMin CAutDrvrCtrlVelErrDerivDecFiltCoeff CAutDrvrCtrlVelErrDerivIncFiltCoeff CAutDrvrCtrlWhlTqReqFilEna CAutDrvrCtrlWhlTqReqFiltCoeff CAutDrvrCtrlWhlTqReqFilType CAutDrvrDrvModReqHoldPerd CAutoHillHoldActvBrkPedlPercStep CAutoHillHoldAddlBrkPRollgStep CAutoHillHoldBrkCoeffMin CAutoHillHoldBrkPedlPercMax CAutoHillHoldBrkPedlPercMin CAutoHillHoldDrvgWhlTqEna CAutoHillHoldDrvgWhlTqMin CAutoHillHoldDrvModNeutralStCtrl CAutoHillHoldIebCtrlPrkgBrkEngdDurgHoldP CAutoHillHoldMod CAutoHillHoldPrkgBrkReqEna CAutoHillHoldPrkgBrkReqWaitPerd CAutoHillHoldRoadGrdtMinStartRollg CAutoHillHoldRoadGrdtMinStartRollgHyst CAutoHillHoldStatyBrkAbsTqMax CAutoHillHoldStatyBrkPMin CAutoHillHoldStOffVehVelHyst CAutoHillHoldStOffVehVelThd CAutoHillHoldTakeoffWhlTqHyst CAutoHillHoldTarBrkPGrdtMax CAutoHillHoldTarBrkPGrdtMin CAutoModeReturnLim CAuxBrkLiDecelAccActvnThres CAuxBrkLiDecelAccDeactvnThres CAuxBrkLiDecelTiMinActv CAuxBrkLiEssAccActvnThres CAuxBrkLiEssAccDeactvnThres CAuxBrkLiEssVehSpdThres CAvasFanStbyReqEna CAvasFanStbyReqPerc CAvasFanStbyVehVelThd CAvasVehVelThd CBmsTqLimMax CCenCluSyncErrThres CCenCluSyncStTi CChargedHighPressure CChargingMaxSoC CCluDiscHeatCp CCluEngdTqMin CCluFltTimeout CCluMinSlipLimit CCluNotUsedTimeout CCluPMaxDelta CCluSTEngdPressErrorThres CCluTinyfillStrtpressure CCluTPeakTi CCMDFloorOffset CCMDFloorOffsetDownRamp CCoastAccThr CCoastPwrReqThr CCoastSpdThr CCwa100PumpMaxSpd CCwa150PumpMaxSpd CCycleRideMoveDuration CDamprTrvlFullBumpFrnt CDamprTrvlFullBumpRe CDamprTrvlLiftDwnFrnt CDamprTrvlLiftDwnRe CDcdcPeakPower CDefaultEngineFanSpeed CDefaultEnginePumpSpeed CDefaultInvFanSpeed CDefaultInvPumpSpeed CDefaultLsttFanSpeed CDefaultMotFanSpeed CDefaultMotPumpSpeed CDeltaDemandHigh CDeltaDemandLow CDeltaSocHyst CDeltaSocThrUnfreeze CDeplEgyMgrPidGainBlend CDeplEgyMgrPidKd CDeplEgyMgrPidKi CDeplEgyMgrPidKp CDeratingLevel1CutStep CDeratingLevel2CutStep CDeratingLevel3CutStep CDeratingLevel4CutStep CDeratingLevelMax CDisableAutoMod CDischargedHighPressure CDisengageLowLimit CDitherAmplitudePlateauDownslopeScale CDitherPeakHold CDitherUpslopeHyst CDrvCfgSelnTime CDrvModParkNeutralIgnOffEna CDrvrAccrPedlPercMax CDrvrBrkPedlPercBasBto CDrvrBrkPedlPercTrackBto CDrvrBrkSwtChoice CDrvrModReqSteerWhlKnobRollovrEna CDrvrModReqSteerWhlKnobStep CDrvrWhlTqBasLimBto CDrvrWhlTqPedlMapElecPeak CDrvrWhlTqPedlMapEngDragCompEna CDrvrWhlTqPedlMapNormPeak CDrvrWhlTqPedlMapRegenHigh CDrvrWhlTqPedlMapRegenLow CDrvrWhlTqPedlMapRegenMid CDrvrWhlTqPedlMapRegenRampInRate CDrvrWhlTqPedlMapRespvPeak CDrvrWhlTqPedlMapSlugPeak CDrvrWhlTqPedlMapSpdLimRampLowr CDrvrWhlTqPedlMapSpdLimRampUppr CDrvrWhlTqPedlMapSpdPedCoeff CDrvrWhlTqPedlMapTireRd CDrvrWhlTqReqBtoTranGrdtLimLowr CDrvrWhlTqReqBtoTranGrdtLimUppr CDrvrWhlTqReqFiltCoeff CDrvrWhlTqReqTranGrdtLimLowr CDrvrWhlTqReqTranGrdtLimUppr CDrvrWhlTqReqValLimLowr CDrvrWhlTqReqValLimRvsLowr CDrvrWhlTqReqValLimRvsUppr CDrvrWhlTqReqValLimUppr CDrvrWhlTqTrackLimBto CEBrakeAbsoluteMaxLimit CEBrakeBlankingTimeNeg CEBrakeBlankingTimePos CEBrakeCalibrationDeadTime CEBrakeCalibrationUnclampTime CEBrakeDeadPeriod CEBrakeDisengageTime CEBrakeDisengageTimeService CEBrakeEngageTime CEBrakeOLThres /end REF_CHARACTERISTIC
/end GROUP
/end MODULE
/end PROJECT
