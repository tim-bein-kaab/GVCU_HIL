ASAP2_VERSION 1 71
/begin PROJECT GEMERA ""
/begin MODULE GVCU ""
/begin MOD_COMMON "" BYTE_ORDER MSB_FIRST ALIGNMENT_BYTE 1 ALIGNMENT_WORD 2 ALIGNMENT_LONG 4 ALIGNMENT_FLOAT16_IEEE 2 ALIGNMENT_FLOAT32_IEEE 4 ALIGNMENT_FLOAT64_IEEE 8 ALIGNMENT_INT64 8 /end MOD_COMMON
/begin RECORD_LAYOUT __Float32_Value FNC_VALUES 1 FLOAT32_IEEE ROW_DIR DIRECT /end RECORD_LAYOUT
/begin RECORD_LAYOUT __SByte_Value FNC_VALUES 1 SBYTE ROW_DIR DIRECT /end RECORD_LAYOUT
/begin RECORD_LAYOUT __UByte_Value FNC_VALUES 1 UBYTE ROW_DIR DIRECT /end RECORD_LAYOUT
/begin RECORD_LAYOUT __SLong_Value FNC_VALUES 1 SLONG ROW_DIR DIRECT /end RECORD_LAYOUT
/begin RECORD_LAYOUT __ULong_Value FNC_VALUES 1 ULONG ROW_DIR DIRECT /end RECORD_LAYOUT
/begin RECORD_LAYOUT __SWord_Value FNC_VALUES 1 SWORD ROW_DIR DIRECT /end RECORD_LAYOUT
/begin RECORD_LAYOUT __UWord_Value FNC_VALUES 1 UWORD ROW_DIR DIRECT /end RECORD_LAYOUT
/begin TYPEDEF_MEASUREMENT tBar_10_S16 "" SWORD tBar_10_S16 0 0 -1.0 1000.0 /end TYPEDEF_MEASUREMENT
/begin TYPEDEF_MEASUREMENT tGear "" ULONG tGear 0 0 0 10 /end TYPEDEF_MEASUREMENT
/begin TYPEDEF_MEASUREMENT tAmpereHour "" FLOAT32_IEEE tAmpereHour 0 0 0 1000 /end TYPEDEF_MEASUREMENT
/begin TYPEDEF_MEASUREMENT tRadianPerSecond "" FLOAT32_IEEE tRadianPerSecond 0 0 -1000 1000 /end TYPEDEF_MEASUREMENT
/begin TYPEDEF_MEASUREMENT tPercent_S8 "" SBYTE tPercent_S8 0 0 0 100 /end TYPEDEF_MEASUREMENT
/begin TYPEDEF_MEASUREMENT tDegree_10_S16 "" SWORD tDegree_10_S16 0 0 -720.0 720.0 /end TYPEDEF_MEASUREMENT
/begin TYPEDEF_MEASUREMENT tPercent "" FLOAT32_IEEE tPercent 0 0 0 100 /end TYPEDEF_MEASUREMENT
/begin TYPEDEF_MEASUREMENT tPerformanceModeEPS "" ULONG tPerformanceModeEPS 0 0 0 3 /end TYPEDEF_MEASUREMENT
/begin TYPEDEF_MEASUREMENT tPerformanceModeSpeedLimiter "" ULONG tPerformanceModeSpeedLimiter 0 0 0 6 /end TYPEDEF_MEASUREMENT
/begin TYPEDEF_MEASUREMENT tMillimetre_10_S16 "" SWORD tMillimetre_10_S16 0 0 -1000.0 1000.0 /end TYPEDEF_MEASUREMENT
/begin TYPEDEF_MEASUREMENT tPropulsionMode "" ULONG tPropulsionMode 0 0 0 4 /end TYPEDEF_MEASUREMENT
/begin TYPEDEF_MEASUREMENT tNewtonMetre "" FLOAT32_IEEE tNewtonMetre 0 0 -100000 100000 /end TYPEDEF_MEASUREMENT
/begin TYPEDEF_MEASUREMENT tPropshaftDrivingCrankState "" ULONG tPropshaftDrivingCrankState 0 0 0 3 /end TYPEDEF_MEASUREMENT
/begin TYPEDEF_MEASUREMENT tAutoHillHoldState "" ULONG tAutoHillHoldState 0 0 0 7 /end TYPEDEF_MEASUREMENT
/begin TYPEDEF_MEASUREMENT tBar "" FLOAT32_IEEE tBar 0 0 -1 1000 /end TYPEDEF_MEASUREMENT
/begin TYPEDEF_MEASUREMENT tSign "" SLONG tSign 0 0 -1 1 /end TYPEDEF_MEASUREMENT
/begin TYPEDEF_MEASUREMENT tPanelStatus "" ULONG tPanelStatus 0 0 0 6 /end TYPEDEF_MEASUREMENT
/begin TYPEDEF_MEASUREMENT tMillivolt_S32 "" SLONG tMillivolt_S32 0 0 0 1000000 /end TYPEDEF_MEASUREMENT
/begin TYPEDEF_MEASUREMENT tDegree "" FLOAT32_IEEE tDegree 0 0 -720 720 /end TYPEDEF_MEASUREMENT
/begin TYPEDEF_MEASUREMENT tPerformanceModeVDC "" ULONG tPerformanceModeVDC 0 0 0 4 /end TYPEDEF_MEASUREMENT
/begin TYPEDEF_MEASUREMENT tAccDistanceLevel "" ULONG tAccDistanceLevel 0 0 0 4 /end TYPEDEF_MEASUREMENT
/begin TYPEDEF_MEASUREMENT tPercent_100_S32 "" SLONG tPercent_100_S32 0 0 0.0 100.0 /end TYPEDEF_MEASUREMENT
/begin TYPEDEF_MEASUREMENT tImmobilizerState "" ULONG tImmobilizerState 0 0 0 2 /end TYPEDEF_MEASUREMENT
/begin TYPEDEF_MEASUREMENT tFraction "" FLOAT32_IEEE tFraction 0 0 0 1 /end TYPEDEF_MEASUREMENT
/begin TYPEDEF_MEASUREMENT tAdaptiveCruiseControlStateRequest "" ULONG tAdaptiveCruiseControlStateRequest 0 0 0 4 /end TYPEDEF_MEASUREMENT
/begin TYPEDEF_MEASUREMENT tTractionControlMode "" ULONG tTractionControlMode 0 0 0 6 /end TYPEDEF_MEASUREMENT
/begin TYPEDEF_MEASUREMENT tOhm "" FLOAT32_IEEE tOhm 0 0 0 2000000 /end TYPEDEF_MEASUREMENT
/begin TYPEDEF_MEASUREMENT tMetreSquared "" FLOAT32_IEEE tMetreSquared 0 0 0 10 /end TYPEDEF_MEASUREMENT
/begin TYPEDEF_MEASUREMENT tBar_100_S16 "" SWORD tBar_100_S16 0 0 -1.0 1000.0 /end TYPEDEF_MEASUREMENT
/begin TYPEDEF_MEASUREMENT tLowPassFilterType "" ULONG tLowPassFilterType 0 0 0 1 /end TYPEDEF_MEASUREMENT
/begin TYPEDEF_MEASUREMENT tHandlingAttitudeMode "" ULONG tHandlingAttitudeMode 0 0 0 7 /end TYPEDEF_MEASUREMENT
/begin TYPEDEF_MEASUREMENT tEnableState "" ULONG tEnableState 0 0 0 3 /end TYPEDEF_MEASUREMENT
/begin TYPEDEF_MEASUREMENT tPedalMapMode "" ULONG tPedalMapMode 0 0 0 6 /end TYPEDEF_MEASUREMENT
/begin TYPEDEF_MEASUREMENT tParkingBrakeRequest "" ULONG tParkingBrakeRequest 0 0 0 2 /end TYPEDEF_MEASUREMENT
/begin TYPEDEF_MEASUREMENT tPerformanceModeDDC "" ULONG tPerformanceModeDDC 0 0 0 6 /end TYPEDEF_MEASUREMENT
/begin TYPEDEF_MEASUREMENT tPerformanceModeRHC "" ULONG tPerformanceModeRHC 0 0 0 3 /end TYPEDEF_MEASUREMENT
/begin TYPEDEF_MEASUREMENT tFactor_1000_S16 "" SWORD tFactor_1000_S16 0 0 -32.768 32.767 /end TYPEDEF_MEASUREMENT
/begin TYPEDEF_MEASUREMENT tVolt "" FLOAT32_IEEE tVolt 0 0 0 1000 /end TYPEDEF_MEASUREMENT
/begin TYPEDEF_MEASUREMENT tLaunchControlMode "" ULONG tLaunchControlMode 0 0 0 3 /end TYPEDEF_MEASUREMENT
/begin TYPEDEF_MEASUREMENT tPowerState "" ULONG tPowerState 0 0 0 15 /end TYPEDEF_MEASUREMENT
/begin TYPEDEF_MEASUREMENT tPerformanceModeTPMS "" ULONG tPerformanceModeTPMS 0 0 0 2 /end TYPEDEF_MEASUREMENT
/begin TYPEDEF_MEASUREMENT tChangeModeEnableIEB "" ULONG tChangeModeEnableIEB 0 0 0 2 /end TYPEDEF_MEASUREMENT
/begin TYPEDEF_MEASUREMENT tPaddleComb "" ULONG tPaddleComb 0 0 0 4 /end TYPEDEF_MEASUREMENT
/begin TYPEDEF_MEASUREMENT tKilometrePerHour "" FLOAT32_IEEE tKilometrePerHour 0 0 -600 600 /end TYPEDEF_MEASUREMENT
/begin TYPEDEF_MEASUREMENT tRadian "" FLOAT32_IEEE tRadian 0 0 -20 20 /end TYPEDEF_MEASUREMENT
/begin TYPEDEF_MEASUREMENT tRegenMode "" ULONG tRegenMode 0 0 0 3 /end TYPEDEF_MEASUREMENT
/begin TYPEDEF_MEASUREMENT tAutomatedDriverControlState "" ULONG tAutomatedDriverControlState 0 0 0 5 /end TYPEDEF_MEASUREMENT
/begin TYPEDEF_MEASUREMENT tAmpere "" FLOAT32_IEEE tAmpere 0 0 0 10000 /end TYPEDEF_MEASUREMENT
/begin TYPEDEF_MEASUREMENT tCelsius "" FLOAT32_IEEE tCelsius 0 0 -400 10000 /end TYPEDEF_MEASUREMENT
/begin TYPEDEF_MEASUREMENT tNewtonMetre_100_S32 "" SLONG tNewtonMetre_100_S32 0 0 -100000.0 100000.0 /end TYPEDEF_MEASUREMENT
/begin TYPEDEF_MEASUREMENT tPerformanceMode "" ULONG tPerformanceMode 0 0 0 7 /end TYPEDEF_MEASUREMENT
/begin TYPEDEF_MEASUREMENT tNewtonMetrePerBar "" FLOAT32_IEEE tNewtonMetrePerBar 0 0 0 150 /end TYPEDEF_MEASUREMENT
/begin TYPEDEF_MEASUREMENT tRevolutionPerMinute_S16 "" SWORD tRevolutionPerMinute_S16 0 0 -32768 32767 /end TYPEDEF_MEASUREMENT
/begin TYPEDEF_MEASUREMENT tMillisecond "" FLOAT32_IEEE tMillisecond 0 0 0 3600000 /end TYPEDEF_MEASUREMENT
/begin TYPEDEF_MEASUREMENT tKilowattHour "" FLOAT32_IEEE tKilowattHour 0 0 -10000 10000 /end TYPEDEF_MEASUREMENT
/begin TYPEDEF_MEASUREMENT tMetrePerSquareSecond "" FLOAT32_IEEE tMetrePerSquareSecond 0 0 -50 50 /end TYPEDEF_MEASUREMENT
/begin TYPEDEF_MEASUREMENT tKilowatt "" FLOAT32_IEEE tKilowatt 0 0 -10000 10000 /end TYPEDEF_MEASUREMENT
/begin TYPEDEF_MEASUREMENT tMillisecond_U32 "" ULONG tMillisecond_U32 0 0 0 3600000 /end TYPEDEF_MEASUREMENT
/begin TYPEDEF_MEASUREMENT tInvSpdCtrlGainSet "" ULONG tInvSpdCtrlGainSet 0 0 0 7 /end TYPEDEF_MEASUREMENT
/begin TYPEDEF_MEASUREMENT tRadianPerSquareSecond "" FLOAT32_IEEE tRadianPerSquareSecond 0 0 -100000 100000 /end TYPEDEF_MEASUREMENT
/begin TYPEDEF_MEASUREMENT tKilometrePerHour_10_S16 "" SWORD tKilometrePerHour_10_S16 0 0 -600.0 600.0 /end TYPEDEF_MEASUREMENT
/begin TYPEDEF_MEASUREMENT tPercent_100_S16 "" SWORD tPercent_100_S16 0 0 0.0 100.0 /end TYPEDEF_MEASUREMENT
/begin TYPEDEF_MEASUREMENT tFactor "" FLOAT32_IEEE tFactor 0 0 -3.40282346639E+38 3.40282346639E+38 /end TYPEDEF_MEASUREMENT
/begin TYPEDEF_MEASUREMENT tTireModel "" ULONG tTireModel 0 0 0 4 /end TYPEDEF_MEASUREMENT
/begin TYPEDEF_MEASUREMENT tMetre "" FLOAT32_IEEE tMetre 0 0 -1000 1000 /end TYPEDEF_MEASUREMENT
/begin TYPEDEF_MEASUREMENT tCelsius_10_S16 "" SWORD tCelsius_10_S16 0 0 -400.0 10000.0 /end TYPEDEF_MEASUREMENT
/begin TYPEDEF_MEASUREMENT tOccupancyStatus "" ULONG tOccupancyStatus 0 0 0 3 /end TYPEDEF_MEASUREMENT
/begin TYPEDEF_MEASUREMENT tDriveMode "" ULONG tDriveMode 0 0 0 5 /end TYPEDEF_MEASUREMENT
/begin TYPEDEF_MEASUREMENT tBrakeLightRequest "" ULONG tBrakeLightRequest 0 0 0 3 /end TYPEDEF_MEASUREMENT
/begin TYPEDEF_MEASUREMENT tYawTorqueRequestMode "" ULONG tYawTorqueRequestMode 0 0 0 7 /end TYPEDEF_MEASUREMENT
/begin TYPEDEF_MEASUREMENT tAccStationaryRequest "" ULONG tAccStationaryRequest 0 0 0 2 /end TYPEDEF_MEASUREMENT
/begin TYPEDEF_MEASUREMENT tPropshaftStationaryCrankState "" ULONG tPropshaftStationaryCrankState 0 0 0 5 /end TYPEDEF_MEASUREMENT
/begin TYPEDEF_MEASUREMENT tMetrePerSecond "" FLOAT32_IEEE tMetrePerSecond 0 0 -200 200 /end TYPEDEF_MEASUREMENT
/begin TYPEDEF_MEASUREMENT tKilometrePerHour_S16 "" SWORD tKilometrePerHour_S16 0 0 -600 600 /end TYPEDEF_MEASUREMENT
/begin TYPEDEF_MEASUREMENT tPerformanceStrategy "" ULONG tPerformanceStrategy 0 0 0 3 /end TYPEDEF_MEASUREMENT
/begin TYPEDEF_MEASUREMENT tVsoVehicleMotionObserverSwt "" ULONG tVsoVehicleMotionObserverSwt 0 0 0 4 /end TYPEDEF_MEASUREMENT
/begin TYPEDEF_MEASUREMENT tDriveConfiguration "" ULONG tDriveConfiguration 0 0 0 3 /end TYPEDEF_MEASUREMENT
/begin TYPEDEF_MEASUREMENT tButtonState "" ULONG tButtonState 0 0 0 3 /end TYPEDEF_MEASUREMENT
/begin TYPEDEF_MEASUREMENT tRollingState "" ULONG tRollingState 0 0 0 4 /end TYPEDEF_MEASUREMENT
/begin TYPEDEF_MEASUREMENT tAutoShiftMode "" ULONG tAutoShiftMode 0 0 0 3 /end TYPEDEF_MEASUREMENT
/begin TYPEDEF_MEASUREMENT tMillivolt_S16 "" SWORD tMillivolt_S16 0 0 0 10000 /end TYPEDEF_MEASUREMENT
/begin TYPEDEF_MEASUREMENT tRevolutionPerMinute "" FLOAT32_IEEE tRevolutionPerMinute 0 0 -10000 10000 /end TYPEDEF_MEASUREMENT
/begin CHARACTERISTIC CTestElecMotTqReqOverrideEna "Electric motor torque request override enable from TM" VALUE 1073887480 __UByte_Value 0 NO_COMPU_METHOD 0 1 STEP_SIZE 1 FORMAT "%.2" /end CHARACTERISTIC
/begin CHARACTERISTIC CTestElecMotTqReqOverride "Electric motor torque request override from TM" VALUE 1073887476 __Float32_Value 0 tNewtonMetre -100000 100000 STEP_SIZE 1 /end CHARACTERISTIC
/begin CHARACTERISTIC CTestIceTqReqOverrideEna "ICE torque request override enable from TM" VALUE 1073887472 __UByte_Value 0 NO_COMPU_METHOD 0 1 STEP_SIZE 1 FORMAT "%.2" /end CHARACTERISTIC
/begin CHARACTERISTIC CTestIceTqReqOverride "ICE torque request override from TM" VALUE 1073887452 __Float32_Value 0 tNewtonMetre -100000 100000 STEP_SIZE 1 /end CHARACTERISTIC
/begin CHARACTERISTIC CPropshRateDirThdUppr "Electric motor direction threshold upper [rad/s]" VALUE 1073887448 __Float32_Value 0 tRadianPerSecond -1000 1000 STEP_SIZE 1 /end CHARACTERISTIC
/begin CHARACTERISTIC CPropshRateDirThdLowr "Electric motor direction threshold lower [rad/s]" VALUE 1073887444 __Float32_Value 0 tRadianPerSecond -1000 1000 STEP_SIZE 1 /end CHARACTERISTIC
/begin CHARACTERISTIC CTestBrkSwt "Override brake switch [0 = ENA_ST_UNKNOWN, 1 = ENA_ST_OFF, 2 = ENA_ST_ON]" VALUE 1073887440 __ULong_Value 0 tEnableState 0 3 STEP_SIZE 1 /end CHARACTERISTIC
/begin CHARACTERISTIC CTestTsmMstSwt "Torque state machine master switch" VALUE 1073887432 __UByte_Value 0 NO_COMPU_METHOD 0 1 STEP_SIZE 1 FORMAT "%.2" /end CHARACTERISTIC
/begin CHARACTERISTIC CTestPrelWhlCluReqHybrid "Enable preliminary wheel clutch torque request during ICE/Hybrid driving" VALUE 1073887431 __UByte_Value 0 NO_COMPU_METHOD 0 1 STEP_SIZE 1 FORMAT "%.2" /end CHARACTERISTIC
/begin CHARACTERISTIC CTestPrelWhlCluReqElec "Enable preliminary wheel clutch torque request during EV driving" VALUE 1073887430 __UByte_Value 0 NO_COMPU_METHOD 0 1 STEP_SIZE 1 FORMAT "%.2" /end CHARACTERISTIC
/begin CHARACTERISTIC CTestWhlTqDifReqEna "Enable yaw torque request per axle" VALUE 1073887429 __UByte_Value 0 NO_COMPU_METHOD 0 1 STEP_SIZE 1 FORMAT "%.2" /end CHARACTERISTIC
/begin CHARACTERISTIC CTestPaddleReqEna "Paddle request enable" VALUE 1073887428 __UByte_Value 0 NO_COMPU_METHOD 0 1 STEP_SIZE 1 FORMAT "%.2" /end CHARACTERISTIC
/begin CHARACTERISTIC CTestStatyCrkPauseSt "Stationary cranking pause state" VALUE 1073887424 __ULong_Value 0 tPropshaftStationaryCrankState 0 5 STEP_SIZE 1 /end CHARACTERISTIC
/begin CHARACTERISTIC CTestDrvgCrkPauseSt "Driving cranking pause state" VALUE 1073887420 __ULong_Value 0 tPropshaftDrivingCrankState 0 3 STEP_SIZE 1 /end CHARACTERISTIC
/begin CHARACTERISTIC CTestElecMotPwrDemEna "Enable charging request for electric system" VALUE 1073887417 __UByte_Value 0 NO_COMPU_METHOD 0 1 STEP_SIZE 1 FORMAT "%.2" /end CHARACTERISTIC
/begin CHARACTERISTIC CPropshRateForWhlRate "Use propshaft rate to calculate wheel rates and directions" VALUE 1073887416 __UByte_Value 0 NO_COMPU_METHOD 0 1 STEP_SIZE 1 FORMAT "%.2" /end CHARACTERISTIC
/begin CHARACTERISTIC CEnaPropshPumpCtrl "E-motor speed controller (dirty) enable" VALUE 1073887382 __UByte_Value 0 NO_COMPU_METHOD 0 1 STEP_SIZE 1 FORMAT "%.2" /end CHARACTERISTIC
/begin CHARACTERISTIC CPropshPumpCtrlSpd "Propshaft VT cooling pump e-motor target pump speed" VALUE 1073887380 __SWord_Value 0 tRevolutionPerMinute_S16 0 8000 STEP_SIZE 50 /end CHARACTERISTIC
/begin CHARACTERISTIC CPropshPumpCtrlSpdOffsetEna "Propshaft VT cooling pump speed offset mode enable" VALUE 1073887378 __UByte_Value 0 NO_COMPU_METHOD 0 1 STEP_SIZE 1 FORMAT "%.2" /end CHARACTERISTIC
/begin CHARACTERISTIC CPropshPumpCtrlSpdOffset "Propshaft VT cooling pump speed offset" VALUE 1073887376 __SWord_Value 0 tRevolutionPerMinute_S16 -8000 8000 STEP_SIZE 10 /end CHARACTERISTIC
/begin CHARACTERISTIC CPropshPumpCtrlGainProp "Propshaft VT cooling pump proportional gain" VALUE 1073887372 __Float32_Value 0 NO_COMPU_METHOD -3.40282346639E+38 3.40282346639E+38 STEP_SIZE 1 FORMAT "%.6" /end CHARACTERISTIC
/begin CHARACTERISTIC CPropshPumpCtrlGainIntgl "Propshaft VT cooling pump integral gain" VALUE 1073887368 __Float32_Value 0 NO_COMPU_METHOD -3.40282346639E+38 3.40282346639E+38 STEP_SIZE 1 FORMAT "%.6" /end CHARACTERISTIC
/begin CHARACTERISTIC CPropshPumpCtrlTqMax "Propshaft VT cooling pump max torque" VALUE 1073887364 __Float32_Value 0 tNewtonMetre -100000 100000 STEP_SIZE 1 /end CHARACTERISTIC
/begin CHARACTERISTIC CPropshPumpCtrlRunTimeout "Propshaft VT cooling pump diagnostics timeout" VALUE 1073887360 __ULong_Value 0 tMillisecond_U32 0 3600000 STEP_SIZE 1 /end CHARACTERISTIC
/begin CHARACTERISTIC CPropshPumpDiagSpdErrThd "Propshaft VT cooling pump speed error threshold" VALUE 1073887356 __Float32_Value 0 tRevolutionPerMinute -10000 10000 STEP_SIZE 1 /end CHARACTERISTIC
/begin CHARACTERISTIC CTestIgnBtnRisingEdgeIceStartEna "Enable starting engine with a short engine start button press" VALUE 1073887354 __UByte_Value 0 NO_COMPU_METHOD 0 1 STEP_SIZE 1 FORMAT "%.2" /end CHARACTERISTIC
/begin CHARACTERISTIC CTestIgnBtnRisingEdgeIceStopEna "Enable stopping engine with a short engine start button press" VALUE 1073887353 __UByte_Value 0 NO_COMPU_METHOD 0 1 STEP_SIZE 1 FORMAT "%.2" /end CHARACTERISTIC
/begin CHARACTERISTIC CTestTrackModePedlMapEna "Enable track mode pedal map state machine" VALUE 1073887352 __UByte_Value 0 NO_COMPU_METHOD 0 1 STEP_SIZE 1 FORMAT "%.2" /end CHARACTERISTIC
/begin CHARACTERISTIC CTestDrvrWhlTqReq "Override driver torque request [Nm]" VALUE 1073887348 __SLong_Value 0 tNewtonMetre_100_S32 -100000.0 100000.0 STEP_SIZE 1 /end CHARACTERISTIC
/begin CHARACTERISTIC CTestDrvMod "Override drive mode [0 = DRV_MOD_UNKNOWN, 1 = DRV_MOD_PARK, 2 = DRV_MOD_NEUTRAL, 3 = DRV_MOD_REVERSE, 4 = DRV_MOD_DRIVE]" VALUE 1073887344 __ULong_Value 0 tDriveMode 0 5 STEP_SIZE 1 /end CHARACTERISTIC
/begin CHARACTERISTIC CTestPaddleCombEna "Paddle Combined state, enables paddle input logic" VALUE 1073887340 __UByte_Value 0 NO_COMPU_METHOD 0 1 STEP_SIZE 1 FORMAT "%.2" /end CHARACTERISTIC
/begin CHARACTERISTIC CTestPaddleComb "Paddle Combined override" VALUE 1073887336 __ULong_Value 0 tPaddleComb 0 4 STEP_SIZE 1 /end CHARACTERISTIC
/begin CHARACTERISTIC CTestParkBtnSt "Override parking brake request [0 = ENA_ST_UNKNOWN, 1 = ENA_ST_OFF, 2 = ENA_ST_ON]" VALUE 1073887332 __ULong_Value 0 tEnableState 0 3 STEP_SIZE 1 /end CHARACTERISTIC
/begin CHARACTERISTIC CTestDrvCfgSwtReq "Override drive configuration request [0 = DRV_CFG_UNKNOWN, 1 = DRV_CFG_AWD, 2 = DRV_CFG_FWD, 3 = DRV_CFG_RWD]" VALUE 1073887328 __ULong_Value 0 tDriveConfiguration 0 3 STEP_SIZE 1 /end CHARACTERISTIC
/begin CHARACTERISTIC CTestPrplModSwtReq "Override Propulsion mode request [0 = PRPL_MOD_UNKNOWN, 1 = PRPL_MOD_ELEC_FORCED, 2 = PRPL_MOD_ELEC, 3 = PRPL_MOD_HYBRID, 4 = PRPL_MOD_ICE_FORCED]" VALUE 1073887324 __ULong_Value 0 tPropulsionMode 0 4 STEP_SIZE 1 /end CHARACTERISTIC
/begin CHARACTERISTIC CTestTireMdl "Override Tire Model Selector outp from DVI [0 = TIRE_MDL_UNKNOWN, 1 = TIRE_MDL_CUP2, 2 = TIRE_MDL_CUP2R, 3 = TIRE_MDL_ALPIN]" VALUE 1073887320 __ULong_Value 0 tTireModel 0 4 STEP_SIZE 1 /end CHARACTERISTIC
/begin CHARACTERISTIC CTestImobSt "Override immobilizer state [0 = IMOB_UNKNOWN, 1 = IMOB_INACTIVE, 2 = IMOB_ACTIVE]" VALUE 1073887316 __ULong_Value 0 tImmobilizerState 0 2 STEP_SIZE 1 /end CHARACTERISTIC
/begin CHARACTERISTIC CTestIgnHold "Override ign hold" VALUE 1073887312 __UByte_Value 0 NO_COMPU_METHOD 0 1 STEP_SIZE 1 FORMAT "%.2" /end CHARACTERISTIC
/begin CHARACTERISTIC CTestDoorStsLe "Door Status Left" VALUE 1073887308 __ULong_Value 0 tPanelStatus 0 6 STEP_SIZE 1 /end CHARACTERISTIC
/begin CHARACTERISTIC CTestDoorStsRi "Door Status Right" VALUE 1073887304 __ULong_Value 0 tPanelStatus 0 6 STEP_SIZE 1 /end CHARACTERISTIC
/begin CHARACTERISTIC CTestHoodStsFrnt "Hood Status Front" VALUE 1073887300 __ULong_Value 0 tPanelStatus 0 6 STEP_SIZE 1 /end CHARACTERISTIC
/begin CHARACTERISTIC CTestHoodStsRear "Hood Status Rear" VALUE 1073887296 __ULong_Value 0 tPanelStatus 0 6 STEP_SIZE 1 /end CHARACTERISTIC
/begin CHARACTERISTIC CTestOccupantPassSeat "Passenger seat occupancy status" VALUE 1073887292 __ULong_Value 0 tOccupancyStatus 0 3 STEP_SIZE 1 /end CHARACTERISTIC
/begin CHARACTERISTIC CTestOccupantRearLeftSeat "Passenger seat occupancy status" VALUE 1073887288 __ULong_Value 0 tOccupancyStatus 0 3 STEP_SIZE 1 /end CHARACTERISTIC
/begin CHARACTERISTIC CTestOccupantRearRightSeat "Passenger seat occupancy status" VALUE 1073887284 __ULong_Value 0 tOccupancyStatus 0 3 STEP_SIZE 1 /end CHARACTERISTIC
/begin CHARACTERISTIC CTestVehRollgSt "Rolling state" VALUE 1073887280 __ULong_Value 0 tRollingState 0 4 STEP_SIZE 1 /end CHARACTERISTIC
/begin CHARACTERISTIC CTestPwrSt "Ignition state" VALUE 1073887276 __ULong_Value 0 tPowerState 0 15 STEP_SIZE 1 /end CHARACTERISTIC
/begin CHARACTERISTIC CTestPrkgBrkReq "Parking brake request" VALUE 1073887272 __ULong_Value 0 tParkingBrakeRequest 0 2 STEP_SIZE 1 /end CHARACTERISTIC
/begin CHARACTERISTIC CTestTsmPrefCenCluCluStFault "Preferred torque source when central clutch state is fault disengaged" VALUE 1073887268 __ULong_Value 0 tPreferredCentralClutchDisengagedFaultMode 0 1 STEP_SIZE 1 /end CHARACTERISTIC
/begin CHARACTERISTIC CTestCenCluSlipCtrlEna "Enable central clutch slip control" VALUE 1073887267 __UByte_Value 0 NO_COMPU_METHOD 0 1 STEP_SIZE 1 FORMAT "%.2" /end CHARACTERISTIC
/begin CHARACTERISTIC CTestRePinionTqLimEna "Enable central clutch slip control" VALUE 1073887266 __UByte_Value 0 NO_COMPU_METHOD 0 1 STEP_SIZE 1 FORMAT "%.2" /end CHARACTERISTIC
/begin CHARACTERISTIC CTestCluFaultReset "Reset clutch faults" VALUE 1073887265 __UByte_Value 0 NO_COMPU_METHOD 0 1 STEP_SIZE 1 FORMAT "%.2" /end CHARACTERISTIC
/begin CHARACTERISTIC CTestPaddleEna "Steering wheel paddles enable (if true, use CTestPaddle__)" VALUE 1073887264 __UByte_Value 0 NO_COMPU_METHOD 0 1 STEP_SIZE 1 FORMAT "%.2" /end CHARACTERISTIC
/begin CHARACTERISTIC CTestPaddleUp "Paddle up test" VALUE 1073887263 __UByte_Value 0 NO_COMPU_METHOD 0 1 STEP_SIZE 1 FORMAT "%.2" /end CHARACTERISTIC
/begin CHARACTERISTIC CTestPaddleDown "Paddle down test" VALUE 1073887262 __UByte_Value 0 NO_COMPU_METHOD 0 1 STEP_SIZE 1 FORMAT "%.2" /end CHARACTERISTIC
/begin CHARACTERISTIC CTestPaddleBoth "Paddle both test" VALUE 1073887261 __UByte_Value 0 NO_COMPU_METHOD 0 1 STEP_SIZE 1 FORMAT "%.2" /end CHARACTERISTIC
/begin CHARACTERISTIC CTestAccrPedlEna "accel pedal percent override in DVI enable" VALUE 1073887260 __UByte_Value 0 NO_COMPU_METHOD 0 1 STEP_SIZE 1 FORMAT "%.2" /end CHARACTERISTIC
/begin CHARACTERISTIC CTestAccrPedlPerc "accel pedal percent override in DVI" VALUE 1073887258 __SWord_Value 0 tPercent_100_S16 0 100 STEP_SIZE 1 /end CHARACTERISTIC
/begin CHARACTERISTIC CTestSpdLimFfTqCmpRefVel "Speed Limiter feedforward torque compensation evaluation using reference velocity" VALUE 1073887257 __UByte_Value 0 NO_COMPU_METHOD 0 1 STEP_SIZE 1 FORMAT "%.2" /end CHARACTERISTIC
/begin CHARACTERISTIC CTestAdpvCrsCtrlDrvrReqEna "Cruise Control driver request enable [false = CTest override]" VALUE 1073887256 __UByte_Value 0 NO_COMPU_METHOD 0 1 STEP_SIZE 1 FORMAT "%.2" /end CHARACTERISTIC
/begin CHARACTERISTIC CTestAdpvCrsCtrlStReq "Cruise Control state request override" VALUE 1073887252 __ULong_Value 0 tAdaptiveCruiseControlStateRequest 0 4 STEP_SIZE 1 /end CHARACTERISTIC
/begin CHARACTERISTIC CTestAdpvCrsCtrlVelReqOvrdEna "Adaptive Cruise Control Velocity request override enable" VALUE 1073887248 __UByte_Value 0 NO_COMPU_METHOD 0 1 STEP_SIZE 1 FORMAT "%.2" /end CHARACTERISTIC
/begin CHARACTERISTIC CTestAdpvCrsCtrlVelReq "Cruise Control Velocity request override [km/h]" VALUE 1073887246 __SWord_Value 0 tKilometrePerHour_10_S16 -600.0 600.0 STEP_SIZE 1 /end CHARACTERISTIC
/begin CHARACTERISTIC CTestAdpvCrsCtrlSetVelIncr "Cruise Control Velocity Request Increment [km/h]" VALUE 1073887244 __SWord_Value 0 tKilometrePerHour_10_S16 -600.0 600.0 STEP_SIZE 1 /end CHARACTERISTIC
/begin CHARACTERISTIC CTestAdpvCrsCtrlAccelReqOvrdEna "Adaptive Cruise Control Acceleration request override enable" VALUE 1073887242 __UByte_Value 0 NO_COMPU_METHOD 0 1 STEP_SIZE 1 FORMAT "%.2" /end CHARACTERISTIC
/begin CHARACTERISTIC CTestAdpvCrsCtrlFfTqCmpRefVel "Adaptive Cruise Control feedforward torque compensation evaluation using reference velocity" VALUE 1073887241 __UByte_Value 0 NO_COMPU_METHOD 0 1 STEP_SIZE 1 FORMAT "%.2" /end CHARACTERISTIC
/begin CHARACTERISTIC CTestAdpvCrsCtrlRoundedVehVelCalcn "Adaptive Cruise Control uses rounded vehicle velocity for torque evaluation" VALUE 1073887240 __UByte_Value 0 NO_COMPU_METHOD 0 1 STEP_SIZE 1 FORMAT "%.2" /end CHARACTERISTIC
/begin CHARACTERISTIC CTestAdpvCrsCtrlAccelReq "Adaptive Cruise Control Acceleration request override enable" VALUE 1073887236 __Float32_Value 0 tMetrePerSquareSecond -50 50 STEP_SIZE 1 /end CHARACTERISTIC
/begin CHARACTERISTIC CTestAdpvCrsCtrlDistLvlReq "Adaptive Cruise Control Distance level request" VALUE 1073887232 __ULong_Value 0 tAccDistanceLevel 0 4 STEP_SIZE 1 /end CHARACTERISTIC
/begin CHARACTERISTIC CTestAdpvCrsCtrlBtnSt "If CTestAdpvCrsCtrlBtnSt != BTN_ST_UKWN, override Cruise controll steering wheel button state" VALUE 1073887228 __ULong_Value 0 tButtonState 0 3 STEP_SIZE 1 /end CHARACTERISTIC
/begin CHARACTERISTIC CTestAdpvCrsCtrlScrollBtnSt "If CTestAdpvCrsCtrlScrollBtnSt != BTN_ST_UKWN, override Cruise controll steering wheel scroll button state" VALUE 1073887224 __ULong_Value 0 tButtonState 0 3 STEP_SIZE 1 /end CHARACTERISTIC
/begin CHARACTERISTIC CTestAdpvCrsCtrlScrollBtnPosnOvrdEna "If CTestAdpvCrsCtrlScrollBtnPosnOvrdEna == ENA_ST_ON, override Cruise controll steering wheel scroll button position" VALUE 1073887220 __ULong_Value 0 tEnableState 0 3 STEP_SIZE 1 /end CHARACTERISTIC
/begin CHARACTERISTIC CTestAdpvCrsCtrlScrollBtnPosn "If CTestAdpvCrsCtrlScrollBtnPosnOvrdEna == ENA_ST_ON, use CTestAdpvCrsCtrlScrollBtnPosn instead of steering wheel position" VALUE 1073887216 __UByte_Value 0 NO_COMPU_METHOD 0 255 STEP_SIZE 1 FORMAT "%.0" /end CHARACTERISTIC
/begin CHARACTERISTIC CTestPerfModSwtReq "Override Performance mode swtch request [0 = UNKNOWN, 1 = GHOST_EV, 2 = COMFORT, 3 = WET_SNOW, 4 = SPORT, 5 = TRACK, 6 = INDIVIDUAL]" VALUE 1073887212 __ULong_Value 0 tPerformanceMode 0 7 STEP_SIZE 1 /end CHARACTERISTIC
/begin CHARACTERISTIC CTestPerfMode "Override performance mode [0 = UNKNOWN, 1 = GHOST_EV, 2 = COMFORT, 3 = WET_SNOW, 4 = SPORT, 5 = TRACK, 6 = INDIVIDUAL]" VALUE 1073887208 __ULong_Value 0 tPerformanceMode 0 7 STEP_SIZE 1 /end CHARACTERISTIC
/begin CHARACTERISTIC CTestPerfModReqAutoShiftMod "Override Performance mode request for AutoShift Mode" VALUE 1073887204 __ULong_Value 0 tAutoShiftMode 0 3 STEP_SIZE 1 /end CHARACTERISTIC
/begin CHARACTERISTIC CTestDriftModEnaSt "Override Performance mode request for Drift Mode" VALUE 1073887200 __ULong_Value 0 tEnableState 0 3 STEP_SIZE 1 /end CHARACTERISTIC
/begin CHARACTERISTIC CTestPerfModReqLaunchCtrlMod "Override Performance mode request for Launch Control Mode" VALUE 1073887196 __ULong_Value 0 tLaunchControlMode 0 3 STEP_SIZE 1 /end CHARACTERISTIC
/begin CHARACTERISTIC CTestPerfModReqPedlMapMod "Override Performance mode request for Pedal Map mode" VALUE 1073887192 __ULong_Value 0 tPedalMapMode 0 6 STEP_SIZE 1 /end CHARACTERISTIC
/begin CHARACTERISTIC CTestPerfModDDCDevModEna "Enable dev mode maps for DDC" VALUE 1073887188 __UByte_Value 0 NO_COMPU_METHOD 0 1 STEP_SIZE 1 FORMAT "%.2" /end CHARACTERISTIC
/begin CHARACTERISTIC CTestPerfModReqDDC "Override Performance mode request to DDC supplier node [0 = UNKNWON, 1 = DDC_PERF_MOD_1, 2 = DDC_PERF_MOD_2, 3 = DDC_PERF_MOD_3, 4 = DDC_PERF_MOD_4, 5 = DDC_PERF_MOD_5, 6 = DDC_PERF_MOD_6]" VALUE 1073887184 __ULong_Value 0 tPerformanceModeDDC 0 6 STEP_SIZE 1 /end CHARACTERISTIC
/begin CHARACTERISTIC CTestPerfModReqEPS "Override Performance mode request to EPS supplier node [0 = UNKNOWN, 1 = EPS_PERF_MOD_SOFT, 2 = EPS_PERF_MOD_MED, 3 = EPS_PERF_MOD_HARD]" VALUE 1073887180 __ULong_Value 0 tPerformanceModeEPS 0 3 STEP_SIZE 1 /end CHARACTERISTIC
/begin CHARACTERISTIC CTestPerfModReqRHC "Override Performance mode request to RHC [0 = UNKNWON, 1 = RHC_PERF_MOD_LOW, 2 = RHC_PERF_MOD_MED, 3 = RHC_PERF_MOD_HIGH]" VALUE 1073887176 __ULong_Value 0 tPerformanceModeRHC 0 3 STEP_SIZE 1 /end CHARACTERISTIC
/begin CHARACTERISTIC CTestPerfModReqSpdLimr "Override Performance mode request for Speed Limiter" VALUE 1073887172 __ULong_Value 0 tPerformanceModeSpeedLimiter 0 6 STEP_SIZE 1 /end CHARACTERISTIC
/begin CHARACTERISTIC CTestPerfModReqTpms "Override Performance mode request for Tpms" VALUE 1073887168 __ULong_Value 0 tPerformanceModeTPMS 0 2 STEP_SIZE 1 /end CHARACTERISTIC
/begin CHARACTERISTIC CTestChgModEnaIEB "Override Performance mode request to IEB supplier node [0 = UNKNOWN, 1 = IEB_CHG_MOD_DISABLED, 2 = IEB_CHG_MOD_ENABLED]" VALUE 1073887164 __ULong_Value 0 tChangeModeEnableIEB 0 2 STEP_SIZE 1 /end CHARACTERISTIC
/begin CHARACTERISTIC CTestVdcPerfModReq "Override Performance mode request for IEB VDC, only works if CTestChgModEnaIEB = IEB_CHG_MOD_ENABLED [0 = UNKNOWN, 1 = UNAVAILABLE, 2 = VDC_PERF_MOD_ON, 3 = VDC_PERF_MOD_INTER, 4 = VDC_PERF_MOD_OFF]" VALUE 1073887160 __ULong_Value 0 tPerformanceModeVDC 0 4 STEP_SIZE 1 /end CHARACTERISTIC
/begin CHARACTERISTIC CTestPerfModReqPerfStgy "Override Performance mode request for Performance Strategy //TO DO (PWTSW-5156) keep to POWER until implemented" VALUE 1073887156 __ULong_Value 0 tPerformanceStrategy 0 3 STEP_SIZE 1 /end CHARACTERISTIC
/begin CHARACTERISTIC CTestPerfModReqPrplMod "Override Performance mode request for Propulsion Mode" VALUE 1073887152 __ULong_Value 0 tPropulsionMode 0 4 STEP_SIZE 1 /end CHARACTERISTIC
/begin CHARACTERISTIC CTestPerfModReqRgnMod "Override Performance mode request for Regen Mode" VALUE 1073887148 __ULong_Value 0 tRegenMode 0 3 STEP_SIZE 1 /end CHARACTERISTIC
/begin CHARACTERISTIC CTestEspTelltlGvcuCondOvrdEna "Allow GVCU to override ESP Telltale using internal conditions" VALUE 1073887147 __UByte_Value 0 NO_COMPU_METHOD 0 1 STEP_SIZE 1 FORMAT "%.2" /end CHARACTERISTIC
/begin CHARACTERISTIC CTestAbsTelltlGvcuCondOvrdEna "Allow GVCU to override ABS Telltale using internal conditions" VALUE 1073887146 __UByte_Value 0 NO_COMPU_METHOD 0 1 STEP_SIZE 1 FORMAT "%.2" /end CHARACTERISTIC
/begin CHARACTERISTIC CTestEspAbsFuncDisblEna "Allow GVCU to disable ESP/ABS functionality when internal conditions are met" VALUE 1073887145 __UByte_Value 0 NO_COMPU_METHOD 0 1 STEP_SIZE 1 FORMAT "%.2" /end CHARACTERISTIC
/begin CHARACTERISTIC CTestForceDisableEspAbsFuncEna "Force disable ESP/ABS functionality, used for testing purposes" VALUE 1073887144 __UByte_Value 0 NO_COMPU_METHOD 0 1 STEP_SIZE 1 FORMAT "%.2" /end CHARACTERISTIC
/begin CHARACTERISTIC CTestIceSpdReqV "Override Ice Spd Req bit on CAN" VALUE 1073887140 __ULong_Value 0 tEnableState 0 3 STEP_SIZE 1 /end CHARACTERISTIC
/begin CHARACTERISTIC CTestPropshTqDmdChrgOvrdEna "Enable a charge torque override within Tq Struct, ignoring energy manager" VALUE 1073887138 __UByte_Value 0 NO_COMPU_METHOD 0 1 STEP_SIZE 1 FORMAT "%.2" /end CHARACTERISTIC
/begin CHARACTERISTIC CTestPropshTqDmdChrgOvrd "Charge torque override within Tq Struct, ignoring energy manager" VALUE 1073887136 __SWord_Value 0 tNewtonMetre_S16 -32000 32000 STEP_SIZE 1 /end CHARACTERISTIC
/begin CHARACTERISTIC CPedal1UMax "TO DO: Calibrate Pedal 1 Max voltage" VALUE 1073887132 __SLong_Value 0 tMillivolt_S32 0 1000000 STEP_SIZE 1 /end CHARACTERISTIC
/begin CHARACTERISTIC CPedal1UMin "Pedal 1 Min voltage" VALUE 1073887128 __SLong_Value 0 tMillivolt_S32 0 1000000 STEP_SIZE 1 /end CHARACTERISTIC
/begin CHARACTERISTIC CPedal2UMax "Pedal 2 Max voltage" VALUE 1073887124 __SLong_Value 0 tMillivolt_S32 0 1000000 STEP_SIZE 1 /end CHARACTERISTIC
/begin CHARACTERISTIC CPedal2UMin "Pedal 2 Min voltage" VALUE 1073887120 __SLong_Value 0 tMillivolt_S32 0 1000000 STEP_SIZE 1 /end CHARACTERISTIC
/begin CHARACTERISTIC CPedalWarmupTime "Duration after startup that the pedal logic will wait before checking faults and outputting a non-zero pedal value" VALUE 1073887116 __ULong_Value 0 tMillisecond_U32 0 3600000 STEP_SIZE 1 /end CHARACTERISTIC
/begin CHARACTERISTIC CPedalAdaptionLimit "Determines the limit for pedal adaptation may deviate away from the standard calibration" VALUE 1073887112 __Float32_Value 0 tFraction 0 1 STEP_SIZE 1 /end CHARACTERISTIC
/begin CHARACTERISTIC CPedalFaultTimeout "Duration the pedal will hold the last valid value when a fault is detected" VALUE 1073887108 __ULong_Value 0 tMillisecond_U32 0 3600000 STEP_SIZE 1 /end CHARACTERISTIC
/begin CHARACTERISTIC CPedalDeadzone "Deadzone around the 0% pedal position" VALUE 1073887104 __SLong_Value 0 tPercent_100_S32 0.0 100.0 STEP_SIZE 1 /end CHARACTERISTIC
/begin CHARACTERISTIC CPedalDiffLimit "Allowed deviation between the two pedals signals" VALUE 1073887100 __SLong_Value 0 tPercent_100_S32 0.0 100.0 STEP_SIZE 1 /end CHARACTERISTIC
/begin CHARACTERISTIC CTestMaxPedal "Clamp the pedal value to a maximum value" VALUE 1073887096 __SLong_Value 0 tPercent_100_S32 0.0 100.0 STEP_SIZE 1 /end CHARACTERISTIC
/begin CHARACTERISTIC CPedalAdaptionFilterNormalizedCutoffFreq "Filter coefficient for the pedal signals when adapting new min/max values" VALUE 1073887092 __Float32_Value 0 tFraction 0 1 STEP_SIZE 1 /end CHARACTERISTIC
/begin CHARACTERISTIC CTestAdpvCrsCtrlVelCtrlEna "Enable Adaptive Cruise Control state transition to Velocitry Control state" VALUE 1073887089 __UByte_Value 0 NO_COMPU_METHOD 0 1 STEP_SIZE 1 FORMAT "%.2" /end CHARACTERISTIC
/begin CHARACTERISTIC CTestAdpvCrsCtrlFolCtrlEna "Enable Adaptive Cruise Control state transition to Following Control" VALUE 1073887088 __UByte_Value 0 NO_COMPU_METHOD 0 1 STEP_SIZE 1 FORMAT "%.2" /end CHARACTERISTIC
/begin CHARACTERISTIC CTestAdpvCrsCtrlStandgActvFromStbyEna "Enable Adaptive Cruise Control state transition to Standing Active state from Standby" VALUE 1073887077 __UByte_Value 0 NO_COMPU_METHOD 0 1 STEP_SIZE 1 FORMAT "%.2" /end CHARACTERISTIC
/begin CHARACTERISTIC CTestAdpvCrsCtrlStandgActvFromFolCtrlEna "Enable Adaptive Cruise Control state transition to Standing Active state from Following Control" VALUE 1073887076 __UByte_Value 0 NO_COMPU_METHOD 0 1 STEP_SIZE 1 FORMAT "%.2" /end CHARACTERISTIC
/begin CHARACTERISTIC CTestAdpvCrsCtrlStatyReqOvrd "Stationary request override" VALUE 1073887072 __ULong_Value 0 tAccStationaryRequest 0 2 STEP_SIZE 1 /end CHARACTERISTIC
/begin CHARACTERISTIC CTestAutDrvrCtrlStOvrd "CTest to override the Automated Driver Control state" VALUE 1073886744 __ULong_Value 0 tAutomatedDriverControlState 0 5 STEP_SIZE 1 /end CHARACTERISTIC
/begin CHARACTERISTIC CTestBrkLiReq "CTest variable to manually verify the lights behaviour" VALUE 1073886548 __ULong_Value 0 tBrakeLightRequest 0 3 STEP_SIZE 1 /end CHARACTERISTIC
/begin CHARACTERISTIC CHomlnSftyIndcdVehVelMax "Maximum value for homologated vehicle velocity" VALUE 1073886520 __SWord_Value 0 tKilometrePerHour_10_S16 -600.0 600.0 STEP_SIZE 1 /end CHARACTERISTIC
/begin CHARACTERISTIC CHvSocCriticalLow "Soc critical threshold to shutdown hybrid system" VALUE 1073886508 __Float32_Value 0 tPercent 0 100 STEP_SIZE 5 /end CHARACTERISTIC
/begin CHARACTERISTIC CHvSocCriticalHigh "Soc max above which TSM goes to ICE turtle" VALUE 1073886504 __Float32_Value 0 tPercent 0 150 STEP_SIZE 5 /end CHARACTERISTIC
/begin CHARACTERISTIC CLvSocReqHvOnChrg "LV battery soc threshold to request HV on for charging lv battery" VALUE 1073886500 __Float32_Value 0 tPercent 0 100 STEP_SIZE 5 /end CHARACTERISTIC
/begin CHARACTERISTIC CLvSocStopChrg "LV battery soc threshold to stop charging" VALUE 1073886496 __Float32_Value 0 tPercent 0 100 STEP_SIZE 5 /end CHARACTERISTIC
/begin CHARACTERISTIC CInhibitHvReqTimeMax "Time to stop lv charging if user want ignition off" VALUE 1073886492 __ULong_Value 0 tMillisecond_U32 0 3600 STEP_SIZE 60 /end CHARACTERISTIC
/begin CHARACTERISTIC CHvSocMinIgnition "HV battery min soc to allow ignition on" VALUE 1073886488 __Float32_Value 0 tPercent 0 100 STEP_SIZE 5 /end CHARACTERISTIC
/begin CHARACTERISTIC CHvSocMinClimateControl "HV battery min soc to allow climate control" VALUE 1073886484 __Float32_Value 0 tPercent 0 100 STEP_SIZE 5 /end CHARACTERISTIC
/begin CHARACTERISTIC CHvSocMinCooling "HV battery min soc to allow external cooling" VALUE 1073886480 __Float32_Value 0 tPercent 0 100 STEP_SIZE 5 /end CHARACTERISTIC
/begin CHARACTERISTIC CHvSocMinLvCharging "HV battery min soc to allow ignition on to allow lv charging" VALUE 1073886476 __Float32_Value 0 tPercent 0 100 STEP_SIZE 5 /end CHARACTERISTIC
/begin CHARACTERISTIC CSocHysteresis "Soc hysteresis to avoid flickerin during state transitions" VALUE 1073886472 __Float32_Value 0 tPercent 0 100 STEP_SIZE 1 /end CHARACTERISTIC
/begin CHARACTERISTIC CPrechrgVltgNoBattDyno "Voltage value above which hybrid state machine goes into running if no HV battery is present" VALUE 1073886468 __Float32_Value 0 tVolt 0 1000 STEP_SIZE 10 /end CHARACTERISTIC
/begin CHARACTERISTIC CTestDiPtTelltls "************************************************************************************************************************************************* * Diag **********************************************" VALUE 1073886464 __UByte_Value 0 NO_COMPU_METHOD 0 1 STEP_SIZE 1 FORMAT "%.2" /end CHARACTERISTIC
/begin CHARACTERISTIC CTelltaleHoldDuration "" VALUE 1073886460 __ULong_Value 0 tMillisecond_U32 0 3600000 STEP_SIZE 1 /end CHARACTERISTIC
/begin CHARACTERISTIC CTestTelltaleAbsWarning "Force enable ABS warning telltale" VALUE 1073886459 __UByte_Value 0 NO_COMPU_METHOD 0 1 STEP_SIZE 1 FORMAT "%.2" /end CHARACTERISTIC
/begin CHARACTERISTIC CTestTelltaleBrakeFailureWarning "Force enable Brake failure warning telltale" VALUE 1073886458 __UByte_Value 0 NO_COMPU_METHOD 0 1 STEP_SIZE 1 FORMAT "%.2" /end CHARACTERISTIC
/begin CHARACTERISTIC CTestTelltaleCheckEngineWarning "Force enable check engine warning telltale" VALUE 1073886457 __UByte_Value 0 NO_COMPU_METHOD 0 1 STEP_SIZE 1 FORMAT "%.2" /end CHARACTERISTIC
/begin CHARACTERISTIC CTestTelltaleParkingBrakeWarning "Force enable parking brake warning telltale" VALUE 1073886456 __UByte_Value 0 NO_COMPU_METHOD 0 1 STEP_SIZE 1 FORMAT "%.2" /end CHARACTERISTIC
/begin CHARACTERISTIC CTestTelltaleEngineOilPressureWarning "Force enable engine oil pressure warning telltale" VALUE 1073886455 __UByte_Value 0 NO_COMPU_METHOD 0 1 STEP_SIZE 1 FORMAT "%.2" /end CHARACTERISTIC
/begin CHARACTERISTIC CTestTelltaleEngineOilTemperatureWarning "Force enable engine oil temperature warning telltale" VALUE 1073886454 __UByte_Value 0 NO_COMPU_METHOD 0 1 STEP_SIZE 1 FORMAT "%.2" /end CHARACTERISTIC
/begin CHARACTERISTIC CTestTelltaleEngineOilLevelLow "Force enable engine oil level low telltale" VALUE 1073886453 __UByte_Value 0 NO_COMPU_METHOD 0 1 STEP_SIZE 1 FORMAT "%.2" /end CHARACTERISTIC
/begin CHARACTERISTIC CTestTelltaleEngineOilAdd "Force enable engine oil add telltale" VALUE 1073886452 __UByte_Value 0 NO_COMPU_METHOD 0 1 STEP_SIZE 1 FORMAT "%.2" /end CHARACTERISTIC
/begin CHARACTERISTIC CTestTelltaleFuelPressureWarning "Force enable fuel pressure warning telltale" VALUE 1073886451 __UByte_Value 0 NO_COMPU_METHOD 0 1 STEP_SIZE 1 FORMAT "%.2" /end CHARACTERISTIC
/begin CHARACTERISTIC CTestTelltaleCoolantTemperatureWarning "Force enable coolant temperature warning telltale" VALUE 1073886450 __UByte_Value 0 NO_COMPU_METHOD 0 1 STEP_SIZE 1 FORMAT "%.2" /end CHARACTERISTIC
/begin CHARACTERISTIC CTestTelltaleCoolantLevelLowWarning "Force enable coolant level low warning telltale" VALUE 1073886449 __UByte_Value 0 NO_COMPU_METHOD 0 1 STEP_SIZE 1 FORMAT "%.2" /end CHARACTERISTIC
/begin CHARACTERISTIC CTestTelltaleTransmissionFailure "Force enable transmission failure telltale" VALUE 1073886448 __UByte_Value 0 NO_COMPU_METHOD 0 1 STEP_SIZE 1 FORMAT "%.2" /end CHARACTERISTIC
/begin CHARACTERISTIC CTestTelltaleTransmissionFluidLevelWarning "Force enable transmission fluid level warning telltale" VALUE 1073886447 __UByte_Value 0 NO_COMPU_METHOD 0 1 STEP_SIZE 1 FORMAT "%.2" /end CHARACTERISTIC
/begin CHARACTERISTIC CTestTelltaleTransmissionTemperatureWarning "Force enable transmission temperature warning telltale" VALUE 1073886446 __UByte_Value 0 NO_COMPU_METHOD 0 1 STEP_SIZE 1 FORMAT "%.2" /end CHARACTERISTIC
/begin CHARACTERISTIC CTestTelltaleCruiseControl "Force enable cruise control telltale" VALUE 1073886445 __UByte_Value 0 NO_COMPU_METHOD 0 1 STEP_SIZE 1 FORMAT "%.2" /end CHARACTERISTIC
/begin CHARACTERISTIC CTestTelltaleAdaptiveCruiseControl "Force enable adaptive cruise control telltale" VALUE 1073886444 __UByte_Value 0 NO_COMPU_METHOD 0 1 STEP_SIZE 1 FORMAT "%.2" /end CHARACTERISTIC
/begin CHARACTERISTIC CTestTelltaleLimpWarning "Force enable limp warning telltale" VALUE 1073886443 __UByte_Value 0 NO_COMPU_METHOD 0 1 STEP_SIZE 1 FORMAT "%.2" /end CHARACTERISTIC
/begin CHARACTERISTIC CTestTelltaleTurtleWarning "Force enable turtle warning telltale" VALUE 1073886442 __UByte_Value 0 NO_COMPU_METHOD 0 1 STEP_SIZE 1 FORMAT "%.2" /end CHARACTERISTIC
/begin CHARACTERISTIC CTestTelltaleEsp "Force enable esp telltale" VALUE 1073886441 __UByte_Value 0 NO_COMPU_METHOD 0 1 STEP_SIZE 1 FORMAT "%.2" /end CHARACTERISTIC
/begin CHARACTERISTIC CTestTelltaleTirePressureWarning "Force enable tire pressure warning telltale" VALUE 1073886440 __UByte_Value 0 NO_COMPU_METHOD 0 1 STEP_SIZE 1 FORMAT "%.2" /end CHARACTERISTIC
/begin CHARACTERISTIC CTestTelltaleAutoHold "Force enable auto hold telltale" VALUE 1073886439 __UByte_Value 0 NO_COMPU_METHOD 0 1 STEP_SIZE 1 FORMAT "%.2" /end CHARACTERISTIC
/begin CHARACTERISTIC CTestTelltaleHillHold "Force enable hill hold telltale" VALUE 1073886438 __UByte_Value 0 NO_COMPU_METHOD 0 1 STEP_SIZE 1 FORMAT "%.2" /end CHARACTERISTIC
/begin CHARACTERISTIC CTestTelltaleTcOff "Force enable tc off telltale" VALUE 1073886437 __UByte_Value 0 NO_COMPU_METHOD 0 1 STEP_SIZE 1 FORMAT "%.2" /end CHARACTERISTIC
/begin CHARACTERISTIC CTestTelltaleActiveSystemFault "Force enable active system fault telltale" VALUE 1073886436 __UByte_Value 0 NO_COMPU_METHOD 0 1 STEP_SIZE 1 FORMAT "%.2" /end CHARACTERISTIC
/begin CHARACTERISTIC CTestTelltaleEpsSteeringFailure "Force enable eps steering failure telltale" VALUE 1073886435 __UByte_Value 0 NO_COMPU_METHOD 0 1 STEP_SIZE 1 FORMAT "%.2" /end CHARACTERISTIC
/begin CHARACTERISTIC CTestTelltaleTrackMode "Force enable track mode telltale" VALUE 1073886434 __UByte_Value 0 NO_COMPU_METHOD 0 1 STEP_SIZE 1 FORMAT "%.2" /end CHARACTERISTIC
/begin CHARACTERISTIC CTestTelltaleBatteryChargeCondition "Force enable battery charge condition telltale" VALUE 1073886433 __UByte_Value 0 NO_COMPU_METHOD 0 1 STEP_SIZE 1 FORMAT "%.2" /end CHARACTERISTIC
/begin CHARACTERISTIC CTestTelltaleHvWarning "Force enable hv warning telltale" VALUE 1073886432 __UByte_Value 0 NO_COMPU_METHOD 0 1 STEP_SIZE 1 FORMAT "%.2" /end CHARACTERISTIC
/begin CHARACTERISTIC CEnaDrvrBrkPedlWhlTqDtReq "Enable wheel torque request calculated from brake pedal travel, requested by IEB" VALUE 1073886412 __UByte_Value 0 NO_COMPU_METHOD 0 1 STEP_SIZE 1 FORMAT "%.2" /end CHARACTERISTIC
/begin CHARACTERISTIC CTqStateCrkLtchdTmr "Crank communication timer [ms]" VALUE 1073886380 __ULong_Value 0 tMillisecond_U32 0 3600000 STEP_SIZE 1 /end CHARACTERISTIC
/begin CHARACTERISTIC CTqTranTol "Torque transition tolerance for state transition [Nm]" VALUE 1073886340 __SLong_Value 0 tNewtonMetre_100_S32 -100000.0 100000.0 STEP_SIZE 1 /end CHARACTERISTIC
/begin CHARACTERISTIC CPanelOpenVehVelThd "Speed treshold to trigger Panel Open Limiter and Cruise Control Standby Inhibit mask  [km/h]" VALUE 1073885664 __SWord_Value 0 tKilometrePerHour_10_S16 -600.0 600.0 STEP_SIZE 1 /end CHARACTERISTIC
/begin CHARACTERISTIC CPaddleParkTime "Time threshold to set park drive mode request [ms]" VALUE 1073885660 __ULong_Value 0 tMillisecond_U32 0 3600000 STEP_SIZE 1 /end CHARACTERISTIC
/begin CHARACTERISTIC CEmgyParkBrkButtonHoldTime "Time threshold to request emergency brake [ms]" VALUE 1073885656 __ULong_Value 0 tMillisecond_U32 0 3600000 STEP_SIZE 1 /end CHARACTERISTIC
/begin CHARACTERISTIC CTsmPrefDrvCfgForEv "Preferred drivetrain configuration for EV driving" VALUE 1073885644 __ULong_Value 0 tDriveConfiguration 0 3 STEP_SIZE 1 /end CHARACTERISTIC
/begin CHARACTERISTIC CTsmDrvCfgMonrTimeThreshold "Time threshold to accept drive configuration from torque state machine [ms]" VALUE 1073885640 __ULong_Value 0 tMillisecond_U32 0 3600000 STEP_SIZE 1 /end CHARACTERISTIC
/begin CHARACTERISTIC CPrplModSelnTime "Time threshold to accept propulsion mode change from Headunit [ms]" VALUE 1073885636 __ULong_Value 0 tMillisecond_U32 0 3600000 STEP_SIZE 1 /end CHARACTERISTIC
/begin CHARACTERISTIC CTsmPrplModMonrTimeThreshold "Time threshold to accept propulsion mode from torque state machine [ms]" VALUE 1073885632 __ULong_Value 0 tMillisecond_U32 0 3600000 STEP_SIZE 1 /end CHARACTERISTIC
/begin CHARACTERISTIC CTsmHybDrvWithIceDecoupl "Enable decoupled engine idle while electric driving" VALUE 1073885628 __UByte_Value 0 NO_COMPU_METHOD 0 1 STEP_SIZE 1 FORMAT "%.2" /end CHARACTERISTIC
/begin CHARACTERISTIC CPerfModDft "Default performance mode" VALUE 1073885624 __ULong_Value 0 tPerformanceMode 0 7 STEP_SIZE 1 /end CHARACTERISTIC
/begin CHARACTERISTIC CPerfModReqHoldPerd "Hold performance mode request when confirmed [ms]" VALUE 1073885620 __ULong_Value 0 tMillisecond_U32 0 3600000 STEP_SIZE 1 /end CHARACTERISTIC
/begin CHARACTERISTIC CPerfModReqRejctdPerd "Rejected Performance Mode Request period [ms]" VALUE 1073885616 __ULong_Value 0 tMillisecond_U32 0 3600000 STEP_SIZE 1 /end CHARACTERISTIC
/begin CHARACTERISTIC CPrplModChgAllwdWhileDrvg "Allow changing propulsion mode while driving using the performance mode selection" VALUE 1073885614 __UByte_Value 0 NO_COMPU_METHOD 0 1 STEP_SIZE 1 FORMAT "%.2" /end CHARACTERISTIC
/begin CHARACTERISTIC CPerfModCptReqHoldPerd "Component performance mode request held period, before checking if the component accepted or rejected the request" VALUE 1073885584 __ULong_Value 0 tMillisecond_U32 0 3600000 STEP_SIZE 1 /end CHARACTERISTIC
/begin CHARACTERISTIC CPerfModReqPndStTiHuLimPerd "Performance mode request pending period when selection comes from HU" VALUE 1073885580 __ULong_Value 0 tMillisecond_U32 0 3600000 STEP_SIZE 1 /end CHARACTERISTIC
/begin CHARACTERISTIC CPerfModReqPndStTiSteerKnobLimPerd "Performance mode request pending period when selection comes from steering knob" VALUE 1073885576 __ULong_Value 0 tMillisecond_U32 0 3600000 STEP_SIZE 1 /end CHARACTERISTIC
/begin CHARACTERISTIC CPerfModRgnModDftFromAdap "If true, use adaption values for regen mode at vehicle startup, otherwise default to CPerfModRgnModDftAtStartup" VALUE 1073885557 __UByte_Value 0 NO_COMPU_METHOD 0 1 STEP_SIZE 1 FORMAT "%.2" /end CHARACTERISTIC
/begin CHARACTERISTIC CPerfModRgnModDftRstAtIgnRisngEdge "If true and CPerfModRgnModDftFromAdap is false, reset the regen mode to CPerfModRgnModDftAtStartup when going in ignition" VALUE 1073885556 __UByte_Value 0 NO_COMPU_METHOD 0 1 STEP_SIZE 1 FORMAT "%.2" /end CHARACTERISTIC
/begin CHARACTERISTIC CPerfModRgnModDftAtStartup "Default regen value at startup if CPerfModRgnModDftFromAdap is false" VALUE 1073885552 __ULong_Value 0 tRegenMode 0 3 STEP_SIZE 1 /end CHARACTERISTIC
/begin CHARACTERISTIC CPerfModLiftInhbIgnore "Ignore lift system fault and accept the performance mode request nevertheless" VALUE 1073885548 __UByte_Value 0 NO_COMPU_METHOD 0 1 STEP_SIZE 1 FORMAT "%.2" /end CHARACTERISTIC
/begin CHARACTERISTIC CShiftReqTime "Shift request hold time [ms]" VALUE 1073885544 __ULong_Value 0 tMillisecond_U32 0 3600000 STEP_SIZE 1 /end CHARACTERISTIC
/begin CHARACTERISTIC CShiftReqFreezeTime "Shift request freeze time, needs to be at least 10 ms larger than CShiftReqTime [ms]" VALUE 1073885540 __ULong_Value 0 tMillisecond_U32 0 3600000 STEP_SIZE 1 /end CHARACTERISTIC
/begin CHARACTERISTIC CHoldIgnitionTime "Hold ignition button time [ms]" VALUE 1073885536 __ULong_Value 0 tMillisecond_U32 0 3600000 STEP_SIZE 1 /end CHARACTERISTIC
/begin CHARACTERISTIC CManualOverrideTime "Car returns to automatic gear selection after this duration when car is in temporary manual [ms]" VALUE 1073885528 __ULong_Value 0 tMillisecond_U32 0 3600000 STEP_SIZE 1 /end CHARACTERISTIC
/begin CHARACTERISTIC CLnchCtrlReqEna "Enable Launch Control request" VALUE 1073885525 __UByte_Value 0 NO_COMPU_METHOD 0 1 STEP_SIZE 1 FORMAT "%.2" /end CHARACTERISTIC
/begin CHARACTERISTIC CLnchCtrlPaddleReqEna "Allow Launch Control request via double up-shift paddle request" VALUE 1073885524 __UByte_Value 0 NO_COMPU_METHOD 0 1 STEP_SIZE 1 FORMAT "%.2" /end CHARACTERISTIC
/begin CHARACTERISTIC CLnchCtrlAbortSteerAgMax "Steering wheel treshold above which launch control is aborted" VALUE 1073885522 __SWord_Value 0 tDegree_10_S16 -720.0 720.0 STEP_SIZE 1 /end CHARACTERISTIC
/begin CHARACTERISTIC CLnchCtrlReqAllwdBrkPedl "Brake pedal percent treshold above which driver request is accepted" VALUE 1073885520 __SWord_Value 0 tPercent_100_S16 0.0 100.0 STEP_SIZE 1 /end CHARACTERISTIC
/begin CHARACTERISTIC CLnchCtrlTakeoffStBrkPedlPerc "Brake pedal percent treshold above which transition to TAKEOFF state is allowed" VALUE 1073885518 __SWord_Value 0 tPercent_100_S16 0.0 100.0 STEP_SIZE 1 /end CHARACTERISTIC
/begin CHARACTERISTIC CLnchCtrlAbortReqBrkPedlPerc "Brake pedal percent treshold below which launch control REQUEST is aborted" VALUE 1073885516 __SWord_Value 0 tPercent_100_S16 0.0 100.0 STEP_SIZE 1 /end CHARACTERISTIC
/begin CHARACTERISTIC CLnchCtrlAbortTakeoffBrkPedlPerc "Brake pedal percent treshold above which launch control TAKEOFF is aborted" VALUE 1073885514 __SWord_Value 0 tPercent_100_S16 0.0 100.0 STEP_SIZE 1 /end CHARACTERISTIC
/begin CHARACTERISTIC CLnchCtrlRegulateStAccrPedlPerc "Accelerator pedal percent treshold above which transition to REGULATE state is allowed" VALUE 1073885512 __SWord_Value 0 tPercent_100_S16 0.0 100.0 STEP_SIZE 1 /end CHARACTERISTIC
/begin CHARACTERISTIC CLnchCtrlAbortReqAccrPedlPerc "Accelerator pedal percent treshold below which Launch Control REQUEST is aborted" VALUE 1073885510 __SWord_Value 0 tPercent_100_S16 0.0 100.0 STEP_SIZE 1 /end CHARACTERISTIC
/begin CHARACTERISTIC CLnchCtrlAbortTakeoffAccrPedlPerc "Accelerator pedal percent treshold below which Launch Control TAKEOFF is aborted" VALUE 1073885508 __SWord_Value 0 tPercent_100_S16 0.0 100.0 STEP_SIZE 1 /end CHARACTERISTIC
/begin CHARACTERISTIC CLnchCtrlReqAllwdLsttOilTemp "Maximum LSTT Oil temperature to allow Launch Control" VALUE 1073885506 __SWord_Value 0 tCelsius_10_S16 -400.0 10000.0 STEP_SIZE 1 /end CHARACTERISTIC
/begin CHARACTERISTIC CLnchCtrlReqAllwdEngCooltTemp "Maximum Engine coolant temperature to allow Launch Control" VALUE 1073885504 __SWord_Value 0 tCelsius_10_S16 -400.0 10000.0 STEP_SIZE 1 /end CHARACTERISTIC
/begin CHARACTERISTIC CLnchCtrlReqAllwdInvCooltTemp "Maximum Inverter coolant temperature to allow Launch Control" VALUE 1073885502 __SWord_Value 0 tCelsius_10_S16 -400.0 10000.0 STEP_SIZE 1 /end CHARACTERISTIC
/begin CHARACTERISTIC CLnchCtrlReqAllwdEngIatTemp "Maximum Engine IAT to allow Launch Control" VALUE 1073885500 __SWord_Value 0 tCelsius_10_S16 -400.0 10000.0 STEP_SIZE 1 /end CHARACTERISTIC
/begin CHARACTERISTIC CLnchCtrlReqStTimeoutPerd "Maximum period launch control is allowed to stay in REQD state" VALUE 1073885496 __ULong_Value 0 tMillisecond_U32 0 3600000 STEP_SIZE 1 /end CHARACTERISTIC
/begin CHARACTERISTIC CLnchCtrlRegulateStTimeoutPerd "Maximum period launch control is allowed to stay in REGULATE state" VALUE 1073885492 __ULong_Value 0 tMillisecond_U32 0 3600000 STEP_SIZE 1 /end CHARACTERISTIC
/begin CHARACTERISTIC CLnchCtrlTakeoffStTimeoutPerd "Maximum period launch control is allowed to stay in TAKEOFF state" VALUE 1073885488 __ULong_Value 0 tMillisecond_U32 0 3600000 STEP_SIZE 1 /end CHARACTERISTIC
/begin CHARACTERISTIC CLnchCtrlStAbortPerd "Keep ABORTD state for CLnchCtrlStAbortPerd time" VALUE 1073885484 __ULong_Value 0 tMillisecond_U32 0 3600000 STEP_SIZE 1 /end CHARACTERISTIC
/begin CHARACTERISTIC CLnchCtrlRetryPerd "Discard any driver request for CLnchCtrlRetryPerd time after user aborts launch control" VALUE 1073885480 __ULong_Value 0 tMillisecond_U32 0 3600000 STEP_SIZE 1 /end CHARACTERISTIC
/begin CHARACTERISTIC CLnchCtrlInfoMsgPerd "Send out the launch control masks for CLnchCtrlInfoMsgPerd time" VALUE 1073885476 __ULong_Value 0 tMillisecond_U32 0 3600000 STEP_SIZE 1 /end CHARACTERISTIC
/begin CHARACTERISTIC CLnchCtrlPaddleReqDoublePressPerd "Time interval withing which a double press of up shift paddle is interpreted as launch control request" VALUE 1073885472 __ULong_Value 0 tMillisecond_U32 0 3600000 STEP_SIZE 1 /end CHARACTERISTIC
/begin CHARACTERISTIC CLnchCtrlPaddleHoldReqPerd "Hold launch control request using double paddle up press period" VALUE 1073885468 __ULong_Value 0 tMillisecond_U32 0 3600000 STEP_SIZE 1 /end CHARACTERISTIC
/begin CHARACTERISTIC CLiftBtnDebounceDuration "Lift button press debounce duration [ms]" VALUE 1073885464 __ULong_Value 0 tMillisecond_U32 0 3600000 STEP_SIZE 1 /end CHARACTERISTIC
/begin CHARACTERISTIC CTestAutoHillHoldSt "Auto hill hold state override" VALUE 1073885456 __ULong_Value 0 tAutoHillHoldState 0 7 STEP_SIZE 1 /end CHARACTERISTIC
/begin CHARACTERISTIC CTestAutoHillHoldSwtReq "Auto hold switch state override" VALUE 1073885452 __ULong_Value 0 tEnableState 0 3 STEP_SIZE 1 /end CHARACTERISTIC
/begin CHARACTERISTIC CTestAutoHillHoldBrkPReqEna "Brake pressure request enable in dev mode" VALUE 1073885450 __UByte_Value 0 NO_COMPU_METHOD 0 1 STEP_SIZE 1 FORMAT "%.2" /end CHARACTERISTIC
/begin CHARACTERISTIC CEngageHighLimit "Min current to consider ebrakes engaged. Used together with other requirements" VALUE 1073885382 __SWord_Value 0 tAmpere_100_S16 0.0 10000.0 STEP_SIZE 1 /end CHARACTERISTIC
/begin CHARACTERISTIC CEBrakeSMChangeDeadTime "Fast SM change prevention. Dead time between SM changes" VALUE 1073885352 __ULong_Value 0 tMillisecond_U32 0 3600000 STEP_SIZE 1 /end CHARACTERISTIC
/begin CHARACTERISTIC CMaxEBrakePWM "Max PWM to use in ebrakes (DO NOT change in execution)" VALUE 1073885348 __UWord_Value 0 NO_COMPU_METHOD 0 65535 STEP_SIZE 1 FORMAT "%.0" /end CHARACTERISTIC
/begin CHARACTERISTIC CHighEBrakePWM "Constant high PWM" VALUE 1073885346 __UWord_Value 0 NO_COMPU_METHOD 0 65535 STEP_SIZE 1 FORMAT "%.0" /end CHARACTERISTIC
/begin CHARACTERISTIC CFaultsDisTimeoutChkCanA "Disable timeout check for bus A (main_bus) messages" VALUE 1073885345 __UByte_Value 0 NO_COMPU_METHOD 0 1 STEP_SIZE 1 FORMAT "%.2" /end CHARACTERISTIC
/begin CHARACTERISTIC CFaultsDisTimeoutChkCanB "Disable timeout check for bus B (dynamic_systems1_bus) messages" VALUE 1073885344 __UByte_Value 0 NO_COMPU_METHOD 0 1 STEP_SIZE 1 FORMAT "%.2" /end CHARACTERISTIC
/begin CHARACTERISTIC CFaultsDisTimeoutChkCanC "Disable timeout check for bus C (powertrain_bus) messages" VALUE 1073885343 __UByte_Value 0 NO_COMPU_METHOD 0 1 STEP_SIZE 1 FORMAT "%.2" /end CHARACTERISTIC
/begin CHARACTERISTIC CFaultsDisTimeoutChkCanD "Disable timeout check for bus D (inverter_bus) messages" VALUE 1073885342 __UByte_Value 0 NO_COMPU_METHOD 0 1 STEP_SIZE 1 FORMAT "%.2" /end CHARACTERISTIC
/begin CHARACTERISTIC CFaultsDisTimeoutChkCanE "Disable timeout check for bus E (gvcu_logger_bus) messages" VALUE 1073885341 __UByte_Value 0 NO_COMPU_METHOD 0 1 STEP_SIZE 1 FORMAT "%.2" /end CHARACTERISTIC
/begin CHARACTERISTIC CFaultsDisTimeoutChkCanF "Disable timeout check for bus F (dynamic_systems2_bus) messages" VALUE 1073885340 __UByte_Value 0 NO_COMPU_METHOD 0 1 STEP_SIZE 1 FORMAT "%.2" /end CHARACTERISTIC
/begin CHARACTERISTIC CFaultsWakeupPerd "Nodes wakeup period, no timeout will be registered in this period [ms]" VALUE 1073885336 __ULong_Value 0 tMillisecond_U32 0 20000 STEP_SIZE 1 /end CHARACTERISTIC
/begin CHARACTERISTIC CFaultsNodeTimeoutHealPerd "Heal node timeout only after a predefined period, Otherwise one message not in timeout of that node will reset the node timeout" VALUE 1073885332 __ULong_Value 0 tMillisecond_U32 0 10000 STEP_SIZE 1 /end CHARACTERISTIC
/begin CHARACTERISTIC CSpdSnsrFrntZeroDetectTimeout "Timeout duration after the last detected tooth to consider speed readings as 0, front outer clutch [ms]" VALUE 1073885328 __ULong_Value 0 tMillisecond_U32 0 400 STEP_SIZE 10 /end CHARACTERISTIC
/begin CHARACTERISTIC CSpdSnsrRearZeroDetectTimeout "Timeout duration after the last detected tooth to consider speed readings as 0, rear outer clutch [ms]" VALUE 1073885324 __ULong_Value 0 tMillisecond_U32 0 400 STEP_SIZE 10 /end CHARACTERISTIC
/begin CHARACTERISTIC CSpdSnsrFrntAxleZeroDetectTimeout "Timeout duration after the last detected tooth to consider speed readings as 0, front axle speed [ms]" VALUE 1073885312 __ULong_Value 0 tMillisecond_U32 0 400 STEP_SIZE 10 /end CHARACTERISTIC
/begin CHARACTERISTIC CSpdSnsrFrntAxleSign "Front axle speed sensor sign direction" VALUE 1073885308 __SLong_Value 0 tSign -1 1 STEP_SIZE 2 /end CHARACTERISTIC
/begin CHARACTERISTIC CSpdSnsrFrntAxleManShutoff "Manually disable the use of the front axle speed sensor" VALUE 1073885304 __UByte_Value 0 NO_COMPU_METHOD 0 1 STEP_SIZE 1 FORMAT "%.2" /end CHARACTERISTIC
/begin CHARACTERISTIC CSpdSnsrRedundancyThd "Speed sensor diagnostics threshold - redundancy check error limit [rad/s]" VALUE 1073885296 __Float32_Value 0 tRadianPerSecond 0.1 10.0 STEP_SIZE 1 /end CHARACTERISTIC
/begin CHARACTERISTIC CSpdSnsrDirBitFailThd "Speed sensor diagnostics threshold - direction bit failure consecutive count" VALUE 1073885292 __UByte_Value 0 NO_COMPU_METHOD 1 10 STEP_SIZE 1 FORMAT "%.0" /end CHARACTERISTIC
/begin CHARACTERISTIC CSpdSnsrRedundancyFaultTime "Speed sensor diagnostics debounce time for redundancy checks [ms]" VALUE 1073885288 __ULong_Value 0 tMillisecond_U32 10 500 STEP_SIZE 1 /end CHARACTERISTIC
/begin CHARACTERISTIC CSpdSnsrRedundancyHealTime "Speed sensor diagnostics healing debounce time [ms]" VALUE 1073885284 __ULong_Value 0 tMillisecond_U32 100 2000 STEP_SIZE 1 /end CHARACTERISTIC
/begin CHARACTERISTIC CSpdSnsrNoChgCntThd "Speed sensor diagnostics threshold - no event count change cycles for channel failure" VALUE 1073885280 __UByte_Value 0 NO_COMPU_METHOD 5 50 STEP_SIZE 1 FORMAT "%.0" /end CHARACTERISTIC
/begin CHARACTERISTIC CSpdSnsrMinSpdDiagChk "Speed sensor diagnostics minimum speed for diagnostic checks [rad/s]" VALUE 1073885276 __Float32_Value 0 tRadianPerSecond 0.5 5.0 STEP_SIZE 1 /end CHARACTERISTIC
/begin CHARACTERISTIC CSpdSnsrDirBitHealTime "Speed sensor diagnostics direction bit fault healing time [ms]" VALUE 1073885272 __ULong_Value 0 tMillisecond_U32 1000 30000 STEP_SIZE 1 /end CHARACTERISTIC
/begin CHARACTERISTIC CSpdSnsrChnFaultHealTime "Speed sensor diagnostics channel fault healing time [ms]" VALUE 1073885268 __ULong_Value 0 tMillisecond_U32 1000 30000 STEP_SIZE 1 /end CHARACTERISTIC
/begin CHARACTERISTIC CEnaVecTqCooltSnsrCircDiag "Enable vector torque coolant temperature sensor circuit diagnostic" VALUE 1073885267 __UByte_Value 0 NO_COMPU_METHOD 0 1 STEP_SIZE 1 FORMAT "%.2" /end CHARACTERISTIC
/begin CHARACTERISTIC CEnaVecTqCooltSnsrOorDiag "Enable vector torque coolant temperature sensor out-of-range diagnostic" VALUE 1073885266 __UByte_Value 0 NO_COMPU_METHOD 0 1 STEP_SIZE 1 FORMAT "%.2" /end CHARACTERISTIC
/begin CHARACTERISTIC CEnaEmotCooltSnsrCircDiag "Enable e-motor  coolant temperature sensor circuit diagnostic" VALUE 1073885265 __UByte_Value 0 NO_COMPU_METHOD 0 1 STEP_SIZE 1 FORMAT "%.2" /end CHARACTERISTIC
/begin CHARACTERISTIC CEnaEmotCooltSnsrOorDiag "Enable e-motor coolant temperature sensor out-of-range diagnostic" VALUE 1073885264 __UByte_Value 0 NO_COMPU_METHOD 0 1 STEP_SIZE 1 FORMAT "%.2" /end CHARACTERISTIC
/begin CHARACTERISTIC CPressSnsrCalDuration "Duration to calibrate sensors" VALUE 1073885260 __ULong_Value 0 tMillisecond_U32 0 3600000 STEP_SIZE 1 /end CHARACTERISTIC
/begin CHARACTERISTIC CPressSnsrCalInterval "Interval to calibrate analog sensor" VALUE 1073885256 __ULong_Value 0 tMillisecond_U32 0 3600000 STEP_SIZE 1 /end CHARACTERISTIC
/begin CHARACTERISTIC CPressSnsrCalPostUse "delay until calibration of sensor is started after it isnt used anymore" VALUE 1073885252 __ULong_Value 0 tMillisecond_U32 0 3600000 STEP_SIZE 1 /end CHARACTERISTIC
/begin CHARACTERISTIC CPressSnsrCalPressTh "Pressure threshold under which sensor calibration is running" VALUE 1073885248 __Float32_Value 0 tBar -1 1000 STEP_SIZE 1 /end CHARACTERISTIC
/begin CHARACTERISTIC CPressSnsrCalHiPThMin "Minimum high pressure circuit pressure to calibrate pressure sensor" VALUE 1073885244 __SWord_Value 0 tBar_100_S16 -1.0 1000.0 STEP_SIZE 1 /end CHARACTERISTIC
/begin CHARACTERISTIC CPressSnsrCalHiPThMax "Maximum high pressure circuit pressure to calibrate pressure sensor" VALUE 1073885242 __SWord_Value 0 tBar_100_S16 -1.0 1000.0 STEP_SIZE 1 /end CHARACTERISTIC
/begin CHARACTERISTIC CPressSnsrOffsetMax "Pressure Sensor Maximum Allowed Offset" VALUE 1073885240 __SWord_Value 0 tBar_100_S16 -1.0 1000.0 STEP_SIZE 1 /end CHARACTERISTIC
/begin CHARACTERISTIC CVecTqCooltSnsrAmphenolRsTab "Amphenol GE-2099 temperature sensor voltage divider resistance" VALUE 1073885236 __Float32_Value 0 tOhm 0 2000000 STEP_SIZE 1 /end CHARACTERISTIC
/begin CHARACTERISTIC CEmotCooltSnsrAmphenolRsTab "Amphenol GE-2098 e-motor temperature sensor voltage divider resistance" VALUE 1073885232 __Float32_Value 0 tOhm 0 2000000 STEP_SIZE 1 /end CHARACTERISTIC
/begin CHARACTERISTIC CTestEBrakeCalibInhibPerd "E-Brakes Wakeup time where calibration is inhibited [ms]" VALUE 1073885024 __ULong_Value 0 tMillisecond_U32 0 3600000 STEP_SIZE 1 /end CHARACTERISTIC
/begin CHARACTERISTIC CInvCmdTimeout "Inverter command timeout [ms]" VALUE 1073885012 __ULong_Value 0 tMillisecond_U32 0 3600000 STEP_SIZE 1 /end CHARACTERISTIC
/begin CHARACTERISTIC CInverterMotorSpinningDirection "Motor spinning direction" VALUE 1073885011 __UByte_Value 0 NO_COMPU_METHOD 0 1 STEP_SIZE 1 FORMAT "%.2" /end CHARACTERISTIC
/begin CHARACTERISTIC CInvSpdCtrlModEna "Inverter speed control enable" VALUE 1073885010 __UByte_Value 0 NO_COMPU_METHOD 0 1 STEP_SIZE 1 FORMAT "%.2" /end CHARACTERISTIC
/begin CHARACTERISTIC CInverterCurrentTqLimFiltCoeff "Motor speed filter for input to max torque calc" VALUE 1073884776 __Float32_Value 0 NO_COMPU_METHOD -3.40282346639E+38 3.40282346639E+38 STEP_SIZE 1 FORMAT "%.6" /end CHARACTERISTIC
/begin CHARACTERISTIC CElecMotMaxSpd "Maximum allowed e-motor speed [rpm]" VALUE 1073884774 __SWord_Value 0 tRevolutionPerMinute_S16 0 30000 STEP_SIZE 100 /end CHARACTERISTIC
/begin CHARACTERISTIC CElecMotMinSpeedCalculation "Minimum emotor speed for torque estimation at low/zero spped [rpm]" VALUE 1073884772 __SWord_Value 0 tRevolutionPerMinute_S16 0 500 STEP_SIZE 1 /end CHARACTERISTIC
/begin CHARACTERISTIC CElectMotEff "Static emotor efficiency, when not using map function of speed and torque" VALUE 1073884768 __Float32_Value 0 NO_COMPU_METHOD 0 1 STEP_SIZE 0.01 FORMAT "%.6" /end CHARACTERISTIC
/begin CHARACTERISTIC CPwrCorrHyst "Power correction hysteresis" VALUE 1073883568 __Float32_Value 0 tKilowatt -100 100 STEP_SIZE 10 /end CHARACTERISTIC
/begin CHARACTERISTIC CPwrCorrThr "Power correction threshold" VALUE 1073883564 __Float32_Value 0 tKilowatt -100 100 STEP_SIZE 10 /end CHARACTERISTIC
/begin CHARACTERISTIC CEmotorTorqueRampUp "Torque ramp-up rate limit [Nm/s]" VALUE 1073883560 __Float32_Value 0 NO_COMPU_METHOD 0 1000 STEP_SIZE 1 FORMAT "%.6" /end CHARACTERISTIC
/begin CHARACTERISTIC CEmotorTorqueRampDown "Torque ramp-down rate limit [Nm/s]" VALUE 1073883556 __Float32_Value 0 NO_COMPU_METHOD 0 1000 STEP_SIZE 1 FORMAT "%.6" /end CHARACTERISTIC
/begin CHARACTERISTIC CVirtualSocInit "SoC init" VALUE 1073883552 __Float32_Value 0 NO_COMPU_METHOD 0 1 STEP_SIZE 0.05 FORMAT "%.6" /end CHARACTERISTIC
/begin CHARACTERISTIC CVirtualSocInitPrc "SoC init" VALUE 1073883548 __SByte_Value 0 tPercent_S8 0 100 STEP_SIZE 1 /end CHARACTERISTIC
/begin CHARACTERISTIC CVirtualSocMax "Virtual battery SoC max" VALUE 1073883544 __Float32_Value 0 NO_COMPU_METHOD 0 1 STEP_SIZE 0.05 FORMAT "%.6" /end CHARACTERISTIC
/begin CHARACTERISTIC CVirtualSocMin "Virtual battery SoC min" VALUE 1073883540 __Float32_Value 0 NO_COMPU_METHOD 0 1 STEP_SIZE 0.05 FORMAT "%.6" /end CHARACTERISTIC
/begin CHARACTERISTIC CVirtualBattCp "Virtual batttery capacity [Ah]" VALUE 1073883536 __Float32_Value 0 tAmpereHour 0 100 STEP_SIZE 1 /end CHARACTERISTIC
/begin CHARACTERISTIC CVirtualBattSoh "Virtual batttery SoH [%]" VALUE 1073883532 __SByte_Value 0 tPercent_S8 0 100 STEP_SIZE 1 /end CHARACTERISTIC
/begin CHARACTERISTIC CVirtualBattAvlDchaCrnt "Max discharge current for virtual battery [A]" VALUE 1073883528 __Float32_Value 0 tKilowattHour 0 1000 STEP_SIZE 10 /end CHARACTERISTIC
/begin CHARACTERISTIC CVirtualBattAvlChrgCrnt "Max charge current for virtual battery [A]" VALUE 1073883524 __Float32_Value 0 tKilowattHour 0 1000 STEP_SIZE 10 /end CHARACTERISTIC
/begin CHARACTERISTIC CVirtualBattNomVltg "Virtual batttery nominal voltage [V]" VALUE 1073883520 __Float32_Value 0 tVolt 0 1000 STEP_SIZE 1 /end CHARACTERISTIC
/begin CHARACTERISTIC CVirtualBattIntR "Virtual batttery internal resistance [ohms]" VALUE 1073883516 __Float32_Value 0 NO_COMPU_METHOD 0 1000 STEP_SIZE 0.1 FORMAT "%.6" /end CHARACTERISTIC
/begin CHARACTERISTIC CVirtualBattMaxDchaCrnt "Virtual batttery max discharge current [A]" VALUE 1073883512 __Float32_Value 0 tAmpere 0 1000 STEP_SIZE 10 /end CHARACTERISTIC
/begin CHARACTERISTIC CVirtualBattMaxChrgCrnt "Virtual batttery max charge current [A]" VALUE 1073883508 __Float32_Value 0 tAmpere 0 1000 STEP_SIZE 10 /end CHARACTERISTIC
/begin CHARACTERISTIC CElecEffChrg "Electric path efficiency in charge" VALUE 1073883416 __Float32_Value 0 NO_COMPU_METHOD 0.0 1.0 STEP_SIZE 0.050 FORMAT "%.6" /end CHARACTERISTIC
/begin CHARACTERISTIC CElecEffDcha "Electric path efficiency in discharge" VALUE 1073883412 __Float32_Value 0 NO_COMPU_METHOD 0.0 1.0 STEP_SIZE 0.05 FORMAT "%.6" /end CHARACTERISTIC
/begin CHARACTERISTIC CVirtualBattEnbl "Virtual battery enabler" VALUE 1073883408 __Float32_Value 0 NO_COMPU_METHOD 0 1 STEP_SIZE 1 FORMAT "%.6" /end CHARACTERISTIC
/begin CHARACTERISTIC CSocOverrideDyno "Soc  constant override for dyno" VALUE 1073883404 __SByte_Value 0 tPercent_S8 0 100 STEP_SIZE 5 /end CHARACTERISTIC
/begin CHARACTERISTIC CSoeOverrideDyno "Soe constant override for dyno" VALUE 1073883400 __Float32_Value 0 tKilowattHour 0 100 STEP_SIZE 5 /end CHARACTERISTIC
/begin CHARACTERISTIC CInvGainIdle "Inverter speed control gain set for hybrid idle" VALUE 1073883396 __ULong_Value 0 tInvSpdCtrlGainSet 0 7 STEP_SIZE 1 /end CHARACTERISTIC
/begin CHARACTERISTIC CInvGainCrk "Inverter speed control gain set for cranking" VALUE 1073883392 __ULong_Value 0 tInvSpdCtrlGainSet 0 7 STEP_SIZE 1 /end CHARACTERISTIC
/begin CHARACTERISTIC CInvGainElecDrv "Inverter speed control gain set for electric drive" VALUE 1073883388 __ULong_Value 0 tInvSpdCtrlGainSet 0 7 STEP_SIZE 1 /end CHARACTERISTIC
/begin CHARACTERISTIC CInvGainPumpCtrl "Inverter speed control gain set for propshaft pump control" VALUE 1073883384 __ULong_Value 0 tInvSpdCtrlGainSet 0 7 STEP_SIZE 1 /end CHARACTERISTIC
/begin CHARACTERISTIC CInvGainDft "Default inverter speed control gain set" VALUE 1073883380 __ULong_Value 0 tInvSpdCtrlGainSet 0 7 STEP_SIZE 1 /end CHARACTERISTIC
/begin CHARACTERISTIC CSocMax "Soc max to avoid overcurrent" VALUE 1073883376 __Float32_Value 0 tPercent 0 100 STEP_SIZE 1 /end CHARACTERISTIC
/begin CHARACTERISTIC CSocMin "Soc min to allow exit from charging if user requests" VALUE 1073883372 __Float32_Value 0 tPercent 0 100 STEP_SIZE 1 /end CHARACTERISTIC
/begin CHARACTERISTIC CSocDeplThd "Soc level for transition to depletion mode" VALUE 1073883368 __Float32_Value 0 tPercent 0 100 STEP_SIZE 1 /end CHARACTERISTIC
/begin CHARACTERISTIC CSocSustTar "Soc sustain target" VALUE 1073883364 __Float32_Value 0 tPercent 0 100 STEP_SIZE 1 /end CHARACTERISTIC
/begin CHARACTERISTIC CSocSustDropGain "Factor to scale down correction inside the band" VALUE 1073883360 __Float32_Value 0 NO_COMPU_METHOD 0 100 STEP_SIZE 1 FORMAT "%.6" /end CHARACTERISTIC
/begin CHARACTERISTIC CSocSustHigh "Soc Sustain high threshold" VALUE 1073883356 __Float32_Value 0 tPercent 0 100 STEP_SIZE 1 /end CHARACTERISTIC
/begin CHARACTERISTIC CSocSustLow "Soc Sustain low threshold" VALUE 1073883352 __Float32_Value 0 tPercent 0 100 STEP_SIZE 1 /end CHARACTERISTIC
/begin CHARACTERISTIC CSocChrgThd "Soc level for transition to charging mode when hybrid idle" VALUE 1073883348 __Float32_Value 0 tPercent 0 100 STEP_SIZE 1 /end CHARACTERISTIC
/begin CHARACTERISTIC CSocHyst "Soc hysteresis" VALUE 1073883344 __Float32_Value 0 tPercent 0 100 STEP_SIZE 1 /end CHARACTERISTIC
/begin CHARACTERISTIC CSocCorrnFltCoeff "LPF coefficient for soc power correction" VALUE 1073883332 __Float32_Value 0 NO_COMPU_METHOD 0 100 STEP_SIZE 1 FORMAT "%.6" /end CHARACTERISTIC
/begin CHARACTERISTIC CSustEgyMgrPidKd "Derivative gain for SoC charge-sustaining PID controller" VALUE 1073883328 __Float32_Value 0 NO_COMPU_METHOD -1000 1000.0 STEP_SIZE 0.01 FORMAT "%.6" /end CHARACTERISTIC
/begin CHARACTERISTIC CSustEgyMgrPidKp "Proportional gain for SoC charge-sustaining PID controller" VALUE 1073883324 __Float32_Value 0 NO_COMPU_METHOD -1000 1000.0 STEP_SIZE 0.01 FORMAT "%.6" /end CHARACTERISTIC
/begin CHARACTERISTIC CSustEgyMgrPidKi "Integral gain for SoC charge-sustaining PID controller" VALUE 1073883320 __Float32_Value 0 NO_COMPU_METHOD -1000 1000.0 STEP_SIZE 0.01 FORMAT "%.6" /end CHARACTERISTIC
/begin CHARACTERISTIC CIntgResetOnSignFlip "Sustain integral reset for error sign flip [0..1] 0=total reset 0.3=cut 30%" VALUE 1073882072 __Float32_Value 0 NO_COMPU_METHOD 0 1 STEP_SIZE 1 FORMAT "%.6" /end CHARACTERISTIC
/begin CHARACTERISTIC CSignFlipDeadband "Delta Soc deadband for sign flip" VALUE 1073882068 __Float32_Value 0 NO_COMPU_METHOD 0 1 STEP_SIZE 1 FORMAT "%.6" /end CHARACTERISTIC
/begin CHARACTERISTIC CEgyMgrPidIntglMax "Max integral term limit for SoC sustain PID controller [kW]" VALUE 1073882064 __Float32_Value 0 NO_COMPU_METHOD -1000 1000 STEP_SIZE 10 FORMAT "%.6" /end CHARACTERISTIC
/begin CHARACTERISTIC CEgyMgrPidIntglMin "Max integral term limit for SoC sustain PID controller [kW]" VALUE 1073882060 __Float32_Value 0 NO_COMPU_METHOD -1000 1000 STEP_SIZE 10 FORMAT "%.6" /end CHARACTERISTIC
/begin CHARACTERISTIC CPwrCorrnMax "Max feedback correction power for SoC sustain PID controller [kW]" VALUE 1073882056 __Float32_Value 0 tKilowatt -5000 5000 STEP_SIZE 10 /end CHARACTERISTIC
/begin CHARACTERISTIC CPwrCorrnMin "Min feedback correction power for SoC sustain PID controller [kW]" VALUE 1073882052 __Float32_Value 0 tKilowatt -5000 5000 STEP_SIZE 10 /end CHARACTERISTIC
/begin CHARACTERISTIC CSocSoftLow "Low Soc soft threshold" VALUE 1073882048 __Float32_Value 0 tPercent 0 100 STEP_SIZE 5 /end CHARACTERISTIC
/begin CHARACTERISTIC CSocSoftHigh "High Soc soft threshold" VALUE 1073882044 __Float32_Value 0 tPercent 0 100 STEP_SIZE 5 /end CHARACTERISTIC
/begin CHARACTERISTIC CSocLow "Low Soc threshold" VALUE 1073882040 __Float32_Value 0 tPercent 0 100 STEP_SIZE 5 /end CHARACTERISTIC
/begin CHARACTERISTIC CSocHigh "High Soc threshold" VALUE 1073882036 __Float32_Value 0 tPercent 0 100 STEP_SIZE 5 /end CHARACTERISTIC
/begin CHARACTERISTIC CThetaMax "Calibration factor for the adaptive equivalence factor calculation" VALUE 1073882032 __Float32_Value 0 NO_COMPU_METHOD 0 1 STEP_SIZE 0.1 FORMAT "%.6" /end CHARACTERISTIC
/begin CHARACTERISTIC CMu "Scaling gain for the adaptive equivalence factor calculation" VALUE 1073882028 __Float32_Value 0 NO_COMPU_METHOD 0 1 STEP_SIZE 0.1 FORMAT "%.6" /end CHARACTERISTIC
/begin CHARACTERISTIC CIceOptPwr "Ice optimum constant power" VALUE 1073882024 __Float32_Value 0 tKilowatt 0 1000 STEP_SIZE 10 /end CHARACTERISTIC
/begin CHARACTERISTIC CPowerSplitStrategy "To enable a static power split or the ECMS strategy" VALUE 1073881972 __ULong_Value 0 tPowerSplitStartegy 0 10 STEP_SIZE 0.00001 /end CHARACTERISTIC
/begin CHARACTERISTIC CTransientPwrGradThr "Power request gradient threshold to detect transient phase" VALUE 1073881956 __Float32_Value 0 tKilowatt 0 100000 STEP_SIZE 1 /end CHARACTERISTIC
/begin CHARACTERISTIC CTransientAccThr "Accelerattion threshold to detect transient phase" VALUE 1073881952 __Float32_Value 0 tMetrePerSquareSecond 0 100 STEP_SIZE 1 /end CHARACTERISTIC
/begin CHARACTERISTIC CRegimePwrThr "Power threshold to detect regime phase" VALUE 1073881948 __Float32_Value 0 tKilowatt 0 1000 STEP_SIZE 1 /end CHARACTERISTIC
/begin CHARACTERISTIC CRegimeAccThr "Acceleration threshold to detect regime phase" VALUE 1073881944 __Float32_Value 0 tMetrePerSquareSecond 0 1000 STEP_SIZE 1 /end CHARACTERISTIC
/begin CHARACTERISTIC CRegimePwrGradThr "Power request gradient threshold to detect regime phase" VALUE 1073881940 __Float32_Value 0 tKilowatt 0 1000000 STEP_SIZE 1 /end CHARACTERISTIC
/begin CHARACTERISTIC CIdleSpdThr "Speed threshold to detect idle phase" VALUE 1073881936 __Float32_Value 0 tMetrePerSecond 0 100 STEP_SIZE 0.1 /end CHARACTERISTIC
/begin CHARACTERISTIC CIdlePwrReqThr "Power request threshold to detect idle phase" VALUE 1073881932 __Float32_Value 0 tKilowatt 0 100 STEP_SIZE 1 /end CHARACTERISTIC
/begin CHARACTERISTIC CIdleAccThr "Acceleration threshold to detect idle phase" VALUE 1073881928 __Float32_Value 0 tMetrePerSquareSecond 0 100 STEP_SIZE 0.1 /end CHARACTERISTIC
/begin CHARACTERISTIC CSustEgyMgrPidGainBlend "Charge-sustaning pid gains filter coefficient" VALUE 1073881924 __Float32_Value 0 NO_COMPU_METHOD 0 100 STEP_SIZE 0.1 FORMAT "%.6" /end CHARACTERISTIC
/begin CHARACTERISTIC CSustainFltCoeff "Sustain filter coefficent" VALUE 1073881916 __Float32_Value 0 NO_COMPU_METHOD 0 100 STEP_SIZE 0.1 FORMAT "%.6" /end CHARACTERISTIC
/begin CHARACTERISTIC CPwrReqStatyThr "Request power threshold to detect staty condition" VALUE 1073881912 __Float32_Value 0 tKilowatt 0 100 STEP_SIZE 0.1 /end CHARACTERISTIC
/begin CHARACTERISTIC CEnblDecoupleEgyStgy "Enable decouple ice command to torque manager" VALUE 1073881910 __UByte_Value 0 NO_COMPU_METHOD 0 1 STEP_SIZE 1 FORMAT "%.2" /end CHARACTERISTIC
/begin CHARACTERISTIC CEnblDecoupleIdleEgyStgy "Enable decouple ice command to torque manager in idle" VALUE 1073881909 __UByte_Value 0 NO_COMPU_METHOD 0 1 STEP_SIZE 1 FORMAT "%.2" /end CHARACTERISTIC
/begin CHARACTERISTIC CEnblDecoupleLightOffEgyStgy "Enable decouple ice command to torque manager when in lightoff" VALUE 1073881908 __UByte_Value 0 NO_COMPU_METHOD 0 1 STEP_SIZE 1 FORMAT "%.2" /end CHARACTERISTIC
/begin CHARACTERISTIC CSocBandDecoupleIdle "Delta soc threshold to allow dercouple in idle" VALUE 1073881904 __Float32_Value 0 NO_COMPU_METHOD 0 1 STEP_SIZE 0.1 FORMAT "%.6" /end CHARACTERISTIC
/begin CHARACTERISTIC CSocBandRecoupleIdle "Delta soc threshold to command recouple in idle" VALUE 1073881900 __Float32_Value 0 NO_COMPU_METHOD 0 1 STEP_SIZE 0.1 FORMAT "%.6" /end CHARACTERISTIC
/begin CHARACTERISTIC CEmaCoeff "Exponential Moving Average (EMA) coefficient  (2/(N+1) with N = 500 samples (50000))" VALUE 1073881896 __Float32_Value 0 NO_COMPU_METHOD 0 10 STEP_SIZE 0.00001 FORMAT "%.6" /end CHARACTERISTIC
/begin CHARACTERISTIC CElecMotChrgPwrMax "Max charge power demand" VALUE 1073881892 __Float32_Value 0 NO_COMPU_METHOD -500 500 STEP_SIZE 5 FORMAT "%.6" /end CHARACTERISTIC
/begin CHARACTERISTIC CElecMotChrgPwrMin "Min charge power demand" VALUE 1073881888 __Float32_Value 0 NO_COMPU_METHOD -500 500 STEP_SIZE 5 FORMAT "%.6" /end CHARACTERISTIC
/begin CHARACTERISTIC CElecMotChrgPwr "Charge power demand" VALUE 1073881884 __Float32_Value 0 NO_COMPU_METHOD 0 500 STEP_SIZE 5 FORMAT "%.6" /end CHARACTERISTIC
/begin CHARACTERISTIC CEnblFilEgyMgrTqDmd "Enable filter on energy manager electric toruqe demand" VALUE 1073881880 __Float32_Value 0 NO_COMPU_METHOD 0 1 STEP_SIZE 1 FORMAT "%.6" /end CHARACTERISTIC
/begin CHARACTERISTIC CEgyMgrTqDmdFilCoeff "Electric torque demand filter coefficient" VALUE 1073881876 __Float32_Value 0 NO_COMPU_METHOD 0.0 1.0 STEP_SIZE 0.001 FORMAT "%.6" /end CHARACTERISTIC
/begin CHARACTERISTIC CEnblEgyMgrTqDmdRampLim "Enable ramp limiter on energy manager electric toruqe demand" VALUE 1073881872 __Float32_Value 0 NO_COMPU_METHOD 0 1 STEP_SIZE 1 FORMAT "%.6" /end CHARACTERISTIC
/begin CHARACTERISTIC CIceLightoffReqPrc "Ice request to detect lighoff complete" VALUE 1073881868 __SByte_Value 0 tPercent_S8 0 100 STEP_SIZE 10 /end CHARACTERISTIC
/begin CHARACTERISTIC CPropshRateIdle "Prop shaft rate threshold to detect idle" VALUE 1073881864 __Float32_Value 0 tRadianPerSecond 0 100 STEP_SIZE 10 /end CHARACTERISTIC
/begin CHARACTERISTIC CEnblEvBoost "Enable EV boost to held ice when CS mode" VALUE 1073881860 __UByte_Value 0 NO_COMPU_METHOD 0 1 STEP_SIZE 1 FORMAT "%.2" /end CHARACTERISTIC
/begin CHARACTERISTIC CEvBoostPwrMax "Max instantaneous boost power [kW]" VALUE 1073881856 __Float32_Value 0 NO_COMPU_METHOD 0 500 STEP_SIZE 1 FORMAT "%.6" /end CHARACTERISTIC
/begin CHARACTERISTIC CEvBoostRateUp "Boost power ramp up/down rate [kW/s]" VALUE 1073881852 __Float32_Value 0 NO_COMPU_METHOD -1000 1000 STEP_SIZE 1 FORMAT "%.6" /end CHARACTERISTIC
/begin CHARACTERISTIC CEvBoostRateDn "Boost power ramp up/down rate [kW/s]" VALUE 1073881848 __Float32_Value 0 NO_COMPU_METHOD -1000 1000 STEP_SIZE 1 FORMAT "%.6" /end CHARACTERISTIC
/begin CHARACTERISTIC CEvBoostHeadRef "Boost power available factor" VALUE 1073881844 __Float32_Value 0 NO_COMPU_METHOD -1000 1000 STEP_SIZE 1 FORMAT "%.6" /end CHARACTERISTIC
/begin CHARACTERISTIC CEvBoostPdotRef "Power gradient available factor" VALUE 1073881840 __Float32_Value 0 NO_COMPU_METHOD -1000 1000 STEP_SIZE 1 FORMAT "%.6" /end CHARACTERISTIC
/begin CHARACTERISTIC CEvBoostWallet "Extra boost energy buffer  [kWh]" VALUE 1073881836 __Float32_Value 0 NO_COMPU_METHOD -1000 1000 STEP_SIZE 1 FORMAT "%.6" /end CHARACTERISTIC
/begin CHARACTERISTIC CEvBoostWalletTau "Min time to use energy boost buffer [s]" VALUE 1073881832 __Float32_Value 0 NO_COMPU_METHOD -1000 1000 STEP_SIZE 1 FORMAT "%.6" /end CHARACTERISTIC
/begin CHARACTERISTIC CEvBoostRechargeGain "FF fraction to recharge the wallet" VALUE 1073881828 __Float32_Value 0 NO_COMPU_METHOD -1000 1000 STEP_SIZE 1 FORMAT "%.6" /end CHARACTERISTIC
/begin CHARACTERISTIC CReecTarget "Reec threshold to ensure end of depletion cycle" VALUE 1073881824 __Float32_Value 0 NO_COMPU_METHOD 0 10 STEP_SIZE 1 FORMAT "%.6" /end CHARACTERISTIC
/begin CHARACTERISTIC CEgyMgrRegenPwrMargin "Regen power margin" VALUE 1073881816 __Float32_Value 0 tKilowatt 0 500 STEP_SIZE 1 /end CHARACTERISTIC
/begin CHARACTERISTIC COvrdLiftCtrlEna "Enable lift system override" VALUE 1073881815 __UByte_Value 0 NO_COMPU_METHOD 0 1 STEP_SIZE 1 FORMAT "%.2" /end CHARACTERISTIC
/begin CHARACTERISTIC COvrdLiftCtrlFL "" VALUE 1073881814 __UByte_Value 0 NO_COMPU_METHOD 0 255 STEP_SIZE 1 FORMAT "%.0" /end CHARACTERISTIC
/begin CHARACTERISTIC COvrdLiftCtrlFR "" VALUE 1073881813 __UByte_Value 0 NO_COMPU_METHOD 0 255 STEP_SIZE 1 FORMAT "%.0" /end CHARACTERISTIC
/begin CHARACTERISTIC COvrdLiftCtrlRL "" VALUE 1073881812 __UByte_Value 0 NO_COMPU_METHOD 0 255 STEP_SIZE 1 FORMAT "%.0" /end CHARACTERISTIC
/begin CHARACTERISTIC COvrdLiftCtrlRR "" VALUE 1073881811 __UByte_Value 0 NO_COMPU_METHOD 0 255 STEP_SIZE 1 FORMAT "%.0" /end CHARACTERISTIC
/begin CHARACTERISTIC CTestLiftBtn "Testbit to emulate lift button" VALUE 1073881810 __UByte_Value 0 NO_COMPU_METHOD 0 1 STEP_SIZE 1 FORMAT "%.2" /end CHARACTERISTIC
/begin CHARACTERISTIC CRideHeiRollCompEna "Roll compensation enable bit [bool]" VALUE 1073881640 __UByte_Value 0 NO_COMPU_METHOD 0 1 STEP_SIZE 1 FORMAT "%.2" /end CHARACTERISTIC
/begin CHARACTERISTIC CRideHeiRollCompLatAccThd "Lateral acceleration threshold for roll compensation [m/s²]" VALUE 1073881636 __Float32_Value 0 tMetrePerSquareSecond -50 50 STEP_SIZE 1 /end CHARACTERISTIC
/begin CHARACTERISTIC CTestAllowRideHeightWithIgnOff "" VALUE 1073881583 __UByte_Value 0 NO_COMPU_METHOD 0 1 STEP_SIZE 1 FORMAT "%.2" /end CHARACTERISTIC
/begin CHARACTERISTIC CTest_cycleRideHeight "" VALUE 1073881582 __UByte_Value 0 NO_COMPU_METHOD 0 1 STEP_SIZE 1 FORMAT "%.2" /end CHARACTERISTIC
/begin CHARACTERISTIC CRideHeightLiftDwnFrnt "Front axle ride height when in Track mode [mm]" VALUE 1073881576 __SWord_Value 0 tMillimetre_10_S16 -1000.0 1000.0 STEP_SIZE 1 /end CHARACTERISTIC
/begin CHARACTERISTIC CRideHeightLiftDwnRe "Rear axle ride height when in Track mode [mm]" VALUE 1073881574 __SWord_Value 0 tMillimetre_10_S16 -1000.0 1000.0 STEP_SIZE 1 /end CHARACTERISTIC
/begin CHARACTERISTIC CSuspMtnRatLiftDwnFrnt "Front Motion ration when lift is fully down [mm]" VALUE 1073881540 __SWord_Value 0 tFactor_1000_S16 -32.768 32.767 STEP_SIZE 1 /end CHARACTERISTIC
/begin CHARACTERISTIC CSuspMtnRatLiftDwnRe "Rear Motion ration when lift is fully down [mm]" VALUE 1073881538 __SWord_Value 0 tFactor_1000_S16 -32.768 32.767 STEP_SIZE 1 /end CHARACTERISTIC
/begin CHARACTERISTIC CRhLiftUpFront "" VALUE 1073881432 __SWord_Value 0 tMillimetre_10_S16 -1000.0 1000.0 STEP_SIZE 1 /end CHARACTERISTIC
/begin CHARACTERISTIC CRhLiftUpRear "" VALUE 1073881430 __SWord_Value 0 tMillimetre_10_S16 -1000.0 1000.0 STEP_SIZE 1 /end CHARACTERISTIC
/begin CHARACTERISTIC CRhLiftUpTolerance "" VALUE 1073881428 __SWord_Value 0 tMillimetre_10_S16 -1000.0 1000.0 STEP_SIZE 1 /end CHARACTERISTIC
/begin CHARACTERISTIC CRhLiftDownThreshold "" VALUE 1073881426 __SWord_Value 0 tMillimetre_10_S16 -1000.0 1000.0 STEP_SIZE 1 /end CHARACTERISTIC
/begin CHARACTERISTIC CSpeedLiftForcedDown "" VALUE 1073881424 __SWord_Value 0 tKilometrePerHour_S16 -600 600 STEP_SIZE 1 /end CHARACTERISTIC
/begin CHARACTERISTIC CLiftTimeout "" VALUE 1073881420 __ULong_Value 0 tMillisecond_U32 0 3600000 STEP_SIZE 1 /end CHARACTERISTIC
/begin CHARACTERISTIC CRHTimeLiftCalibMoveDown "" VALUE 1073881412 __ULong_Value 0 tMillisecond_U32 0 3600000 STEP_SIZE 1 /end CHARACTERISTIC
/begin CHARACTERISTIC CRHTimeLiftCalibMoveUp "" VALUE 1073881408 __ULong_Value 0 tMillisecond_U32 0 3600000 STEP_SIZE 1 /end CHARACTERISTIC
/begin CHARACTERISTIC CRHLiftCalibDownTolerance "" VALUE 1073881404 __SWord_Value 0 tMillivolt_S16 0 10000 STEP_SIZE 1 /end CHARACTERISTIC
/begin CHARACTERISTIC CRHTimeServiceModeMoveDown "" VALUE 1073881400 __ULong_Value 0 tMillisecond_U32 0 3600000 STEP_SIZE 1 /end CHARACTERISTIC
/begin CHARACTERISTIC CRHFrontAxleStaticHeight "" VALUE 1073881398 __SWord_Value 0 tMillimetre_S16 -1000 1000 STEP_SIZE 1 /end CHARACTERISTIC
/begin CHARACTERISTIC CRHRearAxleStaticHeight "" VALUE 1073881396 __SWord_Value 0 tMillimetre_S16 -1000 1000 STEP_SIZE 1 /end CHARACTERISTIC
/begin CHARACTERISTIC CRHminCarAwakeTime "" VALUE 1073881392 __ULong_Value 0 tMillisecond_U32 0 3600000 STEP_SIZE 1 /end CHARACTERISTIC
/begin CHARACTERISTIC CRHInhibitRide "" VALUE 1073881388 __UByte_Value 0 NO_COMPU_METHOD 0 1 STEP_SIZE 1 FORMAT "%.2" /end CHARACTERISTIC
/begin CHARACTERISTIC CRHCalibNbrBleedCycles "Number of bleed cycles to perfor during ride height calibration" VALUE 1073881384 __ULong_Value 0 NO_COMPU_METHOD 0 4294967295 STEP_SIZE 1 FORMAT "%.0" /end CHARACTERISTIC
/begin CHARACTERISTIC CRHsimVehicleSpeed "" VALUE 1073881380 __SWord_Value 0 tKilometrePerHour_S16 -600 600 STEP_SIZE 1 /end CHARACTERISTIC
/begin CHARACTERISTIC CRHMaxRetries "" VALUE 1073881376 __ULong_Value 0 NO_COMPU_METHOD 0 4294967295 STEP_SIZE 1 FORMAT "%.0" /end CHARACTERISTIC
/begin CHARACTERISTIC CRHDropOutOfTolTime "" VALUE 1073881372 __ULong_Value 0 tMillisecond_U32 0 3600000 STEP_SIZE 1 /end CHARACTERISTIC
/begin CHARACTERISTIC CLiftMoveTimeMin "" VALUE 1073881368 __ULong_Value 0 tMillisecond_U32 0 3600000 STEP_SIZE 1 /end CHARACTERISTIC
/begin CHARACTERISTIC CLiftMoveTimeFac "" VALUE 1073881364 __Float32_Value 0 NO_COMPU_METHOD -3.40282346639E+38 3.40282346639E+38 STEP_SIZE 1 FORMAT "%.6" /end CHARACTERISTIC
/begin CHARACTERISTIC CLiftMoveTimeMax "" VALUE 1073881360 __ULong_Value 0 tMillisecond_U32 0 3600000 STEP_SIZE 1 /end CHARACTERISTIC
/begin CHARACTERISTIC CTightToleranceTimeout "" VALUE 1073881356 __ULong_Value 0 tMillisecond_U32 0 3600000 STEP_SIZE 1 /end CHARACTERISTIC
/begin CHARACTERISTIC CRHLooseToleranceUp "" VALUE 1073881352 __SWord_Value 0 tMillimetre_10_S16 -1000.0 1000.0 STEP_SIZE 1 /end CHARACTERISTIC
/begin CHARACTERISTIC CRHLooseToleranceDown "" VALUE 1073881350 __SWord_Value 0 tMillimetre_10_S16 -1000.0 1000.0 STEP_SIZE 1 /end CHARACTERISTIC
/begin CHARACTERISTIC CRHTightToleranceUp "" VALUE 1073881348 __SWord_Value 0 tMillimetre_10_S16 -1000.0 1000.0 STEP_SIZE 1 /end CHARACTERISTIC
/begin CHARACTERISTIC CRHTightToleranceDown "" VALUE 1073881346 __SWord_Value 0 tMillimetre_10_S16 -1000.0 1000.0 STEP_SIZE 1 /end CHARACTERISTIC
/begin CHARACTERISTIC CRHLiftPosnOorTolr "Out of range tolerance for lift position [%]" VALUE 1073881345 __SByte_Value 0 tPercent_S8 0 100 STEP_SIZE 1 /end CHARACTERISTIC
/begin CHARACTERISTIC CRHWishboneAgOorTolr "Out of range tolerance for wishbone sensor in full bump position [%]" VALUE 1073881344 __SByte_Value 0 tPercent_S8 0 100 STEP_SIZE 1 /end CHARACTERISTIC
/begin CHARACTERISTIC CMinLvBatteryWarningThreshold "************************************************************************************************************************************************* * LV battery diagnose ***********************************" VALUE 1073881340 __Float32_Value 0 tVolt 0 1000 STEP_SIZE 1 /end CHARACTERISTIC
/begin CHARACTERISTIC CMaxLvBatteryWarningThreshold "" VALUE 1073881336 __Float32_Value 0 tVolt 0 1000 STEP_SIZE 1 /end CHARACTERISTIC
/begin CHARACTERISTIC CLvBatteryVoltageHyst "" VALUE 1073881332 __Float32_Value 0 tVolt 0 1000 STEP_SIZE 1 /end CHARACTERISTIC
/begin CHARACTERISTIC CSpdLimFbCtrlrEna "Speed limiter feedback controller enable" VALUE 1073881330 __UByte_Value 0 NO_COMPU_METHOD 0 1 STEP_SIZE 1 FORMAT "%.2" /end CHARACTERISTIC
/begin CHARACTERISTIC CSpdLimFfCtrlrEna "Speed limiter feedback controller enable" VALUE 1073881329 __UByte_Value 0 NO_COMPU_METHOD 0 1 STEP_SIZE 1 FORMAT "%.2" /end CHARACTERISTIC
/begin CHARACTERISTIC CSpdLimUnlckMaxSpd "Unlock Track only speed limit (SPD_LIM_PERF_MOD_TRACK_UNLCKD in CSpdLimPerfModArr)" VALUE 1073881328 __UByte_Value 0 NO_COMPU_METHOD 0 1 STEP_SIZE 1 FORMAT "%.2" /end CHARACTERISTIC
/begin CHARACTERISTIC CSpdLimPanelOpen "Speed limit when at least one of the doors or hoods is not fully closed [km/h]" VALUE 1073881284 __SWord_Value 0 tKilometrePerHour_10_S16 -600.0 600.0 STEP_SIZE 1 /end CHARACTERISTIC
/begin CHARACTERISTIC CSpdLimDynoMod "Speed limit when Dyno mode is selected [km/h]" VALUE 1073881282 __SWord_Value 0 tKilometrePerHour_10_S16 -600.0 600.0 STEP_SIZE 1 /end CHARACTERISTIC
/begin CHARACTERISTIC CSpdLimLiftMod "Speed limit when Lift mode is selected [km/h]" VALUE 1073881280 __SWord_Value 0 tKilometrePerHour_10_S16 -600.0 600.0 STEP_SIZE 1 /end CHARACTERISTIC
/begin CHARACTERISTIC CSpdLimElOrIceLimp "Speed limit when either Electric motor or ICE enter a Limited Power state [km/h]" VALUE 1073881278 __SWord_Value 0 tKilometrePerHour_10_S16 -600.0 600.0 STEP_SIZE 1 /end CHARACTERISTIC
/begin CHARACTERISTIC CSpdLimAsf "Speed limit when an Active System Fault is detected [km/h]" VALUE 1073881276 __SWord_Value 0 tKilometrePerHour_10_S16 -600.0 600.0 STEP_SIZE 1 /end CHARACTERISTIC
/begin CHARACTERISTIC CSpdLimTurtle "Speed limit when in Turtle mode [km/h]" VALUE 1073881274 __SWord_Value 0 tKilometrePerHour_10_S16 -600.0 600.0 STEP_SIZE 1 /end CHARACTERISTIC
/begin CHARACTERISTIC CSpdLimVehVelLimDtOvrd "If different from 0, override the drivetrain speed limit with CSpdLimVehVelLimDtOvrd" VALUE 1073881272 __SWord_Value 0 tKilometrePerHour_10_S16 -600.0 600.0 STEP_SIZE 1 /end CHARACTERISTIC
/begin CHARACTERISTIC CSpdLimLiftoffHoldTime "Pedal liftoff detection time [ms]" VALUE 1073881268 __ULong_Value 0 tMillisecond_U32 0 3600000 STEP_SIZE 1 /end CHARACTERISTIC
/begin CHARACTERISTIC CSpdLimRampGrdtLimSlow "slow ramped set speed limit gradient limit [km/h per s] 3.6 equals 0.1g deceleration" VALUE 1073881266 __SWord_Value 0 tKilometrePerHour_10_S16 -600.0 600.0 STEP_SIZE 1 /end CHARACTERISTIC
/begin CHARACTERISTIC CSpdLimRampGrdtLimFast "Fast ramped set speed limit gradient upper limit [km/h per s]" VALUE 1073881264 __SWord_Value 0 tKilometrePerHour_10_S16 -600.0 600.0 STEP_SIZE 1 /end CHARACTERISTIC
/begin CHARACTERISTIC CSpdLimIntvWhlTqThd "Speed limiter activation or deactivation wheel torque treshold" VALUE 1073881260 __SLong_Value 0 tNewtonMetre_100_S32 -100000.0 100000.0 STEP_SIZE 1 /end CHARACTERISTIC
/begin CHARACTERISTIC CSpdLimFfWhlTqReqMin "Minimum wheel torque for Speed Limiter feedforward torque [Nm]" VALUE 1073881256 __SLong_Value 0 tNewtonMetre_100_S32 -100000.0 100000.0 STEP_SIZE 1 /end CHARACTERISTIC
/begin CHARACTERISTIC CSpdLimFfWhlTqReqMax "Maximum wheel torque for Speed Limiter feedforward torque [Nm]" VALUE 1073881252 __SLong_Value 0 tNewtonMetre_100_S32 -100000.0 100000.0 STEP_SIZE 1 /end CHARACTERISTIC
/begin CHARACTERISTIC CSpdLimIntglWhlTqMin "Minimum wheel torque for Speed Limiter integral part [Nm]" VALUE 1073881248 __SLong_Value 0 tNewtonMetre_100_S32 -100000.0 100000.0 STEP_SIZE 1 /end CHARACTERISTIC
/begin CHARACTERISTIC CSpdLimIntglWhlTqMax "Maximum wheel torque for Speed Limiter integral part [Nm]" VALUE 1073881244 __SLong_Value 0 tNewtonMetre_100_S32 -100000.0 100000.0 STEP_SIZE 1 /end CHARACTERISTIC
/begin CHARACTERISTIC CSpdLimFbWhlTqReqMin "Minimum wheel torque for Speed Limiter feedback [Nm]" VALUE 1073881240 __SLong_Value 0 tNewtonMetre_100_S32 -100000.0 100000.0 STEP_SIZE 1 /end CHARACTERISTIC
/begin CHARACTERISTIC CSpdLimFbWhlTqReqMax "Maximum wheel torque for Speed Limiter feedback [Nm]" VALUE 1073881236 __SLong_Value 0 tNewtonMetre_100_S32 -100000.0 100000.0 STEP_SIZE 1 /end CHARACTERISTIC
/begin CHARACTERISTIC CSpdLimTotWhlTqReqMin "Speed Limiter wheel torque request lower limit [Nm]" VALUE 1073881232 __SLong_Value 0 tNewtonMetre_100_S32 -100000.0 100000.0 STEP_SIZE 1 /end CHARACTERISTIC
/begin CHARACTERISTIC CSpdLimTotWhlTqReqMax "Speed Limiter wheel torque request upper limit [Nm]" VALUE 1073881228 __SLong_Value 0 tNewtonMetre_100_S32 -100000.0 100000.0 STEP_SIZE 1 /end CHARACTERISTIC
/begin CHARACTERISTIC CSpdLimGainP "Proportional gain of Speed Limiter [Ns]" VALUE 1073881226 __UWord_Value 0 NO_COMPU_METHOD 0 2000.0 STEP_SIZE 10 FORMAT "%.0" /end CHARACTERISTIC
/begin CHARACTERISTIC CSpdLimGainI "Integral gain of Speed Limiter [N]" VALUE 1073881224 __UWord_Value 0 NO_COMPU_METHOD 0 2000.0 STEP_SIZE 10 FORMAT "%.0" /end CHARACTERISTIC
/begin CHARACTERISTIC CSpdLimGainD "Derivative gain of Speed Limiter [Ns^2]" VALUE 1073881222 __UWord_Value 0 NO_COMPU_METHOD 0 1000.0 STEP_SIZE 10 FORMAT "%.0" /end CHARACTERISTIC
/begin CHARACTERISTIC CSpdLimVelCtrlEnaDfdFil "Enable calculation of derivative error of the PID velocity controller using Dfd Filter" VALUE 1073881220 __UByte_Value 0 NO_COMPU_METHOD 0 1 STEP_SIZE 1 FORMAT "%.2" /end CHARACTERISTIC
/begin CHARACTERISTIC CSpdLimVelErrDerivIncFilCoeff "Velocity Error Derivative Increase filter coefficient [-]" VALUE 1073881216 __Float32_Value 0 NO_COMPU_METHOD -3.40282346639E+38 3.40282346639E+38 STEP_SIZE 1 FORMAT "%.6" /end CHARACTERISTIC
/begin CHARACTERISTIC CSpdLimVelErrDerivDecFilCoeff "Velocity Error Derivative Decrease filter coefficient [-]" VALUE 1073881212 __Float32_Value 0 NO_COMPU_METHOD -3.40282346639E+38 3.40282346639E+38 STEP_SIZE 1 FORMAT "%.6" /end CHARACTERISTIC
/begin CHARACTERISTIC CSpdLimWhlTqReqFilEna "Enable Speed Limiter Troque Request filter" VALUE 1073881208 __UByte_Value 0 NO_COMPU_METHOD 0 1 STEP_SIZE 1 FORMAT "%.2" /end CHARACTERISTIC
/begin CHARACTERISTIC CSpdLimWhlTqReqFilType "Low pass filter type used for speed limiter wheel torque request" VALUE 1073881204 __ULong_Value 0 tLowPassFilterType 0 1 STEP_SIZE 1 /end CHARACTERISTIC
/begin CHARACTERISTIC CSpdLimWhlTqReqFilCoeff "Speed Limiter Troque Request filter coefficient [-]" VALUE 1073881200 __Float32_Value 0 NO_COMPU_METHOD -3.40282346639E+38 3.40282346639E+38 STEP_SIZE 1 FORMAT "%.6" /end CHARACTERISTIC
/begin CHARACTERISTIC CWhlCluSimpleSignDetnEna "Simple wheel clutch slip sign determination, using propshaft torque request for propulsion" VALUE 1073881197 __UByte_Value 0 NO_COMPU_METHOD 0 1 STEP_SIZE 1 FORMAT "%.2" /end CHARACTERISTIC
/begin CHARACTERISTIC CTsmForcedEvTurtle "Forced EV turtle" VALUE 1073881196 __UByte_Value 0 NO_COMPU_METHOD 0 1 STEP_SIZE 1 FORMAT "%.2" /end CHARACTERISTIC
/begin CHARACTERISTIC CWhlTqFrLimLowrAbsActv "Wheel torque limit for front axle while ABS active [Nm]" VALUE 1073881184 __Float32_Value 0 tNewtonMetre 0 15000.0 STEP_SIZE 10 /end CHARACTERISTIC
/begin CHARACTERISTIC CTestRegenCtrl "Enable regen limit dependent on lateral acceleration" VALUE 1073881176 __UByte_Value 0 NO_COMPU_METHOD 0 1 STEP_SIZE 1 FORMAT "%.2" /end CHARACTERISTIC
/begin CHARACTERISTIC CEnaFricBrkReq "Enable brake pressure request to IEB" VALUE 1073881135 __UByte_Value 0 NO_COMPU_METHOD 0 1 STEP_SIZE 1 FORMAT "%.2" /end CHARACTERISTIC
/begin CHARACTERISTIC CEnaFricBrkTqVect "Enable torque vectoring via friction brakes, which makes recuperation requested by brake pedal (IEB) unavailable" VALUE 1073881134 __UByte_Value 0 NO_COMPU_METHOD 0 1 STEP_SIZE 1 FORMAT "%.2" /end CHARACTERISTIC
/begin CHARACTERISTIC CTsmFricBrkTqVectAxleSeln "Friction brake torque vectoring selection when in All-wheel drive" VALUE 1073881133 __UByte_Value 0 NO_COMPU_METHOD 0 1 STEP_SIZE 1 FORMAT "%.2" /end CHARACTERISTIC
/begin CHARACTERISTIC CTsmFricBrkRecupAxleSeln "Friction brake recuperation axle selection when in All-wheel drive" VALUE 1073881132 __UByte_Value 0 NO_COMPU_METHOD 0 1 STEP_SIZE 1 FORMAT "%.2" /end CHARACTERISTIC
/begin CHARACTERISTIC CTsmFricBrkMinTqThdUppr "Friction brakes available for recuperation or differential braking upper threshold [Nm]" VALUE 1073881128 __Float32_Value 0 tNewtonMetre -100000 100000 STEP_SIZE 1 /end CHARACTERISTIC
/begin CHARACTERISTIC CTsmFricBrkMinTqThdLowr "Friction brakes available for recuperation or differential braking lower threshold [Nm]" VALUE 1073881124 __Float32_Value 0 tNewtonMetre -100000 100000 STEP_SIZE 1 /end CHARACTERISTIC
/begin CHARACTERISTIC CFricBrkPReqRsnThd "Friction brakes torque request threshold to activate pressure request reason [Nm]" VALUE 1073881120 __Float32_Value 0 tNewtonMetre -100000 100000 STEP_SIZE 1 /end CHARACTERISTIC
/begin CHARACTERISTIC CFricBrkWhlTqReqTotAchvThd "Friction brake torque achieved treshold, if below the value than friction brakes cannot achieve requested torque, request parking brake intervention" VALUE 1073881116 __Float32_Value 0 tNewtonMetre -100000 100000 STEP_SIZE 1 /end CHARACTERISTIC
/begin CHARACTERISTIC CTsmPtLimpModTqMax "Maximum positive power unit torque while in powertrain limp mode" VALUE 1073881112 __SLong_Value 0 tNewtonMetre_100_S32 0 12000 STEP_SIZE 50 /end CHARACTERISTIC
/begin CHARACTERISTIC CTsmTurtleModTqMax "Maximum positive power unit torque while in either turtle mode" VALUE 1073881108 __SLong_Value 0 tNewtonMetre_100_S32 0 12000 STEP_SIZE 50 /end CHARACTERISTIC
/begin CHARACTERISTIC CTsmTurtleModTqMin "Maximum positive power unit torque while in either turtle mode" VALUE 1073881104 __SLong_Value 0 tNewtonMetre_100_S32 0 12000 STEP_SIZE 50 /end CHARACTERISTIC
/begin CHARACTERISTIC CTsmCanCommStartup "TSM CAN communication start-up time" VALUE 1073881100 __ULong_Value 0 tMillisecond_U32 0 5000 STEP_SIZE 100 /end CHARACTERISTIC
/begin CHARACTERISTIC CTsmAwdTempThd "Temperature threshold to switch to AWD (from FWD in cold) [C]" VALUE 1073881096 __SWord_Value 0 tCelsius_10_S16 -400.0 10000.0 STEP_SIZE 1 /end CHARACTERISTIC
/begin CHARACTERISTIC CTsmAwdTempThdDbncTime "Debounce time for temperature threshold to switch to AWD (from FWD in cold) [ms]" VALUE 1073881092 __ULong_Value 0 tMillisecond_U32 0 3600000 STEP_SIZE 1 /end CHARACTERISTIC
/begin CHARACTERISTIC CTsmPtCriticalFaultReset "TSM reset PT Critical faults" VALUE 1073881088 __UByte_Value 0 NO_COMPU_METHOD 0 1 STEP_SIZE 1 FORMAT "%.2" /end CHARACTERISTIC
/begin CHARACTERISTIC CTsmPtCritAxleClosedEna "" VALUE 1073881087 __UByte_Value 0 NO_COMPU_METHOD 0 1 STEP_SIZE 1 FORMAT "%.2" /end CHARACTERISTIC
/begin CHARACTERISTIC CTsmPtCritAxleFrntMisEna "" VALUE 1073881086 __UByte_Value 0 NO_COMPU_METHOD 0 1 STEP_SIZE 1 FORMAT "%.2" /end CHARACTERISTIC
/begin CHARACTERISTIC CTsmPtCritAxleFwdEna "" VALUE 1073881085 __UByte_Value 0 NO_COMPU_METHOD 0 1 STEP_SIZE 1 FORMAT "%.2" /end CHARACTERISTIC
/begin CHARACTERISTIC CTsmPtCritAxleIceTurtEna "" VALUE 1073881084 __UByte_Value 0 NO_COMPU_METHOD 0 1 STEP_SIZE 1 FORMAT "%.2" /end CHARACTERISTIC
/begin CHARACTERISTIC CTsmPtCritAxleOpenEna "" VALUE 1073881083 __UByte_Value 0 NO_COMPU_METHOD 0 1 STEP_SIZE 1 FORMAT "%.2" /end CHARACTERISTIC
/begin CHARACTERISTIC CTsmPtCritAxleRearMisEna "" VALUE 1073881082 __UByte_Value 0 NO_COMPU_METHOD 0 1 STEP_SIZE 1 FORMAT "%.2" /end CHARACTERISTIC
/begin CHARACTERISTIC CTsmPtCritAxleRwdEna "" VALUE 1073881081 __UByte_Value 0 NO_COMPU_METHOD 0 1 STEP_SIZE 1 FORMAT "%.2" /end CHARACTERISTIC
/begin CHARACTERISTIC CTsmPtCritAxleShutdwnEna "" VALUE 1073881080 __UByte_Value 0 NO_COMPU_METHOD 0 1 STEP_SIZE 1 FORMAT "%.2" /end CHARACTERISTIC
/begin CHARACTERISTIC CTsmPtCritElecFaultEngOffEna "" VALUE 1073881079 __UByte_Value 0 NO_COMPU_METHOD 0 1 STEP_SIZE 1 FORMAT "%.2" /end CHARACTERISTIC
/begin CHARACTERISTIC CTsmPtCritElecShutdwnEna "" VALUE 1073881078 __UByte_Value 0 NO_COMPU_METHOD 0 1 STEP_SIZE 1 FORMAT "%.2" /end CHARACTERISTIC
/begin CHARACTERISTIC CTsmPtCritElecTurtUnavlEna "" VALUE 1073881077 __UByte_Value 0 NO_COMPU_METHOD 0 1 STEP_SIZE 1 FORMAT "%.2" /end CHARACTERISTIC
/begin CHARACTERISTIC CTsmPtCritIceTurtUnavlEna "" VALUE 1073881076 __UByte_Value 0 NO_COMPU_METHOD 0 1 STEP_SIZE 1 FORMAT "%.2" /end CHARACTERISTIC
/begin CHARACTERISTIC CTsmPtCritTqUnavlEna "" VALUE 1073881075 __UByte_Value 0 NO_COMPU_METHOD 0 1 STEP_SIZE 1 FORMAT "%.2" /end CHARACTERISTIC
/begin CHARACTERISTIC CTsmPtCritAxleElecTurtEna "" VALUE 1073881074 __UByte_Value 0 NO_COMPU_METHOD 0 1 STEP_SIZE 1 FORMAT "%.2" /end CHARACTERISTIC
/begin CHARACTERISTIC CTsmEcmCommFaultEna "" VALUE 1073881073 __UByte_Value 0 NO_COMPU_METHOD 0 1 STEP_SIZE 1 FORMAT "%.2" /end CHARACTERISTIC
/begin CHARACTERISTIC CTsmLsttCommFaultEna "" VALUE 1073881072 __UByte_Value 0 NO_COMPU_METHOD 0 1 STEP_SIZE 1 FORMAT "%.2" /end CHARACTERISTIC
/begin CHARACTERISTIC CHndlgAttdModDft "Handling attitude default mode" VALUE 1073881040 __ULong_Value 0 tHandlingAttitudeMode 0 7 STEP_SIZE 1 /end CHARACTERISTIC
/begin CHARACTERISTIC CTestHndlgAttdMod "Handling attitude mode override when not set to UKWN" VALUE 1073881036 __ULong_Value 0 tHandlingAttitudeMode 0 7 STEP_SIZE 1 /end CHARACTERISTIC
/begin CHARACTERISTIC CHndlgAttdModHoldTi "Handling attitude mode hold time [ms]" VALUE 1073881032 __ULong_Value 0 tMillisecond_U32 0 3600000 STEP_SIZE 1 /end CHARACTERISTIC
/begin CHARACTERISTIC CTestTracCtrlMod "Traction control state override" VALUE 1073881028 __ULong_Value 0 tTractionControlMode 0 6 STEP_SIZE 1 /end CHARACTERISTIC
/begin CHARACTERISTIC CTracCtrlWhlTqMin "Minimum wheel torque limit in traction control active mode [Nm]" VALUE 1073881024 __Float32_Value 0 tNewtonMetre 0 2000.0 STEP_SIZE 50 /end CHARACTERISTIC
/begin CHARACTERISTIC CTracCtrlWhlTqMax "Maximum wheel torque limit in traction control active mode [Nm]" VALUE 1073881020 __Float32_Value 0 tNewtonMetre 0 10000.0 STEP_SIZE 50 /end CHARACTERISTIC
/begin CHARACTERISTIC CTracCtrlSlipCntThresActive "Total event counts of clutch slip control before setting TC function telltale active Type: Parameter" VALUE 1073880448 __UByte_Value 0 NO_COMPU_METHOD 1 250 STEP_SIZE 10 FORMAT "%.0" /end CHARACTERISTIC
/begin CHARACTERISTIC CTracCtrlSlipCntThresDeactive "Total event counts of clutch slip control before setting TC function telltale available Type: Parameter" VALUE 1073880447 __UByte_Value 0 NO_COMPU_METHOD 1 250 STEP_SIZE 10 FORMAT "%.0" /end CHARACTERISTIC
/begin CHARACTERISTIC CTracCtrlSlipCntGrowth "Growth rate of slip control counter for TC function telltale Type: Parameter" VALUE 1073880446 __UByte_Value 0 NO_COMPU_METHOD 1 250 STEP_SIZE 1 FORMAT "%.0" /end CHARACTERISTIC
/begin CHARACTERISTIC CTracCtrlSlipCntDecay "Decay rate of slip control counter for TC function telltale Type: Parameter" VALUE 1073880445 __UByte_Value 0 NO_COMPU_METHOD 1 250 STEP_SIZE 1 FORMAT "%.0" /end CHARACTERISTIC
/begin CHARACTERISTIC CTracCtrlSlipCntMax "Maximum slip control counter for TC function telltale Type: Parameter" VALUE 1073880444 __UByte_Value 0 NO_COMPU_METHOD 1 250 STEP_SIZE 10 FORMAT "%.0" /end CHARACTERISTIC
/begin CHARACTERISTIC CTireMaxLgtSlipLimUppr "Tire slip ratio upper limit for traction control [-]" VALUE 1073880440 __Float32_Value 0 tFactor 0 5 STEP_SIZE 0.01 /end CHARACTERISTIC
/begin CHARACTERISTIC CTireMaxLgtSlipLimLowr "Tire slip ratio lower limit for traction control [-]" VALUE 1073880436 __Float32_Value 0 tFactor 0 5 STEP_SIZE 0.01 /end CHARACTERISTIC
/begin CHARACTERISTIC CTqLimRePinionTqLim "Torque limit for rear crown/pinion set" VALUE 1073879952 __Float32_Value 0 tNewtonMetre 0 10000.0 STEP_SIZE 100 /end CHARACTERISTIC
/begin CHARACTERISTIC CTqLimInvSpdCtrlBuf "Buffer on elec mot tq limits for cutting clu tqs due to inv spd ctrl" VALUE 1073879948 __Float32_Value 0 tNewtonMetre -1000.0 1000.0 STEP_SIZE 10 /end CHARACTERISTIC
/begin CHARACTERISTIC CTqLimPropshPmpTqLim "Maximum torque allowed to electric motor in 'propshaft pump' operation" VALUE 1073879944 __Float32_Value 0 tNewtonMetre 0 2000.0 STEP_SIZE 50 /end CHARACTERISTIC
/begin CHARACTERISTIC CTqLimElecMotTqLim "Maximum electric motor torque limit coming from Torque Manager" VALUE 1073879940 __Float32_Value 0 tNewtonMetre -100000 100000 STEP_SIZE 1 /end CHARACTERISTIC
/begin CHARACTERISTIC CTestYawTqReqMod "Yaw torque control mode override" VALUE 1073879936 __ULong_Value 0 tYawTorqueRequestMode 0 7 STEP_SIZE 1 /end CHARACTERISTIC
/begin CHARACTERISTIC CStatyCrkIceSpd "Stationary cranking target ICE speed [rpm]" VALUE 1073878656 __SWord_Value 0 tRevolutionPerMinute_S16 -32768 32767 STEP_SIZE 1 /end CHARACTERISTIC
/begin CHARACTERISTIC CStatyCrkTqReq "Stationary cranking torque request [Nm]" VALUE 1073878652 __Float32_Value 0 tNewtonMetre -100000 100000 STEP_SIZE 1 /end CHARACTERISTIC
/begin CHARACTERISTIC CStatyCrkIceRunngDetnModSpd "Enable stationary cranking ICE running detection by speed [bool]" VALUE 1073878651 __UByte_Value 0 NO_COMPU_METHOD 0 1 STEP_SIZE 1 FORMAT "%.2" /end CHARACTERISTIC
/begin CHARACTERISTIC CStatyCrkIceRunngDetnModNegElecTq "Enable stationary cranking ICE running detection by absolute electric motor torque [bool]" VALUE 1073878650 __UByte_Value 0 NO_COMPU_METHOD 0 1 STEP_SIZE 1 FORMAT "%.2" /end CHARACTERISTIC
/begin CHARACTERISTIC CStatyCrkIceRunngDetnBuf "Speed buffer for stationary cranking ICE running detection [rpm]" VALUE 1073878648 __SWord_Value 0 tRevolutionPerMinute_S16 -32768 32767 STEP_SIZE 1 /end CHARACTERISTIC
/begin CHARACTERISTIC CHybIdleGear "Hybrid idle gear request to transmission" VALUE 1073878644 __ULong_Value 0 tGear 0 10 STEP_SIZE 1 /end CHARACTERISTIC
/begin CHARACTERISTIC CPropshSpdFilFreq "Normalized cutoff frequency for propshaft rate filter [Hz]" VALUE 1073878604 __Float32_Value 0 NO_COMPU_METHOD -3.40282346639E+38 3.40282346639E+38 STEP_SIZE 1 FORMAT "%.6" /end CHARACTERISTIC
/begin CHARACTERISTIC CPropshSpdIntgtrErrThres "Propshaft speed sync error threshold for integrator state handling [rpm]" VALUE 1073878602 __SWord_Value 0 tRevolutionPerMinute_S16 -32768 32767 STEP_SIZE 1 /end CHARACTERISTIC
/begin CHARACTERISTIC CPropshCrkSyncSpdErrThres "Speed error threshold for propshaft sync during cranking sync [rpm]" VALUE 1073878600 __SWord_Value 0 tRevolutionPerMinute_S16 -32768 32767 STEP_SIZE 1 /end CHARACTERISTIC
/begin CHARACTERISTIC CPropshCrkSyncStCnt "Count for propshaft speed sync during cranking sync, used in torque averaging" VALUE 1073878596 __ULong_Value 0 NO_COMPU_METHOD 0 4294967295 STEP_SIZE 1 FORMAT "%.0" /end CHARACTERISTIC
/begin CHARACTERISTIC CPropshCrkMinRate "Minimum propshaft rate to proceed from cranking sync state [rad/s]" VALUE 1073878592 __Float32_Value 0 tRadianPerSecond -1000 1000 STEP_SIZE 1 /end CHARACTERISTIC
/begin CHARACTERISTIC CTestCenCluSyncEna "Enable central clutch sync evaluation [bool]" VALUE 1073878588 __UByte_Value 0 NO_COMPU_METHOD 0 1 STEP_SIZE 1 FORMAT "%.2" /end CHARACTERISTIC
/begin CHARACTERISTIC CTrsmSpdSyncErrThres "Central clutch slip error threshold [rpm]" VALUE 1073878580 __Float32_Value 0 tRevolutionPerMinute -10000 10000 STEP_SIZE 1 /end CHARACTERISTIC
/begin CHARACTERISTIC CPropshRateSyncIntgtrStTi "Propshaft rate sync time [ms]" VALUE 1073878576 __ULong_Value 0 tMillisecond_U32 0 3600000 STEP_SIZE 1 /end CHARACTERISTIC
/begin CHARACTERISTIC CIdleInvGainSetTi "Timer for idle inverter gain set transition [ms]" VALUE 1073878568 __ULong_Value 0 tMillisecond_U32 0 3600000 STEP_SIZE 1 /end CHARACTERISTIC
/begin CHARACTERISTIC CPropshRateErrThdForIdleInvGainSet "Propshaft rate error threshold for idle inverter gain set" VALUE 1073878564 __Float32_Value 0 tRadianPerSecond -1000 1000 STEP_SIZE 1 /end CHARACTERISTIC
/begin CHARACTERISTIC CEnaPropshTqDmdForIce "Enable torque demand from ICE request [bool]" VALUE 1073878560 __UByte_Value 0 NO_COMPU_METHOD 0 1 STEP_SIZE 1 FORMAT "%.2" /end CHARACTERISTIC
/begin CHARACTERISTIC CProshRateErrTqBuffer "Hysteresis buffer on propshaft rate error to hold clutch torque to zero" VALUE 1073878556 __Float32_Value 0 tRadianPerSecond -1000 1000 STEP_SIZE 1 /end CHARACTERISTIC
/begin CHARACTERISTIC CWhlCluTqRampLim "Wheel clutch torque ramp-in rate after a sign change [Nm/s]" VALUE 1073878552 __Float32_Value 0 tNewtonMetre -100000 100000 STEP_SIZE 1 /end CHARACTERISTIC
/begin CHARACTERISTIC CSyncCluRateSlipDfltT "Default temperature to use for clutch slip in case of faulty temperature sensor [C]" VALUE 1073878508 __Float32_Value 0 tCelsius -100 500 STEP_SIZE 5 /end CHARACTERISTIC
/begin CHARACTERISTIC CPropshRateTakeoffStdstillBuf "Propshaft rate buffer for standstill takeoff transition [rad/s]" VALUE 1073878504 __Float32_Value 0 tRadianPerSecond -1000 1000 STEP_SIZE 1 /end CHARACTERISTIC
/begin CHARACTERISTIC CPropshRateTakeoffPreDwnshftBuf "Propshaft rate buffer for pre-downshift takeoff transition [rad/s]" VALUE 1073878500 __Float32_Value 0 tRadianPerSecond -1000 1000 STEP_SIZE 1 /end CHARACTERISTIC
/begin CHARACTERISTIC CPropshRateTarRampGrdt "Propshaft rate target ramping gradient [rad/s]" VALUE 1073878496 __Float32_Value 0 tRadianPerSquareSecond -100000 100000 STEP_SIZE 1 /end CHARACTERISTIC
/begin CHARACTERISTIC CWhlRateMinCluOuterMax "Target wheel speed for extremely low vehicle speed conditions [rad/s]" VALUE 1073878492 __Float32_Value 0 tRadianPerSecond 0 10 STEP_SIZE 0.1 /end CHARACTERISTIC
/begin CHARACTERISTIC CTestPropshTqDmdFromEgyMgr "Propshaft torque request to charge electrical system" VALUE 1073878488 __UByte_Value 0 NO_COMPU_METHOD 0 1 STEP_SIZE 1 FORMAT "%.2" /end CHARACTERISTIC
/begin CHARACTERISTIC CPropshTqDmdChrgMax "Maximum charge torque" VALUE 1073878484 __Float32_Value 0 tNewtonMetre 0 2000 STEP_SIZE 10 /end CHARACTERISTIC
/begin CHARACTERISTIC CPropshTqDmdChrgMin "Minimum charge torque" VALUE 1073878480 __Float32_Value 0 tNewtonMetre -2000 0 STEP_SIZE 10 /end CHARACTERISTIC
/begin CHARACTERISTIC CIceTqMaxBufHybDrvg "Combustion engine maximum torque buffer for hybrid drive" VALUE 1073878476 __Float32_Value 0 tNewtonMetre 0 5000 STEP_SIZE 10 /end CHARACTERISTIC
/begin CHARACTERISTIC CIceTqMaxBufHybIdle "Combustion engine maximum torque buffer for hybrid idle" VALUE 1073878472 __Float32_Value 0 tNewtonMetre 0 5000 STEP_SIZE 10 /end CHARACTERISTIC
/begin CHARACTERISTIC CIceTqMinSlowIdleEnable "Enable ICE idle slow torque minimum change" VALUE 1073878468 __UByte_Value 0 NO_COMPU_METHOD 0 1 STEP_SIZE 1 FORMAT "%.2" /end CHARACTERISTIC
/begin CHARACTERISTIC CIceIdleEntryThd "Threshold above ICE idle speed to trigger slow torque min change" VALUE 1073878466 __SWord_Value 0 tRevolutionPerMinute_S16 0 1000 STEP_SIZE 10 /end CHARACTERISTIC
/begin CHARACTERISTIC CIceIdleExitThd "Threshold above ICE idle speed to exit slow torque min change" VALUE 1073878464 __SWord_Value 0 tRevolutionPerMinute_S16 0 1000 STEP_SIZE 10 /end CHARACTERISTIC
/begin CHARACTERISTIC CIceTqMinSlowIdle "Minimum ICE slow torque request at idle" VALUE 1073878460 __Float32_Value 0 tNewtonMetre 0 200 STEP_SIZE 10 /end CHARACTERISTIC
/begin CHARACTERISTIC CPropshTqDmdChrgRampLimDrvg "Propshaft torque demand for hybrid drive charging ramp gradient limit [Nm/s]" VALUE 1073878456 __Float32_Value 0 NO_COMPU_METHOD -3.40282346639E+38 3.40282346639E+38 STEP_SIZE 1 FORMAT "%.6" /end CHARACTERISTIC
/begin CHARACTERISTIC CPropshTqDmdChrgRampLimIdle "Propshaft torque demand for hybrid idle charging ramp gradient limit [Nm/s]" VALUE 1073878452 __Float32_Value 0 NO_COMPU_METHOD -3.40282346639E+38 3.40282346639E+38 STEP_SIZE 1 FORMAT "%.6" /end CHARACTERISTIC
/begin CHARACTERISTIC CIceSpdThdForCrkIniBump "Rate threshold for feedforward torque used to turn engine over [rpm]" VALUE 1073878448 __SWord_Value 0 tRevolutionPerMinute_S16 0 1000 STEP_SIZE 50 /end CHARACTERISTIC
/begin CHARACTERISTIC CPropshRateCtrlTqReqPartLim "Propshaft rate controller torque request absolute limit on P/I/D parts [Nm]" VALUE 1073877720 __Float32_Value 0 NO_COMPU_METHOD -3.40282346639E+38 3.40282346639E+38 STEP_SIZE 1 FORMAT "%.6" /end CHARACTERISTIC
/begin CHARACTERISTIC CPropshRateCtrlTqReqTotLim "Propshaft rate controller torque request total absolute limit [Nm]" VALUE 1073877716 __Float32_Value 0 NO_COMPU_METHOD -3.40282346639E+38 3.40282346639E+38 STEP_SIZE 1 FORMAT "%.6" /end CHARACTERISTIC
/begin CHARACTERISTIC CIceTqReqRampLimLower "ICE torque request (on propshaft level) ramp limit lower [Nm/s]" VALUE 1073877712 __Float32_Value 0 NO_COMPU_METHOD -3.40282346639E+38 3.40282346639E+38 STEP_SIZE 1 FORMAT "%.6" /end CHARACTERISTIC
/begin CHARACTERISTIC CIceTqReqRampLimUpper "ICE torque request (on propshaft level) ramp limit upper [Nm/s]" VALUE 1073877708 __Float32_Value 0 NO_COMPU_METHOD -3.40282346639E+38 3.40282346639E+38 STEP_SIZE 1 FORMAT "%.6" /end CHARACTERISTIC
/begin CHARACTERISTIC CElecMotTqReqRampLimLower "Electric motor torque request (on propshaft level) ramp limit lower [Nm/s]" VALUE 1073877704 __Float32_Value 0 NO_COMPU_METHOD -3.40282346639E+38 3.40282346639E+38 STEP_SIZE 1 FORMAT "%.6" /end CHARACTERISTIC
/begin CHARACTERISTIC CElecMotTqReqRampLimUpper "Electric motor torque request (on propshaft level) ramp limit upper [Nm/s]" VALUE 1073877700 __Float32_Value 0 NO_COMPU_METHOD -3.40282346639E+38 3.40282346639E+38 STEP_SIZE 1 FORMAT "%.6" /end CHARACTERISTIC
/begin CHARACTERISTIC CPropshTqForInvSpdCtrlFiltCoeff "Incoming filter on inverter speed control FB tq request [Nm]" VALUE 1073877696 __Float32_Value 0 NO_COMPU_METHOD 0 0.5 STEP_SIZE 0.01 FORMAT "%.6" /end CHARACTERISTIC
/begin CHARACTERISTIC CPropshRateCtrlTqReqIntglLimitLower "Clutch Torque Limit using propshCtrlr integrator ramping rate lower [Nm/s]" VALUE 1073877692 __Float32_Value 0 NO_COMPU_METHOD -3.40282346639E+38 3.40282346639E+38 STEP_SIZE 1 FORMAT "%.6" /end CHARACTERISTIC
/begin CHARACTERISTIC CPropshRateCtrlTqReqIntglLimitUpper "Clutch Torque Limit using propshCtrlr integrator ramping rate upper [Nm/s]" VALUE 1073877688 __Float32_Value 0 NO_COMPU_METHOD -3.40282346639E+38 3.40282346639E+38 STEP_SIZE 1 FORMAT "%.6" /end CHARACTERISTIC
/begin CHARACTERISTIC CPropshRateErrFiltStr "Propshaft rate error derivative normalized cutoff frequency [-]" VALUE 1073877684 __Float32_Value 0 NO_COMPU_METHOD -3.40282346639E+38 3.40282346639E+38 STEP_SIZE 1 FORMAT "%.6" /end CHARACTERISTIC
/begin CHARACTERISTIC CPropshTqReqIceFastFiltCoeff "Propshaft torque request fast ICE filter coefficient [-]" VALUE 1073877680 __Float32_Value 0 NO_COMPU_METHOD -3.40282346639E+38 3.40282346639E+38 STEP_SIZE 1 FORMAT "%.6" /end CHARACTERISTIC
/begin CHARACTERISTIC CPropshTqReqIceSlowFiltCoeff "Propshaft torque request slow ICE filter coefficient [-]" VALUE 1073877676 __Float32_Value 0 NO_COMPU_METHOD -3.40282346639E+38 3.40282346639E+38 STEP_SIZE 1 FORMAT "%.6" /end CHARACTERISTIC
/begin CHARACTERISTIC CIceSpdReqMin "ICE speed request hard limit minimum [rpm]" VALUE 1073877674 __SWord_Value 0 tRevolutionPerMinute_S16 -32768 32767 STEP_SIZE 1 /end CHARACTERISTIC
/begin CHARACTERISTIC CIceSpdReqMax "ICE speed request hard limit maximum [rpm]" VALUE 1073877672 __SWord_Value 0 tRevolutionPerMinute_S16 -32768 32767 STEP_SIZE 1 /end CHARACTERISTIC
/begin CHARACTERISTIC CTracCtrlCenCluTqLim "Central clutch torque request limit [Nm]" VALUE 1073877668 __SLong_Value 0 tNewtonMetre_100_S32 -100000.0 100000.0 STEP_SIZE 1 /end CHARACTERISTIC
/begin CHARACTERISTIC CPropshStatyCrkStTimeout "Time given to stationary cranking state transition [ms]" VALUE 1073877664 __ULong_Value 0 tMillisecond_U32 0 10000 STEP_SIZE 1 /end CHARACTERISTIC
/begin CHARACTERISTIC CTsmCrkStFaultTimeout "Hold time for stationary crank fault state [ms]" VALUE 1073877660 __ULong_Value 0 tMillisecond_U32 0 3600000 STEP_SIZE 1 /end CHARACTERISTIC
/begin CHARACTERISTIC CPropshTqSyncFilCoeff "Incoming filter on propshaft torque request for synchronization [Nm]" VALUE 1073877656 __Float32_Value 0 NO_COMPU_METHOD 0 0.5 STEP_SIZE 0.01 FORMAT "%.6" /end CHARACTERISTIC
/begin CHARACTERISTIC CPrelCluReqVehVelThdUpper "Preliminary wheel clutch torque request upper velocity threshold [km/h]" VALUE 1073877652 __SWord_Value 0 tKilometrePerHour_10_S16 -600.0 600.0 STEP_SIZE 1 /end CHARACTERISTIC
/begin CHARACTERISTIC CPrelCluReqVehVelThdLower "Preliminary wheel clutch torque request lower velocity threshold [km/h]" VALUE 1073877650 __SWord_Value 0 tKilometrePerHour_10_S16 -600.0 600.0 STEP_SIZE 1 /end CHARACTERISTIC
/begin CHARACTERISTIC CPrelCluReqSteerAgThdUpper "Preliminary wheel clutch torque request upper steering wheel angle threshold [deg]" VALUE 1073877648 __SWord_Value 0 tDegree_10_S16 -720.0 720.0 STEP_SIZE 1 /end CHARACTERISTIC
/begin CHARACTERISTIC CPrelCluReqSteerAgThdLower "Preliminary wheel clutch torque request lower steering wheel angle threshold [deg]" VALUE 1073877646 __SWord_Value 0 tDegree_10_S16 -720.0 720.0 STEP_SIZE 1 /end CHARACTERISTIC
/begin CHARACTERISTIC CEnaInvCtrlStPlaus "Inverter control state plausibility enable" VALUE 1073877644 __UByte_Value 0 NO_COMPU_METHOD 0 1 STEP_SIZE 1 FORMAT "%.2" /end CHARACTERISTIC
/begin CHARACTERISTIC CInvCtrlStPlausTmr "Inverter control state plausibility time period" VALUE 1073877640 __ULong_Value 0 tMillisecond_U32 0 5000 STEP_SIZE 100 /end CHARACTERISTIC
/begin CHARACTERISTIC CHybIdleChrgPwrHystUppr "Charge torque hysteresis for transitions to couple/decouple idle upper" VALUE 1073877636 __Float32_Value 0 tKilowatt 0 500 STEP_SIZE 1 /end CHARACTERISTIC
/begin CHARACTERISTIC CHybIdleChrgPwrHystLowr "Charge torque hysteresis for transitions to couple/decouple idle lower" VALUE 1073877632 __Float32_Value 0 tKilowatt 0 500 STEP_SIZE 1 /end CHARACTERISTIC
/begin CHARACTERISTIC CForcedChrgBtnStTi "Timer to ignore forced charge change request" VALUE 1073877628 __ULong_Value 0 tMillisecond_U32 0 50000 STEP_SIZE 100 /end CHARACTERISTIC
/begin CHARACTERISTIC CIceOffThrottleTqHybDrvg "Target torque request to engine during lift-off operation [Nm]" VALUE 1073877624 __Float32_Value 0 tNewtonMetre -500 500 STEP_SIZE 10 /end CHARACTERISTIC
/begin CHARACTERISTIC CTpmsWarnLampDisableBelowLowSpd "Ability to disable the warning lamp below SPEED_THRESHOLD" VALUE 1073877623 __UByte_Value 0 NO_COMPU_METHOD 0 1 STEP_SIZE 1 FORMAT "%.2" /end CHARACTERISTIC
/begin CHARACTERISTIC CTpmsSnsrValInvldOverwr "Ability to set temperatures and pressures to invalid value when qualifier Q_FAULTY" VALUE 1073877622 __UByte_Value 0 NO_COMPU_METHOD 0 1 STEP_SIZE 1 FORMAT "%.2" /end CHARACTERISTIC
/begin CHARACTERISTIC CTpmsSpdLimMinNorm "TPMS minimum speed limit for regular tires" VALUE 1073877620 __SWord_Value 0 tKilometrePerHour_10_S16 -600.0 600.0 STEP_SIZE 1 /end CHARACTERISTIC
/begin CHARACTERISTIC CTpmsSpdLimMaxNorm "TPMS maximum speed limit for regular tires" VALUE 1073877618 __SWord_Value 0 tKilometrePerHour_10_S16 -600.0 600.0 STEP_SIZE 1 /end CHARACTERISTIC
/begin CHARACTERISTIC CTpmsSpdLimMinWinter "TPMS minimum speed limit for winter tires" VALUE 1073877616 __SWord_Value 0 tKilometrePerHour_10_S16 -600.0 600.0 STEP_SIZE 1 /end CHARACTERISTIC
/begin CHARACTERISTIC CTpmsSpdLimMaxWinter "TPMS maximum speed limit for winter tires" VALUE 1073877614 __SWord_Value 0 tKilometrePerHour_10_S16 -600.0 600.0 STEP_SIZE 1 /end CHARACTERISTIC
/begin CHARACTERISTIC CEcp80PumpMaxSpd "ecp80 pump max speed" VALUE 1073877460 __Float32_Value 0 tRevolutionPerMinute 0 10000 STEP_SIZE 1 /end CHARACTERISTIC
/begin CHARACTERISTIC CFicFanMaxSpd "cwa100 pump max speed" VALUE 1073877448 __Float32_Value 0 tRevolutionPerMinute 0 10000 STEP_SIZE 1 /end CHARACTERISTIC
/begin CHARACTERISTIC CThermalUnitReqThrForDiag "Fans and pumps request threshold to detect fault/stall" VALUE 1073877232 __SByte_Value 0 tPercent_S8 0 100 STEP_SIZE 1 /end CHARACTERISTIC
/begin CHARACTERISTIC CThermalUnitFaultDebounceTime "Debounce time after which set a fault for fan or pump" VALUE 1073877228 __ULong_Value 0 tMillisecond_U32 0 3600000 STEP_SIZE 10 /end CHARACTERISTIC
/begin CHARACTERISTIC CThermalUnitSpdTolForDiag "Fans and pumps speed threshold to detect a fault" VALUE 1073877224 __Float32_Value 0 tRevolutionPerMinute 0 3000 STEP_SIZE 1 /end CHARACTERISTIC
/begin CHARACTERISTIC CThermalUnitBootUpTime "Timer to wait for fans and pumps to stabilize at first ignition" VALUE 1073877220 __ULong_Value 0 tMillisecond_U32 0 3600000 STEP_SIZE 1 /end CHARACTERISTIC
/begin CHARACTERISTIC CThermalUnitFaultTimeout "Timer to set fault flag [s]" VALUE 1073877216 __ULong_Value 0 tMillisecond_U32 0 3600000 STEP_SIZE 1 /end CHARACTERISTIC
/begin CHARACTERISTIC CPowerEnterMargin "Dcdc Power threshold to enter thermal derating  [kW]" VALUE 1073877212 __Float32_Value 0 tKilowatt 0 10 STEP_SIZE 0.1 /end CHARACTERISTIC
/begin CHARACTERISTIC CPowerExitMargin "Dcdc Power threshold to enter thermal derating  [kW]" VALUE 1073877208 __Float32_Value 0 tKilowatt 0 10 STEP_SIZE 0.1 /end CHARACTERISTIC
/begin CHARACTERISTIC CPowerRestoreMargin "Dcdc Power threshold to enter thermal derating  [kW]" VALUE 1073877204 __Float32_Value 0 tKilowatt 0 10 STEP_SIZE 0.1 /end CHARACTERISTIC
/begin CHARACTERISTIC CRestoreTime "Time to enter thermal derating [ms]" VALUE 1073877200 __ULong_Value 0 tMillisecond_U32 0 10000 STEP_SIZE 10 /end CHARACTERISTIC
/begin CHARACTERISTIC CEnterDeratingTime "Time to enter thermal derating [ms]" VALUE 1073877196 __ULong_Value 0 tMillisecond_U32 0 10000 STEP_SIZE 10 /end CHARACTERISTIC
/begin CHARACTERISTIC CExitDeratingTime "Time to exit thermal derating [ms]" VALUE 1073877192 __ULong_Value 0 tMillisecond_U32 0 10000 STEP_SIZE 10 /end CHARACTERISTIC
/begin CHARACTERISTIC CStepUpTime "Step change timers [ms]" VALUE 1073877188 __ULong_Value 0 tMillisecond_U32 0 10000 STEP_SIZE 10 /end CHARACTERISTIC
/begin CHARACTERISTIC CStepDownTime "Step change timers [ms]" VALUE 1073877184 __ULong_Value 0 tMillisecond_U32 0 10000 STEP_SIZE 10 /end CHARACTERISTIC
/begin CHARACTERISTIC CInverterPumpMinimumCommand "Minimum safe commands for critical 48V pumps [%]" VALUE 1073877183 __SByte_Value 0 tPercent_S8 0 100 STEP_SIZE 5 /end CHARACTERISTIC
/begin CHARACTERISTIC CHvBatteryPumpMinimumCommand "Minimum safe commands for critical 48V pumps [%]" VALUE 1073877182 __SByte_Value 0 tPercent_S8 0 100 STEP_SIZE 5 /end CHARACTERISTIC
/begin CHARACTERISTIC CNonCriticalMinimumCommand "Command for non critical loads, can be derated fully [%]" VALUE 1073877181 __SByte_Value 0 tPercent_S8 0 100 STEP_SIZE 5 /end CHARACTERISTIC
/begin CHARACTERISTIC CThrmMgrFactoryTestEnbl "Thermal factory test enabler to check all fans and pumps are working during start up" VALUE 1073877094 __UByte_Value 0 NO_COMPU_METHOD 0 1 STEP_SIZE 1 FORMAT "%.2" /end CHARACTERISTIC
/begin CHARACTERISTIC CFactoryTestFanReq "Default fan request for factory test" VALUE 1073877093 __SByte_Value 0 tPercent_S8 0 100 STEP_SIZE 5 /end CHARACTERISTIC
/begin CHARACTERISTIC CFactoryTestPumpReq "Default pump request for factory test" VALUE 1073877092 __SByte_Value 0 tPercent_S8 0 100 STEP_SIZE 5 /end CHARACTERISTIC
/begin CHARACTERISTIC CVehMassBase "Curb weight, ready-to-drive vehicle + driver without fuel [kg]" VALUE 1073877000 __SWord_Value 0 tKilogram_S16 0 4000 STEP_SIZE 25 /end CHARACTERISTIC
/begin CHARACTERISTIC CVehYawInertia "Vehicle total yaw inertia [kgm^2] Calculated using steiners theorem Assumed sprung mass 70% of vehicle Used unsprung mass and wheelbase/track for Izz contributions of the wheels" VALUE 1073876996 __Float32_Value 0 tKilogramSquareMetre 0 3000 STEP_SIZE 1 /end CHARACTERISTIC
/begin CHARACTERISTIC CVehFrntTrackWidth "lateral distance between front tire contact centres [m]" VALUE 1073876992 __Float32_Value 0 tMetre 0.0 3.0 STEP_SIZE 0.1 /end CHARACTERISTIC
/begin CHARACTERISTIC CVehReTrackWidth "lateral distance between rear tire contact centres [m]" VALUE 1073876988 __Float32_Value 0 tMetre 0.0 3.0 STEP_SIZE 0.1 /end CHARACTERISTIC
/begin CHARACTERISTIC CVehFrntWheelbase "longitudinal distance from front axle to centre of gravity [m]" VALUE 1073876984 __Float32_Value 0 tMetre 0.0 3.0 STEP_SIZE 0.1 /end CHARACTERISTIC
/begin CHARACTERISTIC CVehReWheelbase "longitudinal distance from rear axle to centre of gravity [m]" VALUE 1073876980 __Float32_Value 0 tMetre 0.0 3.0 STEP_SIZE 0.1 /end CHARACTERISTIC
/begin CHARACTERISTIC CVsoWhlTqFrntBrkThermalInertia "Front brake thermal inertia [J/K]" VALUE 1073876952 __Float32_Value 0 NO_COMPU_METHOD 0 50000 STEP_SIZE 100 FORMAT "%.6" /end CHARACTERISTIC
/begin CHARACTERISTIC CVsoWhlTqRearBrkThermalInertia "Rear brake thermal inertia [J/K]" VALUE 1073876936 __Float32_Value 0 NO_COMPU_METHOD 0 50000 STEP_SIZE 100 FORMAT "%.6" /end CHARACTERISTIC
/begin CHARACTERISTIC CVsoWhlTqFrntBrkRadius "Front brake contact radius [mm]" VALUE 1073876912 __SWord_Value 0 tMillimetre_10_S16 0 1000 STEP_SIZE 10 /end CHARACTERISTIC
/begin CHARACTERISTIC CVsoWhlTqFrntBrkArea "Front brake total equivalent caliper contact area [m^2]" VALUE 1073876908 __Float32_Value 0 tMetreSquared 0 0.1 STEP_SIZE 0.001 /end CHARACTERISTIC
/begin CHARACTERISTIC CVsoWhlTqReBrkRadius "Rear brake contact radius [mm]" VALUE 1073876884 __SWord_Value 0 tMillimetre_10_S16 0 1000 STEP_SIZE 10 /end CHARACTERISTIC
/begin CHARACTERISTIC CVsoWhlTqReBrkArea "Rear brake total equivalent caliper contact area [m^2]" VALUE 1073876880 __Float32_Value 0 tMetreSquared 0 0.1 STEP_SIZE 0.001 /end CHARACTERISTIC
/begin CHARACTERISTIC CVsoWhlTqMaxFricBrkP "Maximum brake pressure in caliper [bar]" VALUE 1073876876 __SWord_Value 0 tBar_10_S16 0 200 STEP_SIZE 10 /end CHARACTERISTIC
/begin CHARACTERISTIC CVsoVehAgEnaSwt "Switch vehicle angle estimation between sensor only, kalman filter or default (Based on Track default setup)" VALUE 1073876872 __ULong_Value 0 tVsoVehicleAngleSwt 0 2 STEP_SIZE 1 /end CHARACTERISTIC
/begin CHARACTERISTIC CVsoVehAgRollProcessCovariance "Noise/uncertainty in model-based roll angle estimate (using roll speed from KW)" VALUE 1073876868 __Float32_Value 0 NO_COMPU_METHOD 0 1.0 STEP_SIZE 0.01 FORMAT "%.6" /end CHARACTERISTIC
/begin CHARACTERISTIC CVsoVehAgRollObserverCovariance "Noise/uncertainty in model-based pitch angle estimate (using pitch speed from KW)" VALUE 1073876864 __Float32_Value 0 NO_COMPU_METHOD 0 1.0 STEP_SIZE 0.01 FORMAT "%.6" /end CHARACTERISTIC
/begin CHARACTERISTIC CVsoVehAgPitchProcessCovariance "Noise/uncertainty in sensor-based roll angle estimate (using wheel travel estimates)" VALUE 1073876860 __Float32_Value 0 NO_COMPU_METHOD 0 1.0 STEP_SIZE 0.01 FORMAT "%.6" /end CHARACTERISTIC
/begin CHARACTERISTIC CVsoVehAgPitchObserverCovariance "Noise/uncertainty in sensor-based pitch angle estimate (using wheel travel estimates)" VALUE 1073876856 __Float32_Value 0 NO_COMPU_METHOD 0 1.0 STEP_SIZE 0.01 FORMAT "%.6" /end CHARACTERISTIC
/begin CHARACTERISTIC CVsoImuAccelVariSnsr1 "Estimated variance in Sensor1 acceleration readings" VALUE 1073876780 __Float32_Value 0 NO_COMPU_METHOD 0 1.0 STEP_SIZE 0.01 FORMAT "%.6" /end CHARACTERISTIC
/begin CHARACTERISTIC CVsoImuGyroVariSnsr1 "Estimated variance in Sensor1 gyroscope readings" VALUE 1073876776 __Float32_Value 0 NO_COMPU_METHOD 0 1.0 STEP_SIZE 0.01 FORMAT "%.6" /end CHARACTERISTIC
/begin CHARACTERISTIC CVsoImuAccelVariSnsr2 "Estimated variance in Sensor2 acceleration readings" VALUE 1073876724 __Float32_Value 0 NO_COMPU_METHOD 0 1.0 STEP_SIZE 0.01 FORMAT "%.6" /end CHARACTERISTIC
/begin CHARACTERISTIC CVsoImuGyroVariSnsr2 "Estimated variance in Sensor2 gyroscope readings" VALUE 1073876720 __Float32_Value 0 NO_COMPU_METHOD 0 1.0 STEP_SIZE 0.01 FORMAT "%.6" /end CHARACTERISTIC
/begin CHARACTERISTIC CVsoImuAccelVariSnsr3 "Estimated variance in Sensor3 acceleration readings" VALUE 1073876668 __Float32_Value 0 NO_COMPU_METHOD 0 1.0 STEP_SIZE 0.01 FORMAT "%.6" /end CHARACTERISTIC
/begin CHARACTERISTIC CVsoImuGyroVariSnsr3 "Estimated variance in Sensor3 gyroscope readings" VALUE 1073876664 __Float32_Value 0 NO_COMPU_METHOD 0 1.0 STEP_SIZE 0.01 FORMAT "%.6" /end CHARACTERISTIC
/begin CHARACTERISTIC CVsoImuCalCntrRst "IMU calibration averaging count" VALUE 1073876660 __ULong_Value 0 NO_COMPU_METHOD 0 3000 STEP_SIZE 100 FORMAT "%.0" /end CHARACTERISTIC
/begin CHARACTERISTIC CVsoImuDiagAccelVectNormMax "Maximum threshold of acceleration vector norm to run a 'rotation calibration needed' diag [m/s^2]" VALUE 1073876656 __Float32_Value 0 tMetrePerSquareSecond 0.0 20.0 STEP_SIZE 0.1 /end CHARACTERISTIC
/begin CHARACTERISTIC CVsoImuDiagAgErrMax "Maximum error angle between accel vectors to trigger the 'rotation calibration needed' flags [deg]" VALUE 1073876652 __Float32_Value 0 tDegree 0.0 20.0 STEP_SIZE 0.1 /end CHARACTERISTIC
/begin CHARACTERISTIC CVsoImuDiagCntrRst "Count to trigger the 'rotation calibration needed' flags [100*s]" VALUE 1073876648 __ULong_Value 0 NO_COMPU_METHOD 0 3000 STEP_SIZE 100 FORMAT "%.0" /end CHARACTERISTIC
/begin CHARACTERISTIC CVsoRollgDirZeroWhlRateThreshold "Wheel rate zero threshold [rad/s]" VALUE 1073876620 __Float32_Value 0 tRadianPerSecond 0.0 10.0 STEP_SIZE 0.1 /end CHARACTERISTIC
/begin CHARACTERISTIC CVsoRollgDirBrakePressureThreshold "Brake pressure threshold to detect stationary vehicle [bar]" VALUE 1073876616 __Float32_Value 0 tBar 0.0 100.0 STEP_SIZE 0.5 /end CHARACTERISTIC
/begin CHARACTERISTIC CVsoRollgDirTakeoffTorque "Torque threshold for takeoff detection [Nm]" VALUE 1073876612 __Float32_Value 0 tNewtonMetre 0.0 2000.0 STEP_SIZE 10.0 /end CHARACTERISTIC
/begin CHARACTERISTIC CVsoRollgDirTakeoffAccel "Acceleration threshold for takeoff detection [m/s^2]" VALUE 1073876608 __Float32_Value 0 tMetrePerSquareSecond 0.0 20.0 STEP_SIZE 0.1 /end CHARACTERISTIC
/begin CHARACTERISTIC CVsoVehMassClosedLoopEnable "bit to enable the closed loop mass calculation based on suspension travel" VALUE 1073876582 __UByte_Value 0 NO_COMPU_METHOD 0 1 STEP_SIZE 1 FORMAT "%.2" /end CHARACTERISTIC
/begin CHARACTERISTIC CVsoVehMassPassengerAdult "weight added to vehicle per adult occupant detected (excl driver) [kg]" VALUE 1073876580 __SWord_Value 0 tKilogram_S16 0 200 STEP_SIZE 5 /end CHARACTERISTIC
/begin CHARACTERISTIC CVsoVehMassPassengerChild "weight added to vehicle per child occupant detected (excl driver) [kg]" VALUE 1073876578 __SWord_Value 0 tKilogram_S16 0 200 STEP_SIZE 5 /end CHARACTERISTIC
/begin CHARACTERISTIC CVsoVehMassDamprSpdThd "threshold for 'zero' damper velocity [m/s]" VALUE 1073876576 __SWord_Value 0 tMillimetrePerSecond_S16 0 200 STEP_SIZE 1 /end CHARACTERISTIC
/begin CHARACTERISTIC CVsoWhlAgFrontStaticToe "Front wheel total static toe angle (+ve inwards) [deg]" VALUE 1073876482 __SWord_Value 0 tDegree_10_S16 -720.0 720.0 STEP_SIZE 1 /end CHARACTERISTIC
/begin CHARACTERISTIC CVsoWhlAgReStaticToe "Rear wheel total static toe angle (+ve inwards) [deg]" VALUE 1073876480 __SWord_Value 0 tDegree_10_S16 -720.0 720.0 STEP_SIZE 1 /end CHARACTERISTIC
/begin CHARACTERISTIC CVsoTireRadFrntCup2Free "Tire free (outer) radius - Front Cup 2 [mm]" VALUE 1073875988 __SWord_Value 0 tMillimetre_10_S16 -1000.0 1000.0 STEP_SIZE 1 /end CHARACTERISTIC
/begin CHARACTERISTIC CVsoTireRadFrntCup2RFree "Tire free (outer) radius - Front Cup 2R [mm]" VALUE 1073875986 __SWord_Value 0 tMillimetre_10_S16 -1000.0 1000.0 STEP_SIZE 1 /end CHARACTERISTIC
/begin CHARACTERISTIC CVsoTireRadFrntAlpinFree "Tire free (outer) radius - Front Alpin [mm]" VALUE 1073875984 __SWord_Value 0 tMillimetre_10_S16 -1000.0 1000.0 STEP_SIZE 1 /end CHARACTERISTIC
/begin CHARACTERISTIC CVsoTireRadFrntCup2SpdFac "Tire quadratic growth with speed - Front Cup 2" VALUE 1073875980 __Float32_Value 0 tFactor -3.40282346639E+38 3.40282346639E+38 STEP_SIZE 1 /end CHARACTERISTIC
/begin CHARACTERISTIC CVsoTireRadFrntCup2RSpdFac "Tire quadratic growth with speed - Front Cup 2R" VALUE 1073875976 __Float32_Value 0 tFactor -3.40282346639E+38 3.40282346639E+38 STEP_SIZE 1 /end CHARACTERISTIC
/begin CHARACTERISTIC CVsoTireRadFrntAlpinSpdFac "Tire quadratic growth with speed - Front Alpin" VALUE 1073875972 __Float32_Value 0 tFactor -3.40282346639E+38 3.40282346639E+38 STEP_SIZE 1 /end CHARACTERISTIC
/begin CHARACTERISTIC CVsoTireRadFrntCup2PresFac "Tire pressure linear effect on radius - Front Cup 2" VALUE 1073875968 __Float32_Value 0 tFactor -3.40282346639E+38 3.40282346639E+38 STEP_SIZE 1 /end CHARACTERISTIC
/begin CHARACTERISTIC CVsoTireRadFrntCup2RPresFac "Tire pressure linear effect on radius - Front Cup 2R" VALUE 1073875964 __Float32_Value 0 tFactor -3.40282346639E+38 3.40282346639E+38 STEP_SIZE 1 /end CHARACTERISTIC
/begin CHARACTERISTIC CVsoTireRadFrntAlpinPresFac "Tire pressure linear effect on radius - Front Alpin" VALUE 1073875960 __Float32_Value 0 tFactor -3.40282346639E+38 3.40282346639E+38 STEP_SIZE 1 /end CHARACTERISTIC
/begin CHARACTERISTIC CVsoTireRadFrntCup2PresQuad "Tire pressure quadratic effect on radius - Front Cup 2" VALUE 1073875956 __Float32_Value 0 tFactor -3.40282346639E+38 3.40282346639E+38 STEP_SIZE 1 /end CHARACTERISTIC
/begin CHARACTERISTIC CVsoTireRadFrntCup2RPresQuad "Tire pressure quadratic effect on radius - Front Cup 2R" VALUE 1073875952 __Float32_Value 0 tFactor -3.40282346639E+38 3.40282346639E+38 STEP_SIZE 1 /end CHARACTERISTIC
/begin CHARACTERISTIC CVsoTireRadFrntAlpinPresQuad "Tire pressure quadratic effect on radius - Front Alpin" VALUE 1073875948 __Float32_Value 0 tFactor -3.40282346639E+38 3.40282346639E+38 STEP_SIZE 1 /end CHARACTERISTIC
/begin CHARACTERISTIC CVsoTireRadReCup2Free "Tire free (outer) radius - Rear Cup 2 [mm]" VALUE 1073875896 __SWord_Value 0 tMillimetre_10_S16 -1000.0 1000.0 STEP_SIZE 1 /end CHARACTERISTIC
/begin CHARACTERISTIC CVsoTireRadReCup2RFree "Tire free (outer) radius - Rear Cup 2R [mm]" VALUE 1073875894 __SWord_Value 0 tMillimetre_10_S16 -1000.0 1000.0 STEP_SIZE 1 /end CHARACTERISTIC
/begin CHARACTERISTIC CVsoTireRadReAlpinFree "Tire free (outer) radius - Rear Alpin [mm]" VALUE 1073875892 __SWord_Value 0 tMillimetre_10_S16 -1000.0 1000.0 STEP_SIZE 1 /end CHARACTERISTIC
/begin CHARACTERISTIC CVsoTireRadReCup2SpdFac "Tire quadratic growth with speed - Rear Cup 2" VALUE 1073875888 __Float32_Value 0 tFactor -3.40282346639E+38 3.40282346639E+38 STEP_SIZE 1 /end CHARACTERISTIC
/begin CHARACTERISTIC CVsoTireRadReCup2RSpdFac "Tire quadratic growth with speed - Rear Cup 2R" VALUE 1073875884 __Float32_Value 0 tFactor -3.40282346639E+38 3.40282346639E+38 STEP_SIZE 1 /end CHARACTERISTIC
/begin CHARACTERISTIC CVsoTireRadReAlpinSpdFac "Tire quadratic growth with speed - Rear Alpin" VALUE 1073875880 __Float32_Value 0 tFactor -3.40282346639E+38 3.40282346639E+38 STEP_SIZE 1 /end CHARACTERISTIC
/begin CHARACTERISTIC CVsoTireRadReCup2PresFac "Tire pressure linear effect on radius - Rear Cup 2" VALUE 1073875876 __Float32_Value 0 tFactor -3.40282346639E+38 3.40282346639E+38 STEP_SIZE 1 /end CHARACTERISTIC
/begin CHARACTERISTIC CVsoTireRadReCup2RPresFac "Tire pressure linear effect on radius - Rear Cup 2R" VALUE 1073875872 __Float32_Value 0 tFactor -3.40282346639E+38 3.40282346639E+38 STEP_SIZE 1 /end CHARACTERISTIC
/begin CHARACTERISTIC CVsoTireRadReAlpinPresFac "Tire pressure linear effect on radius - Rear Alpin" VALUE 1073875868 __Float32_Value 0 tFactor -3.40282346639E+38 3.40282346639E+38 STEP_SIZE 1 /end CHARACTERISTIC
/begin CHARACTERISTIC CVsoTireRadReCup2PresQuad "Tire pressure quadratic effect on radius - Rear Cup 2" VALUE 1073875864 __Float32_Value 0 tFactor -3.40282346639E+38 3.40282346639E+38 STEP_SIZE 1 /end CHARACTERISTIC
/begin CHARACTERISTIC CVsoTireRadReCup2RPresQuad "Tire pressure quadratic effect on radius - Rear Cup 2R" VALUE 1073875860 __Float32_Value 0 tFactor -3.40282346639E+38 3.40282346639E+38 STEP_SIZE 1 /end CHARACTERISTIC
/begin CHARACTERISTIC CVsoTireRadReAlpinPresQuad "Tire pressure quadratic effect on radius - Rear Alpin" VALUE 1073875856 __Float32_Value 0 tFactor -3.40282346639E+38 3.40282346639E+38 STEP_SIZE 1 /end CHARACTERISTIC
/begin CHARACTERISTIC CVsoTireRadAdaptEnable "Tire radius adaption enable bit" VALUE 1073875816 __UByte_Value 0 NO_COMPU_METHOD 0 1 STEP_SIZE 1 FORMAT "%.2" /end CHARACTERISTIC
/begin CHARACTERISTIC CVsoTireRadAdaptFilterCutoffFreq "Tire radius adaption factor filter normalized cutoff frequency" VALUE 1073875812 __Float32_Value 0 tFactor -3.40282346639E+38 3.40282346639E+38 STEP_SIZE 1 /end CHARACTERISTIC
/begin CHARACTERISTIC CVsoTireRadAdaptMaxSpd "Maximum speed at which a tire radius adaption factor is calculated [km/h]" VALUE 1073875808 __SWord_Value 0 tKilometrePerHour_10_S16 -600.0 600.0 STEP_SIZE 1 /end CHARACTERISTIC
/begin CHARACTERISTIC CVsoTireRadAdaptMinSpd "Minimum speed at which a tire radius adaption factor is calculated [km/h]" VALUE 1073875806 __SWord_Value 0 tKilometrePerHour_10_S16 -600.0 600.0 STEP_SIZE 1 /end CHARACTERISTIC
/begin CHARACTERISTIC CVsoTireRadAdaptMaxSteer "Maximum steer angle at which a tire radius adaption factor is calculated [deg]" VALUE 1073875804 __SWord_Value 0 tDegree_10_S16 -720.0 720.0 STEP_SIZE 1 /end CHARACTERISTIC
/begin CHARACTERISTIC CVsoTireRadAdaptMaxAccel "Maximum tangential acceleration magnitude at which a tire radius adaption factor is calculated [m/s^2]" VALUE 1073875800 __Float32_Value 0 tMetrePerSquareSecond -50 50 STEP_SIZE 1 /end CHARACTERISTIC
/begin CHARACTERISTIC CVsoTireRadAdaptMinFactor "Tire radius adaption factor minimum value" VALUE 1073875796 __Float32_Value 0 tFactor -3.40282346639E+38 3.40282346639E+38 STEP_SIZE 1 /end CHARACTERISTIC
/begin CHARACTERISTIC CVsoTireRadAdaptMaxFactor "Tire radius adaption factor maximum value" VALUE 1073875792 __Float32_Value 0 tFactor -3.40282346639E+38 3.40282346639E+38 STEP_SIZE 1 /end CHARACTERISTIC
/begin CHARACTERISTIC CVsoTireRadAdaptMinFactorFault "Tire radius adaption factor minimum fault threshold" VALUE 1073875788 __Float32_Value 0 tFactor -3.40282346639E+38 3.40282346639E+38 STEP_SIZE 1 /end CHARACTERISTIC
/begin CHARACTERISTIC CVsoTireRadAdaptMaxFactorFault "Tire radius adaption factor maximum fault threshold" VALUE 1073875784 __Float32_Value 0 tFactor -3.40282346639E+38 3.40282346639E+38 STEP_SIZE 1 /end CHARACTERISTIC
/begin CHARACTERISTIC CVsoWhlSpdDerivativeFilterCutoffFreq "Wheelspeed derivative normalized cutoff frequency" VALUE 1073875780 __Float32_Value 0 NO_COMPU_METHOD -3.40282346639E+38 3.40282346639E+38 STEP_SIZE 1 FORMAT "%.6" /end CHARACTERISTIC
/begin CHARACTERISTIC CVsoWhlSpdAccelFilterCutoffFreq "Wheelspeed total acceleration normalized cutoff frequency" VALUE 1073875776 __Float32_Value 0 NO_COMPU_METHOD -3.40282346639E+38 3.40282346639E+38 STEP_SIZE 1 FORMAT "%.6" /end CHARACTERISTIC
/begin CHARACTERISTIC CVsoWhlSpdOutputFilterCutoffFreq "Wheelspeed velocity normalized cutoff frequency" VALUE 1073875772 __Float32_Value 0 NO_COMPU_METHOD -3.40282346639E+38 3.40282346639E+38 STEP_SIZE 1 FORMAT "%.6" /end CHARACTERISTIC
/begin CHARACTERISTIC CVsoWhlSpdBrakeLimit "Braking acceleration threshold to implement max(wheelspeed) [m/s^2]" VALUE 1073875768 __Float32_Value 0 tMetrePerSquareSecond -50 50 STEP_SIZE 1 /end CHARACTERISTIC
/begin CHARACTERISTIC CVsoWhlSpdAccelLimit "Acceleration threshold to implement min(wheelspeed) [m/s^2]" VALUE 1073875764 __Float32_Value 0 tMetrePerSquareSecond -50 50 STEP_SIZE 1 /end CHARACTERISTIC
/begin CHARACTERISTIC CVsoWhlSpdAccelErrorWeight "Weight for wheelspeed acceleration error in weighted average calculation (compared to the speed deviation error)" VALUE 1073875760 __Float32_Value 0 NO_COMPU_METHOD -3.40282346639E+38 3.40282346639E+38 STEP_SIZE 1 FORMAT "%.6" /end CHARACTERISTIC
/begin CHARACTERISTIC CVsoWhlSpdTqPenalty "Weight for wheel torque term in weighted average calculation (compared to the speed deviation error)" VALUE 1073875756 __Float32_Value 0 NO_COMPU_METHOD -3.40282346639E+38 3.40282346639E+38 STEP_SIZE 1 FORMAT "%.6" /end CHARACTERISTIC
/begin CHARACTERISTIC CVsoWhlSpdLowQlyPenalty "Added penalty to weights due to a Q_LOW_QUALITY signal" VALUE 1073875752 __Float32_Value 0 NO_COMPU_METHOD -3.40282346639E+38 3.40282346639E+38 STEP_SIZE 1 FORMAT "%.6" /end CHARACTERISTIC
/begin CHARACTERISTIC CVsoWhlSpdMinSnsrCnt "Minimum number of wheel rate sensors online to consider estimator 'normal'" VALUE 1073875748 __UByte_Value 0 NO_COMPU_METHOD 0 255 STEP_SIZE 1 FORMAT "%.0" /end CHARACTERISTIC
/begin CHARACTERISTIC CVsoWhlSpdSlipGrad "Bulk-average tire longitudinal slip stiffness for corrected speed torque compensation" VALUE 1073875744 __Float32_Value 0 NO_COMPU_METHOD -3.40282346639E+38 3.40282346639E+38 STEP_SIZE 1 FORMAT "%.6" /end CHARACTERISTIC
/begin CHARACTERISTIC CVsoVehMtnObsvrSwt "Select observer mode: OFF: input quantities are passed through were possible, zeroed otherwise KIN: Kinematic observer estimated quantities are taken for the output, input quantities are passed through otherwise; dynamic observer runs in background for logging DYN: Dynamic observer estimated quantities are taken for the output, input quantities are passed through otherwise ; kinematic observer runs in background for logging HYB: Hybrid observer running using both Kinematic and Dynamic observers" VALUE 1073875740 __ULong_Value 0 tVsoVehicleMotionObserverSwt 0 4 STEP_SIZE 1 /end CHARACTERISTIC
/begin CHARACTERISTIC CVsoKsoPole0 "Kinematic State observer poles and decay factors" VALUE 1073875736 __Float32_Value 0 NO_COMPU_METHOD -3.40282346639E+38 3.40282346639E+38 STEP_SIZE 1 FORMAT "%.6" /end CHARACTERISTIC
/begin CHARACTERISTIC CVsoKsoPole1 "" VALUE 1073875732 __Float32_Value 0 NO_COMPU_METHOD -3.40282346639E+38 3.40282346639E+38 STEP_SIZE 1 FORMAT "%.6" /end CHARACTERISTIC
/begin CHARACTERISTIC CVsoKsoDecay0 "" VALUE 1073875728 __Float32_Value 0 NO_COMPU_METHOD -3.40282346639E+38 3.40282346639E+38 STEP_SIZE 1 FORMAT "%.6" /end CHARACTERISTIC
/begin CHARACTERISTIC CVsoKsoDecay1 "" VALUE 1073875724 __Float32_Value 0 NO_COMPU_METHOD -3.40282346639E+38 3.40282346639E+38 STEP_SIZE 1 FORMAT "%.6" /end CHARACTERISTIC
/begin CHARACTERISTIC CVsoDsoMinSpd "VSO dynamic state observer minimum working speed [km/h]" VALUE 1073875720 __Float32_Value 0 tKilometrePerHour 0.1 30 STEP_SIZE 1 /end CHARACTERISTIC
/begin CHARACTERISTIC CVsoDsoVehVelLatMaxAbs "VSO dynamic state observer maximum lateral vehicle velocity absolute value [m/s]" VALUE 1073875716 __Float32_Value 0 tMetrePerSecond 0 30 STEP_SIZE 1 /end CHARACTERISTIC
/begin CHARACTERISTIC CVsoDsoVehYawRateMaxAbs "VSO dynamic state observer maximum yaw rate [rad/s]" VALUE 1073875712 __Float32_Value 0 tRadianPerSecond 0 30 STEP_SIZE 1 /end CHARACTERISTIC
/begin CHARACTERISTIC CVsoRoadAgStatyCalcnEna "Enable simple calculation of road gradient and banking in standstill" VALUE 1073875528 __UByte_Value 0 NO_COMPU_METHOD 0 1 STEP_SIZE 1 FORMAT "%.2" /end CHARACTERISTIC
/begin CHARACTERISTIC CVsoRoadAgAccelThd "Vehicle longitudinal acceleration treshold to evaluate road angles" VALUE 1073875524 __Float32_Value 0 tMetrePerSquareSecond -50 50 STEP_SIZE 1 /end CHARACTERISTIC
/begin CHARACTERISTIC CTestVsoRoadAgOvrdEna "Enable override of road gradient and bank calculation" VALUE 1073875522 __UByte_Value 0 NO_COMPU_METHOD 0 1 STEP_SIZE 1 FORMAT "%.2" /end CHARACTERISTIC
/begin CHARACTERISTIC CTestVsoRoadGrdtOvrd "Override road gradient calculation, requires CTestVsoRoadAgOvrdEna = true" VALUE 1073875520 __SWord_Value 0 tDegree_10_S16 -720.0 720.0 STEP_SIZE 1 /end CHARACTERISTIC
/begin CHARACTERISTIC CTestVsoRoadBnkOvrd "Override road banking calculation, requires CTestVsoRoadAgOvrdEna = true" VALUE 1073875518 __SWord_Value 0 tDegree_10_S16 -720.0 720.0 STEP_SIZE 1 /end CHARACTERISTIC
/begin CHARACTERISTIC CVsoRoadAgFiltEna "Road gradient and bank filter enable" VALUE 1073875516 __UByte_Value 0 NO_COMPU_METHOD 0 1 STEP_SIZE 1 FORMAT "%.2" /end CHARACTERISTIC
/begin CHARACTERISTIC CVsoRoadAgFilCoeff "Road gradient and bank filter coefficient" VALUE 1073875512 __Float32_Value 0 tFactor -3.40282346639E+38 3.40282346639E+38 STEP_SIZE 1 /end CHARACTERISTIC
/begin CHARACTERISTIC CTestVsoTireMdlFricCoeffEstimnEnaSt "Enable tire friction estimation" VALUE 1073875508 __ULong_Value 0 tEnableState 0 3 STEP_SIZE 1 /end CHARACTERISTIC
/begin CHARACTERISTIC CTestVsoTireMdlTireMaxFRednFacEnaSt "Enable the tire max force (longitudinal and lateral) reduction based on actual slip ratio" VALUE 1073875504 __ULong_Value 0 tEnableState 0 3 STEP_SIZE 1 /end CHARACTERISTIC
/begin CHARACTERISTIC CVsoTireRoadFricCoeffConDry "Tire Model: constant tire-road friction coefficient on dry asphalt" VALUE 1073875404 __Float32_Value 0 tFactor 0 1 STEP_SIZE 0.1 /end CHARACTERISTIC
/begin CHARACTERISTIC CVsoTireRoadFricCoeffConIce "Tire Model: constant tire-road friction coefficient on ice" VALUE 1073875400 __Float32_Value 0 tFactor 0 1 STEP_SIZE 0.1 /end CHARACTERISTIC
/begin CHARACTERISTIC CVsoTireMdlMaxPureLgtSlipCon "Initial Tire Model: constant maximum pure longitudinal slip" VALUE 1073875372 __Float32_Value 0 tFactor 0 0.30 STEP_SIZE 0.005 /end CHARACTERISTIC
/begin CHARACTERISTIC CVsoTireMdlFricHiLgtSlipThd "Initial Tire Model: tire slip to trigger a low to high mu transition" VALUE 1073875368 __Float32_Value 0 tFactor 0 0.30 STEP_SIZE 0.005 /end CHARACTERISTIC
/begin CHARACTERISTIC CVsoTireMdlMaxPureLatSlipCon "Initial Tire Model: constant maximum pure lateral slip" VALUE 1073875364 __Float32_Value 0 tRadian 0 0.8 STEP_SIZE 0.05 /end CHARACTERISTIC
/begin CHARACTERISTIC CVsoTireMdlPureLatSlipStfnCon "Initial Tire Model: constant pure lateral slip stiffness [mu/rad]" VALUE 1073875360 __Float32_Value 0 NO_COMPU_METHOD 0 50 STEP_SIZE 1 FORMAT "%.6" /end CHARACTERISTIC
/begin CHARACTERISTIC CVsoAeroLoadConst "Aerodynamic downforce coefficient" VALUE 1073875356 __Float32_Value 0 tFactor -3.40282346639E+38 3.40282346639E+38 STEP_SIZE 1 /end CHARACTERISTIC
/begin CHARACTERISTIC CVsoAeroDragArea "Aerodynamic drag equation frontal area [m^2]" VALUE 1073875352 __Float32_Value 0 tMetreSquared 0 10 STEP_SIZE 1 /end CHARACTERISTIC
/begin CHARACTERISTIC CVsoAeroDragConst "Aerodynamic drag equation constant coefficient [-]" VALUE 1073875348 __Float32_Value 0 NO_COMPU_METHOD -3.40282346639E+38 3.40282346639E+38 STEP_SIZE 1 FORMAT "%.6" /end CHARACTERISTIC
/begin CHARACTERISTIC CVsoAeroDragFrntTrvlCoeff "Aerodynamic drag equation linear coefficient, front wheel travel [m^-1]" VALUE 1073875344 __Float32_Value 0 NO_COMPU_METHOD -3.40282346639E+38 3.40282346639E+38 STEP_SIZE 1 FORMAT "%.6" /end CHARACTERISTIC
/begin CHARACTERISTIC CVsoAeroDragRearTrvlCoeff "Aerodynamic drag equation linear coefficient, rear wheel travel [m^-1]" VALUE 1073875340 __Float32_Value 0 NO_COMPU_METHOD -3.40282346639E+38 3.40282346639E+38 STEP_SIZE 1 FORMAT "%.6" /end CHARACTERISTIC
/begin CHARACTERISTIC CWhlCluTqMax "Maximum wheel clutch torque" VALUE 1073874884 __Float32_Value 0 tNewtonMetre -100000 100000 STEP_SIZE 1 /end CHARACTERISTIC
/begin CHARACTERISTIC CNmPerBarMin "Min estimated nm/bar" VALUE 1073874820 __Float32_Value 0 tNewtonMetrePerBar 0 150 STEP_SIZE 1 /end CHARACTERISTIC
/begin CHARACTERISTIC CNmPerBarMax "Max estimated nm/bar" VALUE 1073874816 __Float32_Value 0 tNewtonMetrePerBar 0 150 STEP_SIZE 1 /end CHARACTERISTIC
/begin CHARACTERISTIC CSoftDisengageDuration "Soft Disengage Duration" VALUE 1073874716 __ULong_Value 0 tMillisecond_U32 0 3600000 STEP_SIZE 1 /end CHARACTERISTIC
/begin CHARACTERISTIC CTestWhlCluEnable "Enable bit for testing wheel clutches" VALUE 1073874705 __UByte_Value 0 NO_COMPU_METHOD 0 1 STEP_SIZE 1 FORMAT "%.2" /end CHARACTERISTIC
/begin CHARACTERISTIC CTestWhlCluControlOverride "Enable bit for testing wheel clutches using direct CMD%" VALUE 1073874704 __UByte_Value 0 NO_COMPU_METHOD 0 1 STEP_SIZE 1 FORMAT "%.2" /end CHARACTERISTIC
/begin CHARACTERISTIC CHysteresisThreshold "Threshold to change sign of hysteresis" VALUE 1073874676 __SWord_Value 0 tBar_100_S16 -1.0 1000.0 STEP_SIZE 1 /end CHARACTERISTIC
/begin CHARACTERISTIC CKissCluPMin "Pressure for pressure controller to distinguish between fastfill and tinyfill" VALUE 1073874582 __SWord_Value 0 tBar_100_S16 -1.0 1000.0 STEP_SIZE 1 /end CHARACTERISTIC
/begin CHARACTERISTIC CKissCluPressureHyst "Kiss pressure margin of error (hysteresis)" VALUE 1073874580 __SWord_Value 0 tBar_100_S16 -1.0 1000.0 STEP_SIZE 1 /end CHARACTERISTIC
/begin CHARACTERISTIC CNoPressureTh "Measured pressures below this threshold means zero pressure" VALUE 1073874578 __SWord_Value 0 tBar_100_S16 -1.0 1000.0 STEP_SIZE 1 /end CHARACTERISTIC
/begin CHARACTERISTIC CKissCluPMax "Maximum kiss pressure allowed" VALUE 1073874576 __SWord_Value 0 tBar_100_S16 -1.0 1000.0 STEP_SIZE 1 /end CHARACTERISTIC
/begin CHARACTERISTIC CFastfillEndKissFactor "Factor of kiss PWM allowed in fastfill end" VALUE 1073874568 __Float32_Value 0 tFactor -3.40282346639E+38 3.40282346639E+38 STEP_SIZE 1 /end CHARACTERISTIC
/begin CHARACTERISTIC CValveFullStrokeRequest "Full stroke PID pressure request" VALUE 1073874566 __SWord_Value 0 tBar_100_S16 -1.0 1000.0 STEP_SIZE 1 /end CHARACTERISTIC
/begin CHARACTERISTIC CScaledErrorPressureThresh "Pressure threshold below which, error is not scaled down" VALUE 1073874552 __SWord_Value 0 tBar_100_S16 -1.0 1000.0 STEP_SIZE 1 /end CHARACTERISTIC
/begin CHARACTERISTIC CPID_AccumulatorLim "PID Accumulator limit (0.01 = 1%)" VALUE 1073874548 __SLong_Value 0 NO_COMPU_METHOD -2147483648 2147483647 STEP_SIZE 1 FORMAT "%.0" /end CHARACTERISTIC
/begin CHARACTERISTIC CFeedforwardUpKickFactor "'Upkick' factor of demand to speed up pressure changes" VALUE 1073874340 __Float32_Value 0 tFactor -3.40282346639E+38 3.40282346639E+38 STEP_SIZE 1 /end CHARACTERISTIC
/begin CHARACTERISTIC CFeedforwardUpKickPressure "'Upkick' offset to speed up pressure changes" VALUE 1073874336 __SWord_Value 0 tBar_100_S16 -1.0 1000.0 STEP_SIZE 1 /end CHARACTERISTIC
/begin CHARACTERISTIC CFeedforwardUpKickTime "Length of 'upkick'" VALUE 1073874332 __ULong_Value 0 tMillisecond_U32 0 3600000 STEP_SIZE 1 /end CHARACTERISTIC
/begin CHARACTERISTIC CFeedforwardUpKickThreshold "Threshold to get a 'kick'" VALUE 1073874328 __SWord_Value 0 tBar_100_S16 -1.0 1000.0 STEP_SIZE 1 /end CHARACTERISTIC
/begin CHARACTERISTIC CFeedforwardDownKickPressure "'Downkick' to speed up pressure changes" VALUE 1073874326 __SWord_Value 0 tBar_100_S16 -1.0 1000.0 STEP_SIZE 1 /end CHARACTERISTIC
/begin CHARACTERISTIC CFeedforwardDownKickThreshold "Threshold to get a 'kick'" VALUE 1073874324 __SWord_Value 0 tBar_100_S16 -1.0 1000.0 STEP_SIZE 1 /end CHARACTERISTIC
/begin CHARACTERISTIC CKickHoldOff "Don't kick too often, use a couple of 75ms of hold off" VALUE 1073874320 __ULong_Value 0 tMillisecond_U32 0 3600000 STEP_SIZE 1 /end CHARACTERISTIC
/begin CHARACTERISTIC CPressOscilMaxPeriod "Maximum pressure oscillation period" VALUE 1073874208 __ULong_Value 0 tMillisecond_U32 0 3600000 STEP_SIZE 1 /end CHARACTERISTIC
/begin CHARACTERISTIC CPressOscilMinAmpl "Minimum amplitude for pressure oscillation detection" VALUE 1073874204 __SWord_Value 0 tBar_100_S16 -1.0 1000.0 STEP_SIZE 1 /end CHARACTERISTIC
/begin CHARACTERISTIC CPressOscilSyncMaxDeviation "Maximum deviation(%) of period, below which sync can happen" VALUE 1073874200 __Float32_Value 0 tFactor -3.40282346639E+38 3.40282346639E+38 STEP_SIZE 1 /end CHARACTERISTIC
/begin CHARACTERISTIC CPressOscilSyncCount "Number of detected pressure oscillations required to sync" VALUE 1073874196 __UByte_Value 0 NO_COMPU_METHOD 0 255 STEP_SIZE 1 FORMAT "%.0" /end CHARACTERISTIC
/begin CHARACTERISTIC CPressOscilFiltCoef "Pressure oscillation period filter coefficient" VALUE 1073874192 __Float32_Value 0 NO_COMPU_METHOD -3.40282346639E+38 3.40282346639E+38 STEP_SIZE 1 FORMAT "%.6" /end CHARACTERISTIC
/begin CHARACTERISTIC CSolenoidDriverMinCurrent "Minimum Allowed Request Current for a solenoid driver channel [A]" VALUE 1073874180 __Float32_Value 0 tAmpere 0 10000 STEP_SIZE 1 /end CHARACTERISTIC
/begin CHARACTERISTIC CFastfillDelayTime "* Fastfill Sequence ********************************* Delay between fastfills" VALUE 1073874172 __ULong_Value 0 tMillisecond_U32 0 3600000 STEP_SIZE 1 /end CHARACTERISTIC
/begin CHARACTERISTIC CFastfillStrtPressure "Fastfill sequence start pressure" VALUE 1073874168 __SWord_Value 0 tBar_100_S16 -1.0 1000.0 STEP_SIZE 1 /end CHARACTERISTIC
/begin CHARACTERISTIC CFastfillHighThreshold "Fastfill sequence threshold to consider the pressure high If the pressure is over this for a long time, then fastfill time should decrease" VALUE 1073874166 __SWord_Value 0 tBar_100_S16 -1.0 1000.0 STEP_SIZE 1 /end CHARACTERISTIC
/begin CHARACTERISTIC CFastfillAdaptionRoom "Fastfill sequence adaption room [%]" VALUE 1073874156 __SWord_Value 0 tPercent_100_S16 0.0 100.0 STEP_SIZE 1 /end CHARACTERISTIC
/begin CHARACTERISTIC CFastfillAdaptionWhlCluSpdCompMax "Fastfill sequence adaption maximum Clutch Speed compensation[ms]" VALUE 1073874152 __ULong_Value 0 tMillisecond_U32 0 3600000 STEP_SIZE 1 /end CHARACTERISTIC
/begin CHARACTERISTIC CFastfillAdaptionIntegralHystNeg "Fastfill sequence adaption threshold of integral of error to make correction (Overfill)" VALUE 1073874120 __SWord_Value 0 tBar_100_S16 -1.0 1000.0 STEP_SIZE 1 /end CHARACTERISTIC
/begin CHARACTERISTIC CFastfillAdaptionIntegralHystPos "Fastfill sequence adaption threshold of integral of error to make correction (underfill)" VALUE 1073874118 __SWord_Value 0 tBar_100_S16 -1.0 1000.0 STEP_SIZE 1 /end CHARACTERISTIC
/begin CHARACTERISTIC CFastfillAdaptionMaxStepNeg "Fastfill max negate step in adaption" VALUE 1073874108 __SWord_Value 0 tPercent_100_S16 0.0 100.0 STEP_SIZE 1 /end CHARACTERISTIC
/begin CHARACTERISTIC CFastfillAdaptionMinPeakPressure "Fastfill sequence lower pressure adaption boundary" VALUE 1073874098 __SWord_Value 0 tBar_100_S16 -1.0 1000.0 STEP_SIZE 1 /end CHARACTERISTIC
/begin CHARACTERISTIC CFastfillPressureDropThreshold "Number of samples of relaxed pressure needed to leave the fastfill hold state" VALUE 1073874096 __UByte_Value 0 NO_COMPU_METHOD 0 255 STEP_SIZE 1 FORMAT "%.0" /end CHARACTERISTIC
/begin CHARACTERISTIC CFastfillEndTime "Duration of PID control after the hold part NOTE! Used as denominator, dont put to 0" VALUE 1073874084 __ULong_Value 0 tMillisecond_U32 0 3600000 STEP_SIZE 1 /end CHARACTERISTIC
/begin CHARACTERISTIC CTestEnableFFAdaptions "Test bit to run the Fast Fill adaptions unchecked" VALUE 1073873832 __UByte_Value 0 NO_COMPU_METHOD 0 1 STEP_SIZE 1 FORMAT "%.2" /end CHARACTERISTIC
/begin CHARACTERISTIC CFFAdaptWhlCluRPMLimit "Clutch Speed limit under which FF adaption is allowed" VALUE 1073873826 __SWord_Value 0 tRevolutionPerMinute_S16 -32768 32767 STEP_SIZE 1 /end CHARACTERISTIC
/begin CHARACTERISTIC CRuntimeCalibEnable "Runtime calibration enable bit" VALUE 1073873824 __UByte_Value 0 NO_COMPU_METHOD 0 1 STEP_SIZE 1 FORMAT "%.2" /end CHARACTERISTIC
/begin CHARACTERISTIC CRuntimeCalibIdeviation "Runtime calibration deviation Sustained controller correction larger than this will trigger Runtime calibration" VALUE 1073873822 __SWord_Value 0 tPercent_100_S16 0.0 100.0 STEP_SIZE 1 /end CHARACTERISTIC
/begin CHARACTERISTIC CRuntimeCalibStepBase "Step when adjusting the base point" VALUE 1073873820 __SWord_Value 0 tPercent_100_S16 0.0 100.0 STEP_SIZE 1 /end CHARACTERISTIC
/begin CHARACTERISTIC CRuntimeCalibStepTop "Step when adjusting the top point" VALUE 1073873818 __SWord_Value 0 tPercent_100_S16 0.0 100.0 STEP_SIZE 1 /end CHARACTERISTIC
/begin CHARACTERISTIC CRuntimeCalibHPMargin "Runtime calibration HP margin Needs to have this margin to high pressure" VALUE 1073873816 __SWord_Value 0 tBar_100_S16 -1.0 1000.0 STEP_SIZE 1 /end CHARACTERISTIC
/begin CHARACTERISTIC CRuntimeCalibPressureConditionTop "Runtime calibration pressure condition high Needs higher clutch pressure than this to auto calibrate the top setpoint" VALUE 1073873814 __SWord_Value 0 tBar_100_S16 -1.0 1000.0 STEP_SIZE 1 /end CHARACTERISTIC
/begin CHARACTERISTIC CRuntimeCalibPressureConditionLow "Runtime calibration pressure condition Needs lower clutch pressure than this to auto calibrate the low setpoint" VALUE 1073873812 __SWord_Value 0 tBar_100_S16 -1.0 1000.0 STEP_SIZE 1 /end CHARACTERISTIC
/begin CHARACTERISTIC CRuntimeCalibTime "Runtime calibration timestep Conditions should persist during this time for a 'vote'" VALUE 1073873808 __ULong_Value 0 tMillisecond_U32 0 3600000 STEP_SIZE 1 /end CHARACTERISTIC
/begin CHARACTERISTIC CRuntimeCalibVoteCount "Runtime calibration votes to change calibration" VALUE 1073873807 __UByte_Value 0 NO_COMPU_METHOD 0 255 STEP_SIZE 1 FORMAT "%.0" /end CHARACTERISTIC
/begin CHARACTERISTIC CRuntimeCalibVoteOpposite "Runtime calibration votes in opposite direction to prevent changing calibration" VALUE 1073873806 __UByte_Value 0 NO_COMPU_METHOD 0 255 STEP_SIZE 1 FORMAT "%.0" /end CHARACTERISTIC
/begin CHARACTERISTIC CRuntimeCalibTempMin "Runtime calibration minimum temperature to calibrate top" VALUE 1073873804 __SWord_Value 0 tDegree_10_S16 -720.0 720.0 STEP_SIZE 1 /end CHARACTERISTIC
/begin CHARACTERISTIC CRuntimeCalibTempMax "Runtime calibration maximum temperature to calibrate top" VALUE 1073873802 __SWord_Value 0 tDegree_10_S16 -720.0 720.0 STEP_SIZE 1 /end CHARACTERISTIC
/begin CHARACTERISTIC CStuckOpenValvePressureLimit "Limit to consider valve stuck open, or clutch engaged when not requested" VALUE 1073873800 __SWord_Value 0 tBar_100_S16 -1.0 1000.0 STEP_SIZE 1 /end CHARACTERISTIC
/begin CHARACTERISTIC CSteelDiscHeatCp "Heat capacity of all steel discs in a clutch [J/K]" VALUE 1073873780 __Float32_Value 0 tJoulePerKelvin -3.40282346639E+38 3.40282346639E+38 STEP_SIZE 1 /end CHARACTERISTIC
/begin CHARACTERISTIC CWaffleThermConduct "Conductivity through waffle pattern from steel disc to clutch disc center [W/K]" VALUE 1073873772 __Float32_Value 0 tWattPerKelvin -3.40282346639E+38 3.40282346639E+38 STEP_SIZE 1 /end CHARACTERISTIC
/begin CHARACTERISTIC CTestWhlCluSlipEnable "Enable clutch slip test for hubdyno" VALUE 1073873713 __UByte_Value 0 NO_COMPU_METHOD 0 1 STEP_SIZE 1 FORMAT "%.2" /end CHARACTERISTIC
/begin CHARACTERISTIC CTestWhlCluSlipStart "Start slip test on hubdyno" VALUE 1073873712 __UByte_Value 0 NO_COMPU_METHOD 0 1 STEP_SIZE 1 FORMAT "%.2" /end CHARACTERISTIC
/begin CHARACTERISTIC CTestWhlCluSlipTime "Max time allowed to slip" VALUE 1073873708 __ULong_Value 0 tMillisecond_U32 0 60000 STEP_SIZE 1 /end CHARACTERISTIC
/begin CHARACTERISTIC CTestWhlCluSlipTMax "Max temperature before aborting test" VALUE 1073873702 __SWord_Value 0 tCelsius_10_S16 -400.0 10000.0 STEP_SIZE 1 /end CHARACTERISTIC
/begin CHARACTERISTIC CTestSlipCtrlEna "Enable clutch minimum slip controller (TC)" VALUE 1073873692 __UByte_Value 0 NO_COMPU_METHOD 0 1 STEP_SIZE 1 FORMAT "%.2" /end CHARACTERISTIC
/begin CHARACTERISTIC CSlipCtrlrMinDeltaTi "Delta time bigger than this to conisder I and D part invalid" VALUE 1073873528 __Float32_Value 0 tMillisecond 0 3600000 STEP_SIZE 1 /end CHARACTERISTIC
/begin CHARACTERISTIC CSlipRateErrCutoffFreq "Slip speed error derivative normalized cutoff frequency" VALUE 1073873524 __Float32_Value 0 tFactor -3.40282346639E+38 3.40282346639E+38 STEP_SIZE 1 /end CHARACTERISTIC
/begin CHARACTERISTIC CSlipCtrlrIMax "Max wheel clutch slip controller integrator" VALUE 1073873520 __Float32_Value 0 tNewtonMetre -100000 100000 STEP_SIZE 1 /end CHARACTERISTIC
/begin CHARACTERISTIC CWhlCluSignSlipBuf "Buffer near zero clutch slip to switch from speed-based sign to torque-based sign" VALUE 1073873500 __Float32_Value 0 tRadianPerSecond -1000 1000 STEP_SIZE 1 /end CHARACTERISTIC
/begin CHARACTERISTIC CWhlCluSignTqHyst "Hysteresis on propshaft torque for clutch torque sign determination (propshaft level)" VALUE 1073873496 __Float32_Value 0 tNewtonMetre -1 1000 STEP_SIZE 1 /end CHARACTERISTIC
/begin CHARACTERISTIC CWhlCluSignFiltCoeff "LPF Filter for clutch slip sign" VALUE 1073873492 __Float32_Value 0 NO_COMPU_METHOD 0.0 1.0 STEP_SIZE 0.005 FORMAT "%.6" /end CHARACTERISTIC
/begin CHARACTERISTIC CWhlCluSignDirThresh "Direction threshold on filtered sign factor to commit POS/NEG (0..1)" VALUE 1073873488 __Float32_Value 0 tFactor 0.1 1.0 STEP_SIZE 0.01 /end CHARACTERISTIC
/begin CHARACTERISTIC CWhlCluSignZeroEnterThresh "Threshold on filtered factor to consider entering ZERO (smaller than dir threshold)" VALUE 1073873484 __Float32_Value 0 tFactor 0.0 0.5 STEP_SIZE 0.01 /end CHARACTERISTIC
/begin CHARACTERISTIC CWhlCluSignZeroEnterMs "Milliseconds the filtered factor must stay below zero enter threshold to commit ZERO" VALUE 1073873480 __ULong_Value 0 tMillisecond_U32 0 1000 STEP_SIZE 1 /end CHARACTERISTIC
/begin COMPU_METHOD tFactor "" IDENTICAL "%.6" "" /end COMPU_METHOD
/begin COMPU_METHOD tFraction "" IDENTICAL "%.6" "" /end COMPU_METHOD
/begin COMPU_METHOD tFactor_1000_S16 "" LINEAR "%.3" "-" COEFFS_LINEAR 0.001000 0 /end COMPU_METHOD
/begin COMPU_METHOD tPercent "" IDENTICAL "%.1" "%" /end COMPU_METHOD
/begin COMPU_METHOD tPercent_100_S16 "" LINEAR "%.2" "%" COEFFS_LINEAR 0.010000 0 /end COMPU_METHOD
/begin COMPU_METHOD tPercent_S8 "" IDENTICAL "%.0" "%" /end COMPU_METHOD
/begin COMPU_METHOD tPercent_100_S32 "" LINEAR "%.2" "%" COEFFS_LINEAR 0.010000 0 /end COMPU_METHOD
/begin COMPU_METHOD tMillisecond "" IDENTICAL "%.3" "ms" /end COMPU_METHOD
/begin COMPU_METHOD tMillisecond_U32 "" IDENTICAL "%.3" "ms" /end COMPU_METHOD
/begin COMPU_METHOD tMetre "" IDENTICAL "%.4" "m" /end COMPU_METHOD
/begin COMPU_METHOD tMillimetre_S16 "" IDENTICAL "%.3" "mm" /end COMPU_METHOD
/begin COMPU_METHOD tMillimetre_10_S16 "" LINEAR "%.1" "mm" COEFFS_LINEAR 0.100000 0 /end COMPU_METHOD
/begin COMPU_METHOD tMetreSquared "" IDENTICAL "%.4" "m2" /end COMPU_METHOD
/begin COMPU_METHOD tMetrePerSecond "" IDENTICAL "%.3" "m/s" /end COMPU_METHOD
/begin COMPU_METHOD tMillimetrePerSecond_S16 "" IDENTICAL "%.0" "mm/s" /end COMPU_METHOD
/begin COMPU_METHOD tKilometrePerHour "" IDENTICAL "%.3" "km/h" /end COMPU_METHOD
/begin COMPU_METHOD tKilometrePerHour_S16 "" IDENTICAL "%.0" "km/h" /end COMPU_METHOD
/begin COMPU_METHOD tKilometrePerHour_10_S16 "" LINEAR "%.1" "km/h" COEFFS_LINEAR 0.100000 0 /end COMPU_METHOD
/begin COMPU_METHOD tMetrePerSquareSecond "" IDENTICAL "%.3" "m/s2" /end COMPU_METHOD
/begin COMPU_METHOD tRadian "" IDENTICAL "%.3" "rad" /end COMPU_METHOD
/begin COMPU_METHOD tDegree "" IDENTICAL "%.3" "deg" /end COMPU_METHOD
/begin COMPU_METHOD tDegree_10_S16 "" LINEAR "%.1" "deg" COEFFS_LINEAR 0.100000 0 /end COMPU_METHOD
/begin COMPU_METHOD tRadianPerSecond "" IDENTICAL "%.3" "rad/s" /end COMPU_METHOD
/begin COMPU_METHOD tRevolutionPerMinute "" IDENTICAL "%.3" "rpm" /end COMPU_METHOD
/begin COMPU_METHOD tRevolutionPerMinute_S16 "" IDENTICAL "%.0" "rpm" /end COMPU_METHOD
/begin COMPU_METHOD tRadianPerSquareSecond "" IDENTICAL "%.3" "rad/s2" /end COMPU_METHOD
/begin COMPU_METHOD tKilogram_S16 "" IDENTICAL "%.0" "kg" /end COMPU_METHOD
/begin COMPU_METHOD tNewtonMetre "" IDENTICAL "%.3" "Nm" /end COMPU_METHOD
/begin COMPU_METHOD tNewtonMetre_100_S32 "" LINEAR "%.2" "Nm" COEFFS_LINEAR 0.010000 0 /end COMPU_METHOD
/begin COMPU_METHOD tNewtonMetre_S16 "" IDENTICAL "%.0" "Nm" /end COMPU_METHOD
/begin COMPU_METHOD tNewtonMetrePerBar "" IDENTICAL "%.2" "Nm/bar" /end COMPU_METHOD
/begin COMPU_METHOD tKilowatt "" IDENTICAL "%.3" "kW" /end COMPU_METHOD
/begin COMPU_METHOD tKilowattHour "" IDENTICAL "%.3" "kWh" /end COMPU_METHOD
/begin COMPU_METHOD tCelsius "" IDENTICAL "%.3" "C" /end COMPU_METHOD
/begin COMPU_METHOD tCelsius_10_S16 "" LINEAR "%.1" "C" COEFFS_LINEAR 0.100000 0 /end COMPU_METHOD
/begin COMPU_METHOD tBar "" IDENTICAL "%.3" "bar" /end COMPU_METHOD
/begin COMPU_METHOD tBar_10_S16 "" LINEAR "%.1" "bar" COEFFS_LINEAR 0.100000 0 /end COMPU_METHOD
/begin COMPU_METHOD tBar_100_S16 "" LINEAR "%.2" "bar" COEFFS_LINEAR 0.010000 0 /end COMPU_METHOD
/begin COMPU_METHOD tOhm "" IDENTICAL "%.3" "Ohm" /end COMPU_METHOD
/begin COMPU_METHOD tKilogramSquareMetre "" IDENTICAL "%.4" "kg/m2" /end COMPU_METHOD
/begin COMPU_METHOD tAmpere "" IDENTICAL "%.3" "A" /end COMPU_METHOD
/begin COMPU_METHOD tAmpereHour "" IDENTICAL "%.3" "Ah" /end COMPU_METHOD
/begin COMPU_METHOD tAmpere_100_S16 "" LINEAR "%.2" "A" COEFFS_LINEAR 0.010000 0 /end COMPU_METHOD
/begin COMPU_METHOD tMillivolt_S16 "" IDENTICAL "%.0" "mV" /end COMPU_METHOD
/begin COMPU_METHOD tMillivolt_S32 "" IDENTICAL "%.0" "mV" /end COMPU_METHOD
/begin COMPU_METHOD tVolt "" IDENTICAL "%.3" "V" /end COMPU_METHOD
/begin COMPU_METHOD tJoulePerKelvin "" IDENTICAL "%.2" "J/K" /end COMPU_METHOD
/begin COMPU_METHOD tWattPerKelvin "" IDENTICAL "%.2" "W/K" /end COMPU_METHOD
/begin COMPU_METHOD tSign "" TAB_VERB "%.0" "" COMPU_TAB_REF tSign /end COMPU_METHOD
/begin COMPU_METHOD tPropshaftStationaryCrankState "" TAB_VERB "%.0" "" COMPU_TAB_REF tPropshaftStationaryCrankState /end COMPU_METHOD
/begin COMPU_METHOD tPropshaftDrivingCrankState "" TAB_VERB "%.0" "" COMPU_TAB_REF tPropshaftDrivingCrankState /end COMPU_METHOD
/begin COMPU_METHOD tPropulsionMode "" TAB_VERB "%.0" "" COMPU_TAB_REF tPropulsionMode /end COMPU_METHOD
/begin COMPU_METHOD tLowPassFilterType "" TAB_VERB "%.0" "" COMPU_TAB_REF tLowPassFilterType /end COMPU_METHOD
/begin COMPU_METHOD tDriveConfiguration "" TAB_VERB "%.0" "" COMPU_TAB_REF tDriveConfiguration /end COMPU_METHOD
/begin COMPU_METHOD tDriveMode "" TAB_VERB "%.0" "" COMPU_TAB_REF tDriveMode /end COMPU_METHOD
/begin COMPU_METHOD tGear "" TAB_VERB "%.0" "" COMPU_TAB_REF tGear /end COMPU_METHOD
/begin COMPU_METHOD tPerformanceMode "" TAB_VERB "%.0" "" COMPU_TAB_REF tPerformanceMode /end COMPU_METHOD
/begin COMPU_METHOD tHandlingAttitudeMode "" TAB_VERB "%.0" "" COMPU_TAB_REF tHandlingAttitudeMode /end COMPU_METHOD
/begin COMPU_METHOD tTractionControlMode "" TAB_VERB "%.0" "" COMPU_TAB_REF tTractionControlMode /end COMPU_METHOD
/begin COMPU_METHOD tYawTorqueRequestMode "" TAB_VERB "%.0" "" COMPU_TAB_REF tYawTorqueRequestMode /end COMPU_METHOD
/begin COMPU_METHOD tPedalMapMode "" TAB_VERB "%.0" "" COMPU_TAB_REF tPedalMapMode /end COMPU_METHOD
/begin COMPU_METHOD tRegenMode "" TAB_VERB "%.0" "" COMPU_TAB_REF tRegenMode /end COMPU_METHOD
/begin COMPU_METHOD tPerformanceModeRHC "" TAB_VERB "%.0" "" COMPU_TAB_REF tPerformanceModeRHC /end COMPU_METHOD
/begin COMPU_METHOD tAutoShiftMode "" TAB_VERB "%.0" "" COMPU_TAB_REF tAutoShiftMode /end COMPU_METHOD
/begin COMPU_METHOD tPerformanceModeDDC "" TAB_VERB "%.0" "" COMPU_TAB_REF tPerformanceModeDDC /end COMPU_METHOD
/begin COMPU_METHOD tChangeModeEnableIEB "" TAB_VERB "%.0" "" COMPU_TAB_REF tChangeModeEnableIEB /end COMPU_METHOD
/begin COMPU_METHOD tPerformanceModeVDC "" TAB_VERB "%.0" "" COMPU_TAB_REF tPerformanceModeVDC /end COMPU_METHOD
/begin COMPU_METHOD tPerformanceModeEPS "" TAB_VERB "%.0" "" COMPU_TAB_REF tPerformanceModeEPS /end COMPU_METHOD
/begin COMPU_METHOD tPerformanceModeTPMS "" TAB_VERB "%.0" "" COMPU_TAB_REF tPerformanceModeTPMS /end COMPU_METHOD
/begin COMPU_METHOD tPerformanceModeSpeedLimiter "" TAB_VERB "%.0" "" COMPU_TAB_REF tPerformanceModeSpeedLimiter /end COMPU_METHOD
/begin COMPU_METHOD tEnableState "" TAB_VERB "%.0" "" COMPU_TAB_REF tEnableState /end COMPU_METHOD
/begin COMPU_METHOD tButtonState "" TAB_VERB "%.0" "" COMPU_TAB_REF tButtonState /end COMPU_METHOD
/begin COMPU_METHOD tPaddleComb "" TAB_VERB "%.0" "" COMPU_TAB_REF tPaddleComb /end COMPU_METHOD
/begin COMPU_METHOD tPerformanceStrategy "" TAB_VERB "%.0" "" COMPU_TAB_REF tPerformanceStrategy /end COMPU_METHOD
/begin COMPU_METHOD tPanelStatus "" TAB_VERB "%.0" "" COMPU_TAB_REF tPanelStatus /end COMPU_METHOD
/begin COMPU_METHOD tImmobilizerState "" TAB_VERB "%.0" "" COMPU_TAB_REF tImmobilizerState /end COMPU_METHOD
/begin COMPU_METHOD tPowerState "" TAB_VERB "%.0" "" COMPU_TAB_REF tPowerState /end COMPU_METHOD
/begin COMPU_METHOD tParkingBrakeRequest "" TAB_VERB "%.0" "" COMPU_TAB_REF tParkingBrakeRequest /end COMPU_METHOD
/begin COMPU_METHOD tRollingState "" TAB_VERB "%.0" "" COMPU_TAB_REF tRollingState /end COMPU_METHOD
/begin COMPU_METHOD tTireModel "" TAB_VERB "%.0" "" COMPU_TAB_REF tTireModel /end COMPU_METHOD
/begin COMPU_METHOD tOccupancyStatus "" TAB_VERB "%.0" "" COMPU_TAB_REF tOccupancyStatus /end COMPU_METHOD
/begin COMPU_METHOD tAutoHillHoldState "" TAB_VERB "%.0" "" COMPU_TAB_REF tAutoHillHoldState /end COMPU_METHOD
/begin COMPU_METHOD tPreferredCentralClutchDisengagedFaultMode "" TAB_VERB "%.0" "" COMPU_TAB_REF tPreferredCentralClutchDisengagedFaultMode /end COMPU_METHOD
/begin COMPU_METHOD tInvSpdCtrlGainSet "" TAB_VERB "%.0" "" COMPU_TAB_REF tInvSpdCtrlGainSet /end COMPU_METHOD
/begin COMPU_METHOD tLaunchControlMode "" TAB_VERB "%.0" "" COMPU_TAB_REF tLaunchControlMode /end COMPU_METHOD
/begin COMPU_METHOD tAccStationaryRequest "" TAB_VERB "%.0" "" COMPU_TAB_REF tAccStationaryRequest /end COMPU_METHOD
/begin COMPU_METHOD tAdaptiveCruiseControlStateRequest "" TAB_VERB "%.0" "" COMPU_TAB_REF tAdaptiveCruiseControlStateRequest /end COMPU_METHOD
/begin COMPU_METHOD tAccDistanceLevel "" TAB_VERB "%.0" "" COMPU_TAB_REF tAccDistanceLevel /end COMPU_METHOD
/begin COMPU_METHOD tAutomatedDriverControlState "" TAB_VERB "%.0" "" COMPU_TAB_REF tAutomatedDriverControlState /end COMPU_METHOD
/begin COMPU_METHOD tBrakeLightRequest "" TAB_VERB "%.0" "" COMPU_TAB_REF tBrakeLightRequest /end COMPU_METHOD
/begin COMPU_METHOD tPowerSplitStartegy "" TAB_VERB "%.0" "" COMPU_TAB_REF tPowerSplitStartegy /end COMPU_METHOD
/begin COMPU_METHOD tVsoVehicleAngleSwt "" TAB_VERB "%.0" "" COMPU_TAB_REF tVsoVehicleAngleSwt /end COMPU_METHOD
/begin COMPU_METHOD tVsoVehicleMotionObserverSwt "" TAB_VERB "%.0" "" COMPU_TAB_REF tVsoVehicleMotionObserverSwt /end COMPU_METHOD
/begin COMPU_VTAB tSign "" TAB_VERB 2 -1 "SIGN_NEGATIVE" 0 "SIGN_ZERO" 1 "SIGN_POSITIVE" /end COMPU_VTAB
/begin COMPU_VTAB tPropshaftStationaryCrankState "" TAB_VERB 6 0 "STATY_CRK_ST_INIT" 1 "STATY_CRK_ST_COUPLE" 2 "STATY_CRK_ST_SYNC" 3 "STATY_CRK_ST_START" 4 "STATY_CRK_ST_RUNNING" 5 "STATY_CRK_ST_FAULT" /end COMPU_VTAB
/begin COMPU_VTAB tPropshaftDrivingCrankState "" TAB_VERB 4 0 "DRVG_CRK_ST_INIT" 1 "DRVG_CRK_ST_COUPLE" 2 "DRVG_CRK_ST_START" 3 "DRVG_CRK_ST_FAULT" /end COMPU_VTAB
/begin COMPU_VTAB tPropulsionMode "" TAB_VERB 5 0 "PRPL_MOD_UNKNOWN" 1 "PRPL_MOD_ELEC_FORCED" 2 "PRPL_MOD_ELEC" 3 "PRPL_MOD_HYBRID" 4 "PRPL_MOD_ICE_FORCED" /end COMPU_VTAB
/begin COMPU_VTAB tLowPassFilterType "" TAB_VERB 2 0 "LPF_TYPE_O1_BUTTER" 1 "LPF_TYPE_O2_BUTTER" /end COMPU_VTAB
/begin COMPU_VTAB tDriveConfiguration "" TAB_VERB 4 0 "DRV_CFG_UNKNOWN" 1 "DRV_CFG_AWD" 2 "DRV_CFG_FWD" 3 "DRV_CFG_RWD" /end COMPU_VTAB
/begin COMPU_VTAB tDriveMode "" TAB_VERB 6 0 "DRV_MOD_UNKNOWN" 1 "DRV_MOD_PARK" 2 "DRV_MOD_NEUTRAL" 3 "DRV_MOD_REVERSE" 4 "DRV_MOD_DRIVE" 5 "NUM_OF_DRV_MOD" /end COMPU_VTAB
/begin COMPU_VTAB tGear "" TAB_VERB 11 0 "GEAR_INVALID" 1 "GEAR_1" 2 "GEAR_2" 3 "GEAR_3" 4 "GEAR_4" 5 "GEAR_5" 6 "GEAR_6" 7 "GEAR_7" 8 "GEAR_8" 9 "GEAR_9" 10 "GEAR_N" /end COMPU_VTAB
/begin COMPU_VTAB tPerformanceMode "" TAB_VERB 8 0 "PERF_MOD_UNKNOWN" 1 "PERF_MOD_GHOST_EV" 2 "PERF_MOD_COMFORT" 3 "PERF_MOD_WET_SNOW" 4 "PERF_MOD_SPORT" 5 "PERF_MOD_TRACK" 6 "PERF_MOD_INDIVIDUAL" 7 "NUM_OF_PERF_MOD" /end COMPU_VTAB
/begin COMPU_VTAB tHandlingAttitudeMode "" TAB_VERB 8 0 "HNDLG_ATTD_MOD_UKWN" 1 "HNDLG_ATTD_MOD_1" 2 "HNDLG_ATTD_MOD_2" 3 "HNDLG_ATTD_MOD_3" 4 "HNDLG_ATTD_MOD_4" 5 "HNDLG_ATTD_MOD_5" 6 "HNDLG_ATTD_MOD_BURNOUT" 7 "HNDLG_ATTD_MOD_DRIFT" /end COMPU_VTAB
/begin COMPU_VTAB tTractionControlMode "" TAB_VERB 7 0 "TRAC_CTRL_MOD_UKWN" 1 "TRAC_CTRL_MOD_1" 2 "TRAC_CTRL_MOD_2" 3 "TRAC_CTRL_MOD_3" 4 "TRAC_CTRL_MOD_4" 5 "TRAC_CTRL_MOD_5" 6 "TRAC_CTRL_MOD_OFF" /end COMPU_VTAB
/begin COMPU_VTAB tYawTorqueRequestMode "" TAB_VERB 8 0 "YAW_TQ_REQ_MOD_UKWN" 1 "YAW_TQ_REQ_MOD_1" 2 "YAW_TQ_REQ_MOD_2" 3 "YAW_TQ_REQ_MOD_3" 4 "YAW_TQ_REQ_MOD_4" 5 "YAW_TQ_REQ_MOD_5" 6 "YAW_TQ_REQ_MOD_OFF" 7 "YAW_TQ_REQ_MOD_DRIFT" /end COMPU_VTAB
/begin COMPU_VTAB tPedalMapMode "" TAB_VERB 7 0 "PEDL_MAP_MOD_UKWN" 1 "PEDL_MAP_MOD_EV" 2 "PEDL_MAP_MOD_SLUGGISH" 3 "PEDL_MAP_MOD_NORMAL" 4 "PEDL_MAP_MOD_RESPONSIVE" 5 "PEDL_MAP_MOD_TRACK_ONLY" 6 "PEDL_MAP_MOD_COUNT" /end COMPU_VTAB
/begin COMPU_VTAB tRegenMode "" TAB_VERB 4 0 "RGN_MOD_UKWN" 1 "RGN_MOD_NO_RGN" 2 "RGN_MOD_MID_RGN" 3 "RGN_MOD_HIGH_RGN" /end COMPU_VTAB
/begin COMPU_VTAB tPerformanceModeRHC "" TAB_VERB 4 0 "RHC_PERF_MOD_UKWN" 1 "RHC_PERF_MOD_LOW" 2 "RHC_PERF_MOD_MED" 3 "RHC_PERF_MOD_HIGH" /end COMPU_VTAB
/begin COMPU_VTAB tAutoShiftMode "" TAB_VERB 4 0 "AUTO_SHIFT_MOD_UKWN" 1 "AUTO_SHIFT_MOD_EARLY" 2 "AUTO_SHIFT_MOD_MID" 3 "AUTO_SHIFT_MOD_LATE" /end COMPU_VTAB
/begin COMPU_VTAB tPerformanceModeDDC "" TAB_VERB 7 0 "DDC_PERF_MOD_UKWN" 1 "DDC_PERF_MOD_1" 2 "DDC_PERF_MOD_2" 3 "DDC_PERF_MOD_3" 4 "DDC_PERF_MOD_4" 5 "DDC_PERF_MOD_5" 6 "DDC_PERF_MOD_6" /end COMPU_VTAB
/begin COMPU_VTAB tChangeModeEnableIEB "" TAB_VERB 3 0 "IEB_CHG_MOD_UKWN" 1 "IEB_CHG_MOD_DISABLED" 2 "IEB_CHG_MOD_ENABLED" /end COMPU_VTAB
/begin COMPU_VTAB tPerformanceModeVDC "" TAB_VERB 5 0 "VDC_PERF_MOD_UKWN" 1 "VDC_PERF_MOD_UNAVL" 2 "VDC_PERF_MOD_ON" 3 "VDC_PERF_MOD_INTER" 4 "VDC_PERF_MOD_OFF" /end COMPU_VTAB
/begin COMPU_VTAB tPerformanceModeEPS "" TAB_VERB 4 0 "EPS_PERF_MOD_UKWN" 1 "EPS_PERF_MOD_SOFT" 2 "EPS_PERF_MOD_MED" 3 "EPS_PERF_MOD_HARD" /end COMPU_VTAB
/begin COMPU_VTAB tPerformanceModeTPMS "" TAB_VERB 3 0 "TPMS_PERF_MOD_UKWN" 1 "TPMS_PERF_MOD_NORM" 2 "TPMS_PERF_MOD_PERF" /end COMPU_VTAB
/begin COMPU_VTAB tPerformanceModeSpeedLimiter "" TAB_VERB 7 0 "SPD_LIM_PERF_MOD_UKWN" 1 "SPD_LIM_PERF_MOD_LOW_RVRS" 2 "SPD_LIM_PERF_MOD_LOW_DRV" 3 "SPD_LIM_PERF_MOD_NORM" 4 "SPD_LIM_PERF_MOD_HIGH" 5 "SPD_LIM_PERF_MOD_TRACK_UNLCKD" 6 "NUM_OF_SPD_LIM_PERF_MOD" /end COMPU_VTAB
/begin COMPU_VTAB tEnableState "" TAB_VERB 4 0 "ENA_ST_UNKNOWN" 1 "ENA_ST_OFF" 2 "ENA_ST_ON" 3 "ENA_ST_FLT" /end COMPU_VTAB
/begin COMPU_VTAB tButtonState "" TAB_VERB 4 0 "BTN_ST_UKWN" 1 "BTN_ST_RELD" 2 "BTN_ST_PSD" 3 "BTN_ST_ERR" /end COMPU_VTAB
/begin COMPU_VTAB tPaddleComb "" TAB_VERB 5 0 "PADDLE_UNKNOWN" 1 "PADDLE_RELEASED" 2 "PADDLE_DOWN" 3 "PADDLE_UP" 4 "PADDLE_BOTH" /end COMPU_VTAB
/begin COMPU_VTAB tPerformanceStrategy "" TAB_VERB 4 0 "PERF_STGY_UKWN" 1 "PERF_STGY_ENDURANCE" 2 "PERF_STGY_POWER" 3 "PERF_STGY_HOT_LAP" /end COMPU_VTAB
/begin COMPU_VTAB tPanelStatus "" TAB_VERB 7 0 "PANEL_UNKNOWN" 1 "PANEL_OPEN" 2 "PANEL_OPENING" 3 "PANEL_IDLE" 4 "PANEL_CLOSING" 5 "PANEL_CLOSED" 6 "PANEL_CLOSED_AND_LATCHED" /end COMPU_VTAB
/begin COMPU_VTAB tImmobilizerState "" TAB_VERB 3 0 "IMOB_UNKNOWN" 1 "IMOB_INACTIVE" 2 "IMOB_ACTIVE" /end COMPU_VTAB
/begin COMPU_VTAB tPowerState "" TAB_VERB 16 0 "PWR_ST_UNAVL" 1 "PWR_ST_SLEEP" 2 "PWR_ST_THERM_MNGT" 3 "PWR_ST_POST_CRASH" 4 "PWR_ST_INTRUSION" 5 "PWR_ST_BATT_CHRGN" 6 "PWR_ST_USR_ACS" 7 "PWR_ST_IGN" 8 "PWR_ST_FLASHING" 15 "PWR_ST_INVLD" /end COMPU_VTAB
/begin COMPU_VTAB tParkingBrakeRequest "" TAB_VERB 3 0 "PRKG_BRK_REQ_UNKNOWN" 1 "PRKG_BRK_REQ_DISENGAGE" 2 "PRKG_BRK_REQ_ENGAGE" /end COMPU_VTAB
/begin COMPU_VTAB tRollingState "" TAB_VERB 5 0 "ROLLING_UNKNOWN" 1 "ROLLING_STATIONARY" 2 "ROLLING_FORWARD" 3 "ROLLING_REARWARD" 4 "ROLLING_OVERSPEED" /end COMPU_VTAB
/begin COMPU_VTAB tTireModel "" TAB_VERB 5 0 "TIRE_MDL_UNKNOWN" 1 "TIRE_MDL_CUP2" 2 "TIRE_MDL_CUP2R" 3 "TIRE_MDL_ALPIN" 4 "NUM_OF_TIRE_MDLS" /end COMPU_VTAB
/begin COMPU_VTAB tOccupancyStatus "" TAB_VERB 4 0 "OCCPT_UNKNOWN" 1 "OCCPT_NONE" 2 "OCCPT_CHILD" 3 "OCCPT_ADULT" /end COMPU_VTAB
/begin COMPU_VTAB tAutoHillHoldState "" TAB_VERB 8 0 "AHH_ST_UKWN" 1 "AHH_ST_OFF" 2 "AHH_ST_AUTO_HOLD_DEACTVD" 3 "AHH_ST_AUTO_HOLD_ACTV" 4 "AHH_ST_AUTO_HOLD_UNAVL" 5 "AHH_ST_HILL_HOLD_ACTV" 6 "AHH_ST_HILL_HOLD_UNAVL" 7 "AHH_ST_NUM_OF_ST" /end COMPU_VTAB
/begin COMPU_VTAB tPreferredCentralClutchDisengagedFaultMode "" TAB_VERB 2 0 "CEN_CLU_FAULT_DISEG_EV" 1 "CEN_CLU_FAULT_DISEG_ICE" /end COMPU_VTAB
/begin COMPU_VTAB tInvSpdCtrlGainSet "" TAB_VERB 8 0 "INV_GAIN_SET_0" 1 "INV_GAIN_SET_1" 2 "INV_GAIN_SET_2" 3 "INV_GAIN_SET_3" 4 "INV_GAIN_SET_4" 5 "INV_GAIN_SET_5" 6 "INV_GAIN_SET_6" 7 "INV_GAIN_SET_NUM" /end COMPU_VTAB
/begin COMPU_VTAB tLaunchControlMode "" TAB_VERB 4 0 "LC_MOD_UNKNOWN" 1 "LC_MOD_UNAVL" 2 "LC_MOD_AVL" 3 "LC_MOD_ACTV" /end COMPU_VTAB
/begin COMPU_VTAB tAccStationaryRequest "" TAB_VERB 3 0 "ACC_STATY_REQ_UNKNOWN" 1 "ACC_STATY_REQ_STATY" 2 "ACC_STATY_REQ_GO" /end COMPU_VTAB
/begin COMPU_VTAB tAdaptiveCruiseControlStateRequest "" TAB_VERB 5 0 "ACC_ST_REQ_UNKNOWN" 1 "ACC_ST_REQ_OFF" 2 "ACC_ST_REQ_STBY" 3 "ACC_ST_REQ_ACTV_VEL_CTRL" 4 "ACC_ST_REQ_ACTV_FOL_CTRL" /end COMPU_VTAB
/begin COMPU_VTAB tAccDistanceLevel "" TAB_VERB 5 0 "ACC_DIST_LVL_UNKNOWN" 1 "ACC_DIST_LVL_0" 2 "ACC_DIST_LVL_1" 3 "ACC_DIST_LVL_2" 4 "ACC_DIST_LVL_3" /end COMPU_VTAB
/begin COMPU_VTAB tAutomatedDriverControlState "" TAB_VERB 6 0 "AUT_DRVR_CTRL_ST_UKWN" 1 "AUT_DRVR_CTRL_ST_OFF" 2 "AUT_DRVR_CTRL_ST_RDY" 3 "AUT_DRVR_CTRL_ST_ACTV" 4 "AUT_DRVR_CTRL_ST_OVRD" 5 "AUT_DRVR_CTRL_ST_SHUTDWN" /end COMPU_VTAB
/begin COMPU_VTAB tBrakeLightRequest "" TAB_VERB 4 0 "BRK_LI_REQ_UNKNOWN" 1 "BRK_LI_REQ_OFF" 2 "BRK_LI_REQ_ON" 3 "BRK_LI_REQ_ESS_BRKG" /end COMPU_VTAB
/begin COMPU_VTAB tPowerSplitStartegy "" TAB_VERB 2 0 "POWER_SPLIT_STATIC" 1 "POWER_SPLIT_ADAPTIVE_ECMS" /end COMPU_VTAB
/begin COMPU_VTAB tVsoVehicleAngleSwt "" TAB_VERB 3 0 "VSO_VEH_AG_SWT_OFF" 1 "VSO_VEH_AG_SWT_SNSR" 2 "VSO_VEH_AG_SWT_KALMAN" /end COMPU_VTAB
/begin COMPU_VTAB tVsoVehicleMotionObserverSwt "" TAB_VERB 5 0 "VSO_VMO_SWT_OFF" 1 "VSO_VMO_SWT_KIN" 2 "VSO_VMO_SWT_DYN" 3 "VSO_VMO_SWT_HYB" 4 "VSO_VMO_SWT_DEBUG" /end COMPU_VTAB
/begin GROUP caldata_VALUE ""
 /begin REF_CHARACTERISTIC CEBrakeSMChangeDeadTime CEcp80PumpMaxSpd CEgyMgrPidIntglMax CEgyMgrPidIntglMin CEgyMgrRegenPwrMargin CEgyMgrTqDmdFilCoeff CElecEffChrg CElecEffDcha CElecMotChrgPwr CElecMotChrgPwrMax CElecMotChrgPwrMin CElecMotMaxSpd CElecMotMinSpeedCalculation CElecMotTqReqRampLimLower CElecMotTqReqRampLimUpper CElectMotEff CEmaCoeff CEmgyParkBrkButtonHoldTime CEmotCooltSnsrAmphenolRsTab CEmotorTorqueRampDown CEmotorTorqueRampUp CEnaDrvrBrkPedlWhlTqDtReq CEnaEmotCooltSnsrCircDiag CEnaEmotCooltSnsrOorDiag CEnaFricBrkReq CEnaFricBrkTqVect CEnaInvCtrlStPlaus CEnaPropshPumpCtrl CEnaPropshTqDmdForIce CEnaVecTqCooltSnsrCircDiag CEnaVecTqCooltSnsrOorDiag CEnblDecoupleEgyStgy CEnblDecoupleIdleEgyStgy CEnblDecoupleLightOffEgyStgy CEnblEgyMgrTqDmdRampLim CEnblEvBoost CEnblFilEgyMgrTqDmd CEngageHighLimit CEnterDeratingTime CEvBoostHeadRef CEvBoostPdotRef CEvBoostPwrMax CEvBoostRateDn CEvBoostRateUp CEvBoostRechargeGain CEvBoostWallet CEvBoostWalletTau CExitDeratingTime CFactoryTestFanReq CFactoryTestPumpReq CFastfillAdaptionIntegralHystNeg CFastfillAdaptionIntegralHystPos CFastfillAdaptionMaxStepNeg CFastfillAdaptionMinPeakPressure CFastfillAdaptionRoom CFastfillAdaptionWhlCluSpdCompMax CFastfillDelayTime CFastfillEndKissFactor CFastfillEndTime CFastfillHighThreshold CFastfillPressureDropThreshold CFastfillStrtPressure CFaultsDisTimeoutChkCanA CFaultsDisTimeoutChkCanB CFaultsDisTimeoutChkCanC CFaultsDisTimeoutChkCanD CFaultsDisTimeoutChkCanE CFaultsDisTimeoutChkCanF CFaultsNodeTimeoutHealPerd CFaultsWakeupPerd CFeedforwardDownKickPressure CFeedforwardDownKickThreshold CFeedforwardUpKickFactor CFeedforwardUpKickPressure CFeedforwardUpKickThreshold CFeedforwardUpKickTime CFFAdaptWhlCluRPMLimit CFicFanMaxSpd CForcedChrgBtnStTi CFricBrkPReqRsnThd CFricBrkWhlTqReqTotAchvThd CHighEBrakePWM CHndlgAttdModDft CHndlgAttdModHoldTi CHoldIgnitionTime CHomlnSftyIndcdVehVelMax CHvBatteryPumpMinimumCommand CHvSocCriticalHigh CHvSocCriticalLow CHvSocMinClimateControl CHvSocMinCooling CHvSocMinIgnition CHvSocMinLvCharging CHybIdleChrgPwrHystLowr CHybIdleChrgPwrHystUppr CHybIdleGear CHysteresisThreshold CIceIdleEntryThd CIceIdleExitThd CIceLightoffReqPrc CIceOffThrottleTqHybDrvg CIceOptPwr CIceSpdReqMax CIceSpdReqMin CIceSpdThdForCrkIniBump CIceTqMaxBufHybDrvg CIceTqMaxBufHybIdle CIceTqMinSlowIdle CIceTqMinSlowIdleEnable CIceTqReqRampLimLower CIceTqReqRampLimUpper CIdleAccThr CIdleInvGainSetTi CIdlePwrReqThr CIdleSpdThr CInhibitHvReqTimeMax CIntgResetOnSignFlip CInvCmdTimeout CInvCtrlStPlausTmr CInverterCurrentTqLimFiltCoeff CInverterMotorSpinningDirection CInverterPumpMinimumCommand CInvGainCrk CInvGainDft CInvGainElecDrv CInvGainIdle CInvGainPumpCtrl CInvSpdCtrlModEna CKickHoldOff CKissCluPMax CKissCluPMin CKissCluPressureHyst CLiftBtnDebounceDuration CLiftMoveTimeFac CLiftMoveTimeMax CLiftMoveTimeMin CLiftTimeout CLnchCtrlAbortReqAccrPedlPerc CLnchCtrlAbortReqBrkPedlPerc CLnchCtrlAbortSteerAgMax CLnchCtrlAbortTakeoffAccrPedlPerc CLnchCtrlAbortTakeoffBrkPedlPerc CLnchCtrlInfoMsgPerd CLnchCtrlPaddleHoldReqPerd CLnchCtrlPaddleReqDoublePressPerd CLnchCtrlPaddleReqEna CLnchCtrlRegulateStAccrPedlPerc CLnchCtrlRegulateStTimeoutPerd CLnchCtrlReqAllwdBrkPedl CLnchCtrlReqAllwdEngCooltTemp CLnchCtrlReqAllwdEngIatTemp CLnchCtrlReqAllwdInvCooltTemp CLnchCtrlReqAllwdLsttOilTemp CLnchCtrlReqEna CLnchCtrlReqStTimeoutPerd CLnchCtrlRetryPerd CLnchCtrlStAbortPerd CLnchCtrlTakeoffStBrkPedlPerc CLnchCtrlTakeoffStTimeoutPerd CLvBatteryVoltageHyst CLvSocReqHvOnChrg CLvSocStopChrg CManualOverrideTime CMaxEBrakePWM CMaxLvBatteryWarningThreshold CMinLvBatteryWarningThreshold CMu CNmPerBarMax CNmPerBarMin CNonCriticalMinimumCommand CNoPressureTh COvrdLiftCtrlEna COvrdLiftCtrlFL COvrdLiftCtrlFR COvrdLiftCtrlRL COvrdLiftCtrlRR CPaddleParkTime CPanelOpenVehVelThd CPedal1UMax CPedal1UMin CPedal2UMax CPedal2UMin CPedalAdaptionFilterNormalizedCutoffFreq CPedalAdaptionLimit CPedalDeadzone CPedalDiffLimit CPedalFaultTimeout CPedalWarmupTime CPerfModCptReqHoldPerd CPerfModDft CPerfModLiftInhbIgnore CPerfModReqHoldPerd CPerfModReqPndStTiHuLimPerd CPerfModReqPndStTiSteerKnobLimPerd CPerfModReqRejctdPerd CPerfModRgnModDftAtStartup CPerfModRgnModDftFromAdap CPerfModRgnModDftRstAtIgnRisngEdge CPID_AccumulatorLim CPowerEnterMargin CPowerExitMargin CPowerRestoreMargin CPowerSplitStrategy CPrechrgVltgNoBattDyno CPrelCluReqSteerAgThdLower CPrelCluReqSteerAgThdUpper CPrelCluReqVehVelThdLower CPrelCluReqVehVelThdUpper CPressOscilFiltCoef CPressOscilMaxPeriod CPressOscilMinAmpl CPressOscilSyncCount CPressOscilSyncMaxDeviation CPressSnsrCalDuration CPressSnsrCalHiPThMax CPressSnsrCalHiPThMin CPressSnsrCalInterval CPressSnsrCalPostUse CPressSnsrCalPressTh CPressSnsrOffsetMax CPropshCrkMinRate CPropshCrkSyncSpdErrThres CPropshCrkSyncStCnt CPropshPumpCtrlGainIntgl CPropshPumpCtrlGainProp CPropshPumpCtrlRunTimeout CPropshPumpCtrlSpd CPropshPumpCtrlSpdOffset CPropshPumpCtrlSpdOffsetEna CPropshPumpCtrlTqMax CPropshPumpDiagSpdErrThd CPropshRateCtrlTqReqIntglLimitLower CPropshRateCtrlTqReqIntglLimitUpper CPropshRateCtrlTqReqPartLim CPropshRateCtrlTqReqTotLim CPropshRateDirThdLowr CPropshRateDirThdUppr CPropshRateErrFiltStr CPropshRateErrThdForIdleInvGainSet CPropshRateForWhlRate CPropshRateIdle CPropshRateSyncIntgtrStTi CPropshRateTakeoffPreDwnshftBuf CPropshRateTakeoffStdstillBuf CPropshRateTarRampGrdt CPropshSpdFilFreq CPropshSpdIntgtrErrThres CPropshStatyCrkStTimeout CPropshTqDmdChrgMax CPropshTqDmdChrgMin CPropshTqDmdChrgRampLimDrvg CPropshTqDmdChrgRampLimIdle CPropshTqForInvSpdCtrlFiltCoeff CPropshTqReqIceFastFiltCoeff CPropshTqReqIceSlowFiltCoeff CPropshTqSyncFilCoeff CProshRateErrTqBuffer CPrplModChgAllwdWhileDrvg CPrplModSelnTime CPwrCorrHyst CPwrCorrnMax CPwrCorrnMin CPwrCorrThr CPwrReqStatyThr CReecTarget CRegimeAccThr CRegimePwrGradThr CRegimePwrThr CRestoreTime CRHCalibNbrBleedCycles CRHDropOutOfTolTime CRHFrontAxleStaticHeight CRHInhibitRide CRHLiftCalibDownTolerance CRhLiftDownThreshold CRHLiftPosnOorTolr CRhLiftUpFront CRhLiftUpRear CRhLiftUpTolerance CRHLooseToleranceDown CRHLooseToleranceUp CRHMaxRetries CRHminCarAwakeTime CRHRearAxleStaticHeight CRHsimVehicleSpeed CRHTightToleranceDown CRHTightToleranceUp CRHTimeLiftCalibMoveDown CRHTimeLiftCalibMoveUp CRHTimeServiceModeMoveDown CRHWishboneAgOorTolr CRideHeightLiftDwnFrnt CRideHeightLiftDwnRe CRideHeiRollCompEna CRideHeiRollCompLatAccThd CRuntimeCalibEnable CRuntimeCalibHPMargin CRuntimeCalibIdeviation CRuntimeCalibPressureConditionLow CRuntimeCalibPressureConditionTop CRuntimeCalibStepBase CRuntimeCalibStepTop CRuntimeCalibTempMax CRuntimeCalibTempMin CRuntimeCalibTime CRuntimeCalibVoteCount CRuntimeCalibVoteOpposite CScaledErrorPressureThresh CShiftReqFreezeTime CShiftReqTime CSignFlipDeadband CSlipCtrlrIMax CSlipCtrlrMinDeltaTi CSlipRateErrCutoffFreq CSocBandDecoupleIdle CSocBandRecoupleIdle CSocChrgThd CSocCorrnFltCoeff CSocDeplThd CSocHigh CSocHyst CSocHysteresis CSocLow CSocMax CSocMin CSocOverrideDyno CSocSoftHigh CSocSoftLow CSocSustDropGain CSocSustHigh CSocSustLow CSocSustTar CSoeOverrideDyno CSoftDisengageDuration CSolenoidDriverMinCurrent CSpdLimAsf CSpdLimDynoMod CSpdLimElOrIceLimp CSpdLimFbCtrlrEna CSpdLimFbWhlTqReqMax CSpdLimFbWhlTqReqMin CSpdLimFfCtrlrEna CSpdLimFfWhlTqReqMax CSpdLimFfWhlTqReqMin CSpdLimGainD CSpdLimGainI CSpdLimGainP CSpdLimIntglWhlTqMax CSpdLimIntglWhlTqMin CSpdLimIntvWhlTqThd CSpdLimLiftMod CSpdLimLiftoffHoldTime CSpdLimPanelOpen CSpdLimRampGrdtLimFast CSpdLimRampGrdtLimSlow CSpdLimTotWhlTqReqMax CSpdLimTotWhlTqReqMin CSpdLimTurtle CSpdLimUnlckMaxSpd CSpdLimVehVelLimDtOvrd CSpdLimVelCtrlEnaDfdFil CSpdLimVelErrDerivDecFilCoeff CSpdLimVelErrDerivIncFilCoeff CSpdLimWhlTqReqFilCoeff CSpdLimWhlTqReqFilEna CSpdLimWhlTqReqFilType CSpdSnsrChnFaultHealTime CSpdSnsrDirBitFailThd CSpdSnsrDirBitHealTime CSpdSnsrFrntAxleManShutoff CSpdSnsrFrntAxleSign CSpdSnsrFrntAxleZeroDetectTimeout CSpdSnsrFrntZeroDetectTimeout CSpdSnsrMinSpdDiagChk CSpdSnsrNoChgCntThd CSpdSnsrRearZeroDetectTimeout CSpdSnsrRedundancyFaultTime CSpdSnsrRedundancyHealTime CSpdSnsrRedundancyThd CSpeedLiftForcedDown CStatyCrkIceRunngDetnBuf CStatyCrkIceRunngDetnModNegElecTq CStatyCrkIceRunngDetnModSpd CStatyCrkIceSpd CStatyCrkTqReq CSteelDiscHeatCp CStepDownTime CStepUpTime CStuckOpenValvePressureLimit CSuspMtnRatLiftDwnFrnt CSuspMtnRatLiftDwnRe CSustainFltCoeff CSustEgyMgrPidGainBlend CSustEgyMgrPidKd CSustEgyMgrPidKi CSustEgyMgrPidKp CSyncCluRateSlipDfltT CTelltaleHoldDuration CTest_cycleRideHeight CTestAbsTelltlGvcuCondOvrdEna CTestAccrPedlEna CTestAccrPedlPerc CTestAdpvCrsCtrlAccelReq CTestAdpvCrsCtrlAccelReqOvrdEna CTestAdpvCrsCtrlBtnSt CTestAdpvCrsCtrlDistLvlReq CTestAdpvCrsCtrlDrvrReqEna CTestAdpvCrsCtrlFfTqCmpRefVel CTestAdpvCrsCtrlFolCtrlEna CTestAdpvCrsCtrlRoundedVehVelCalcn CTestAdpvCrsCtrlScrollBtnPosn CTestAdpvCrsCtrlScrollBtnPosnOvrdEna CTestAdpvCrsCtrlScrollBtnSt CTestAdpvCrsCtrlSetVelIncr CTestAdpvCrsCtrlStandgActvFromFolCtrlEna CTestAdpvCrsCtrlStandgActvFromStbyEna CTestAdpvCrsCtrlStatyReqOvrd CTestAdpvCrsCtrlStReq CTestAdpvCrsCtrlVelCtrlEna CTestAdpvCrsCtrlVelReq CTestAdpvCrsCtrlVelReqOvrdEna CTestAllowRideHeightWithIgnOff CTestAutDrvrCtrlStOvrd CTestAutoHillHoldBrkPReqEna CTestAutoHillHoldSt CTestAutoHillHoldSwtReq CTestBrkLiReq CTestBrkSwt CTestCenCluSlipCtrlEna CTestCenCluSyncEna CTestChgModEnaIEB CTestCluFaultReset CTestDiPtTelltls CTestDoorStsLe CTestDoorStsRi CTestDriftModEnaSt CTestDrvCfgSwtReq CTestDrvgCrkPauseSt CTestDrvMod CTestDrvrWhlTqReq CTestEBrakeCalibInhibPerd CTestElecMotPwrDemEna CTestElecMotTqReqOverride CTestElecMotTqReqOverrideEna CTestEnableFFAdaptions CTestEspAbsFuncDisblEna CTestEspTelltlGvcuCondOvrdEna CTestForceDisableEspAbsFuncEna CTestHndlgAttdMod CTestHoodStsFrnt CTestHoodStsRear CTestIceSpdReqV CTestIceTqReqOverride CTestIceTqReqOverrideEna CTestIgnBtnRisingEdgeIceStartEna CTestIgnBtnRisingEdgeIceStopEna CTestIgnHold CTestImobSt CTestLiftBtn CTestMaxPedal CTestOccupantPassSeat CTestOccupantRearLeftSeat CTestOccupantRearRightSeat CTestPaddleBoth CTestPaddleComb CTestPaddleCombEna CTestPaddleDown CTestPaddleEna CTestPaddleReqEna CTestPaddleUp CTestParkBtnSt CTestPerfModDDCDevModEna CTestPerfMode CTestPerfModReqAutoShiftMod CTestPerfModReqDDC CTestPerfModReqEPS CTestPerfModReqLaunchCtrlMod CTestPerfModReqPedlMapMod CTestPerfModReqPerfStgy CTestPerfModReqPrplMod CTestPerfModReqRgnMod CTestPerfModReqRHC CTestPerfModReqSpdLimr CTestPerfModReqTpms CTestPerfModSwtReq CTestPrelWhlCluReqElec CTestPrelWhlCluReqHybrid CTestPrkgBrkReq CTestPropshTqDmdChrgOvrd CTestPropshTqDmdChrgOvrdEna CTestPropshTqDmdFromEgyMgr CTestPrplModSwtReq CTestPwrSt CTestRegenCtrl CTestRePinionTqLimEna CTestSlipCtrlEna CTestSpdLimFfTqCmpRefVel CTestStatyCrkPauseSt CTestTelltaleAbsWarning CTestTelltaleActiveSystemFault CTestTelltaleAdaptiveCruiseControl CTestTelltaleAutoHold CTestTelltaleBatteryChargeCondition CTestTelltaleBrakeFailureWarning CTestTelltaleCheckEngineWarning CTestTelltaleCoolantLevelLowWarning CTestTelltaleCoolantTemperatureWarning CTestTelltaleCruiseControl CTestTelltaleEngineOilAdd CTestTelltaleEngineOilLevelLow CTestTelltaleEngineOilPressureWarning CTestTelltaleEngineOilTemperatureWarning CTestTelltaleEpsSteeringFailure CTestTelltaleEsp CTestTelltaleFuelPressureWarning CTestTelltaleHillHold CTestTelltaleHvWarning CTestTelltaleLimpWarning CTestTelltaleParkingBrakeWarning CTestTelltaleTcOff CTestTelltaleTirePressureWarning CTestTelltaleTrackMode CTestTelltaleTransmissionFailure CTestTelltaleTransmissionFluidLevelWarning CTestTelltaleTransmissionTemperatureWarning CTestTelltaleTurtleWarning CTestTireMdl CTestTracCtrlMod CTestTrackModePedlMapEna CTestTsmMstSwt CTestTsmPrefCenCluCluStFault CTestVdcPerfModReq CTestVehRollgSt CTestVsoRoadAgOvrdEna CTestVsoRoadBnkOvrd CTestVsoRoadGrdtOvrd CTestVsoTireMdlFricCoeffEstimnEnaSt CTestVsoTireMdlTireMaxFRednFacEnaSt CTestWhlCluControlOverride CTestWhlCluEnable CTestWhlCluSlipEnable CTestWhlCluSlipStart CTestWhlCluSlipTime CTestWhlCluSlipTMax CTestWhlTqDifReqEna CTestYawTqReqMod CThermalUnitBootUpTime CThermalUnitFaultDebounceTime CThermalUnitFaultTimeout CThermalUnitReqThrForDiag CThermalUnitSpdTolForDiag CThetaMax CThrmMgrFactoryTestEnbl CTightToleranceTimeout CTireMaxLgtSlipLimLowr CTireMaxLgtSlipLimUppr CTpmsSnsrValInvldOverwr CTpmsSpdLimMaxNorm CTpmsSpdLimMaxWinter CTpmsSpdLimMinNorm CTpmsSpdLimMinWinter CTpmsWarnLampDisableBelowLowSpd CTqLimElecMotTqLim CTqLimInvSpdCtrlBuf CTqLimPropshPmpTqLim CTqLimRePinionTqLim CTqStateCrkLtchdTmr CTqTranTol CTracCtrlCenCluTqLim CTracCtrlSlipCntDecay CTracCtrlSlipCntGrowth CTracCtrlSlipCntMax CTracCtrlSlipCntThresActive CTracCtrlSlipCntThresDeactive CTracCtrlWhlTqMax CTracCtrlWhlTqMin CTransientAccThr CTransientPwrGradThr CTrsmSpdSyncErrThres CTsmAwdTempThd CTsmAwdTempThdDbncTime CTsmCanCommStartup CTsmCrkStFaultTimeout CTsmDrvCfgMonrTimeThreshold CTsmEcmCommFaultEna CTsmForcedEvTurtle CTsmFricBrkMinTqThdLowr CTsmFricBrkMinTqThdUppr CTsmFricBrkRecupAxleSeln CTsmFricBrkTqVectAxleSeln CTsmHybDrvWithIceDecoupl CTsmLsttCommFaultEna CTsmPrefDrvCfgForEv CTsmPrplModMonrTimeThreshold CTsmPtCritAxleClosedEna CTsmPtCritAxleElecTurtEna CTsmPtCritAxleFrntMisEna CTsmPtCritAxleFwdEna CTsmPtCritAxleIceTurtEna CTsmPtCritAxleOpenEna CTsmPtCritAxleRearMisEna CTsmPtCritAxleRwdEna CTsmPtCritAxleShutdwnEna CTsmPtCritElecFaultEngOffEna CTsmPtCritElecShutdwnEna CTsmPtCritElecTurtUnavlEna CTsmPtCriticalFaultReset CTsmPtCritIceTurtUnavlEna CTsmPtCritTqUnavlEna CTsmPtLimpModTqMax CTsmTurtleModTqMax CTsmTurtleModTqMin CValveFullStrokeRequest CVecTqCooltSnsrAmphenolRsTab CVehFrntTrackWidth CVehFrntWheelbase CVehMassBase CVehReTrackWidth CVehReWheelbase CVehYawInertia CVirtualBattAvlChrgCrnt CVirtualBattAvlDchaCrnt CVirtualBattCp CVirtualBattEnbl CVirtualBattIntR CVirtualBattMaxChrgCrnt CVirtualBattMaxDchaCrnt CVirtualBattNomVltg CVirtualBattSoh CVirtualSocInit CVirtualSocInitPrc CVirtualSocMax CVirtualSocMin CVsoAeroDragArea CVsoAeroDragConst CVsoAeroDragFrntTrvlCoeff CVsoAeroDragRearTrvlCoeff CVsoAeroLoadConst CVsoDsoMinSpd CVsoDsoVehVelLatMaxAbs CVsoDsoVehYawRateMaxAbs CVsoImuAccelVariSnsr1 CVsoImuAccelVariSnsr2 CVsoImuAccelVariSnsr3 CVsoImuCalCntrRst CVsoImuDiagAccelVectNormMax CVsoImuDiagAgErrMax CVsoImuDiagCntrRst CVsoImuGyroVariSnsr1 CVsoImuGyroVariSnsr2 CVsoImuGyroVariSnsr3 CVsoKsoDecay0 CVsoKsoDecay1 CVsoKsoPole0 CVsoKsoPole1 CVsoRoadAgAccelThd CVsoRoadAgFilCoeff CVsoRoadAgFiltEna CVsoRoadAgStatyCalcnEna CVsoRollgDirBrakePressureThreshold CVsoRollgDirTakeoffAccel CVsoRollgDirTakeoffTorque CVsoRollgDirZeroWhlRateThreshold CVsoTireMdlFricHiLgtSlipThd CVsoTireMdlMaxPureLatSlipCon CVsoTireMdlMaxPureLgtSlipCon CVsoTireMdlPureLatSlipStfnCon CVsoTireRadAdaptEnable CVsoTireRadAdaptFilterCutoffFreq CVsoTireRadAdaptMaxAccel CVsoTireRadAdaptMaxFactor CVsoTireRadAdaptMaxFactorFault CVsoTireRadAdaptMaxSpd CVsoTireRadAdaptMaxSteer CVsoTireRadAdaptMinFactor CVsoTireRadAdaptMinFactorFault CVsoTireRadAdaptMinSpd CVsoTireRadFrntAlpinFree CVsoTireRadFrntAlpinPresFac CVsoTireRadFrntAlpinPresQuad CVsoTireRadFrntAlpinSpdFac CVsoTireRadFrntCup2Free CVsoTireRadFrntCup2PresFac CVsoTireRadFrntCup2PresQuad CVsoTireRadFrntCup2RFree CVsoTireRadFrntCup2RPresFac CVsoTireRadFrntCup2RPresQuad CVsoTireRadFrntCup2RSpdFac CVsoTireRadFrntCup2SpdFac CVsoTireRadReAlpinFree CVsoTireRadReAlpinPresFac CVsoTireRadReAlpinPresQuad CVsoTireRadReAlpinSpdFac CVsoTireRadReCup2Free CVsoTireRadReCup2PresFac CVsoTireRadReCup2PresQuad CVsoTireRadReCup2RFree CVsoTireRadReCup2RPresFac CVsoTireRadReCup2RPresQuad CVsoTireRadReCup2RSpdFac CVsoTireRadReCup2SpdFac CVsoTireRoadFricCoeffConDry CVsoTireRoadFricCoeffConIce CVsoVehAgEnaSwt CVsoVehAgPitchObserverCovariance CVsoVehAgPitchProcessCovariance CVsoVehAgRollObserverCovariance CVsoVehAgRollProcessCovariance CVsoVehMassClosedLoopEnable CVsoVehMassDamprSpdThd CVsoVehMassPassengerAdult CVsoVehMassPassengerChild CVsoVehMtnObsvrSwt CVsoWhlAgFrontStaticToe CVsoWhlAgReStaticToe CVsoWhlSpdAccelErrorWeight CVsoWhlSpdAccelFilterCutoffFreq CVsoWhlSpdAccelLimit CVsoWhlSpdBrakeLimit CVsoWhlSpdDerivativeFilterCutoffFreq CVsoWhlSpdLowQlyPenalty CVsoWhlSpdMinSnsrCnt CVsoWhlSpdOutputFilterCutoffFreq CVsoWhlSpdSlipGrad CVsoWhlSpdTqPenalty CVsoWhlTqFrntBrkArea CVsoWhlTqFrntBrkRadius CVsoWhlTqFrntBrkThermalInertia CVsoWhlTqMaxFricBrkP CVsoWhlTqRearBrkThermalInertia CVsoWhlTqReBrkArea CVsoWhlTqReBrkRadius CWaffleThermConduct CWhlCluSignDirThresh CWhlCluSignFiltCoeff CWhlCluSignSlipBuf CWhlCluSignTqHyst CWhlCluSignZeroEnterMs CWhlCluSignZeroEnterThresh CWhlCluSimpleSignDetnEna CWhlCluTqMax CWhlCluTqRampLim CWhlRateMinCluOuterMax CWhlTqFrLimLowrAbsActv /end REF_CHARACTERISTIC
/end GROUP
/end MODULE
/end PROJECT
